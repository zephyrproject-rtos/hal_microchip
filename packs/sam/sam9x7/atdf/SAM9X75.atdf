# SAM9X75 device description
Architecture: ARM926EJ-S; Family: SAM9; Series: SAM9X7
Parameters: POWER_DOMAIN=PD_CORE, __ARCH_ARM=1, __ARCH_ARM_CORTEX_M=0
Programming and debug interfaces: JTAG
Registers are 32-bit, read-write, reset 0x0 unless marked. A register's access mark holds for its fields unless they carry their own. Offsets are from the block's base; lines under a group give offsets from that group; [hi:lo] are bit positions; {n}, {i} and the like mark numbered series; 'fields as' and 'values as' point back to an identical list; <NAME> marks a mode.

## Ordering variants
SAM9X75-I/4PB: TFBGA240, pinout BGA240, up to 800 MHz, -40 to 85 C, 1.7 to 3.6 V
SAM9X75-V/4PB: TFBGA240, pinout BGA240, up to 800 MHz, -40 to 105 C, 1.7 to 3.6 V
SAM9X75-V/6GW: TFBGA256, pinout BGA256, up to 800 MHz, -40 to 105 C, 1.7 to 3.6 V

## Memory
base space: start 0 size 0x100000000, little endian
  0x00100000 ECC_ROM size 0x100000 rom, ro, executable
  0x00300000 SRAM0 size 0x100000 ram, rw, executable
  0x00400000 SRAM1 size 0x100000 ram, rw, executable
  0x00500000 UDPHS_RAM size 0x100000 ram, rw, executable
  0x00600000 UHPHS_OHCI size 0x100000 ram, rw, executable
  0x00700000 UHPHS_EHCI size 0x100000 ram, rw, executable
  0x10000000 EBI_CS0 size 0x10000000 ram, rw, executable, external
  0x20000000 EBI_CS1 size 0x10000000 ram, rw, executable, external
  0x20000000 EBI_MPDDR size 0x10000000 ram, rw, executable, external
  0x30000000 EBI_CS2 size 0x10000000 ram, rw, executable, external
  0x30000000 EBI_NF size 0x10000000 ram, rw, executable, external
  0x60000000 QSPIMEM size 0x20000000 ram, rw, executable
  0x80000000 SDMMC0 size 0x10000000 ram, rw, executable
  0x90000000 SDMMC1 size 0x10000000 ram, rw, executable
  0xD0000000 CSI2DC_META size 0x100000 ram, rw, executable
  0xEFF00000 OTPC size 0x1000 ram, rw, executable
  0xF0000000 PERIPHERALS size 0x10000000 io, rw

## Peripheral instances (address, pins/pin function, parameters)
ADC at 0xF804C000
  pins: AD{n} PA{n+24}/X1 (n=0..7); ADTRG PB18/B set 1
  parameters: INSTANCE_ID=19 (ADC Controller), CLOCK_ID=19, DMAC_ID_RX=40
AES at 0xF0034000
  parameters: INSTANCE_ID=39 (Advanced Encryption Standard), CLOCK_ID=39, DMAC_ID_TX=32, DMAC_ID_RX=33
AIC at 0xFFFFF100
  pins: IRQ PB18/D set 1; FIQ PC31/A set 1
  parameters: INSTANCE_ID_FIQ=0 (Advanced Interrupt Controller), INSTANCE_ID_IRQ=31 (Advanced Interrupt Controller)
BSC at 0xFFFFFE54
CLASSD at 0xF003C000
  pins: CLASSD_R0 PA15/C set 1; CLASSD_R1 PA16/C set 1; CLASSD_R2 PA17/C set 1; CLASSD_L0 PA18/C set 1; CLASSD_L1 PA19/C set 1; CLASSD_L2 PA20/C set 1; CLASSD_L3 PA21/C set 1; CLASSD_R3 PA22/C set 1
  parameters: INSTANCE_ID=42 (CLASS D Controller), CLOCK_ID=42, DMAC_ID_TX=35
CSI at 0xF8058000
  parameters: INSTANCE_ID=53 (Camera Serial Interface 2 4-Lanes), CLOCK_ID=53
CSI2DC at 0xF805C000
  parameters: INSTANCE_ID=52 (CSI to Demultiplexer Controller), CLOCK_ID=52
DBGU at 0xFFFFF200
  pins: DRXD PA26/A set 1; DTXD PA27/A set 1
  parameters: INSTANCE_ID=47 (DBGU), CLOCK_ID=47, DMAC_ID_TX=28, DMAC_ID_RX=29
DSI at 0xF8054000
  parameters: INSTANCE_ID=54 (Display Serial Interface 4-Lanes), CLOCK_ID=54
EBI
  pins: NANDOE PD0/A set 1; NANDWE PD1/A set 1; A21 PD2/A set 1; NANDALE PD2/A set 1; A22 PD3/A set 1; NANDCLE PD3/A set 1; NCS2 PD4/A set 1; NANDCS PD4/A set 1; NCS0 PD5/B set 1; NANDDAT{n} PD{n+6}/A set 1 (n=0..7); A1 PD6/B set 1; A12 PD7/B set 1; A19 PD8/B set 1; A20 PD9/B set 1; NRD PD10/B set 1; NWR0 PD11/B set 1; NWE PD11/B set 1; A0 PD12/B set 1; NBS0 PD12/B set 1; NWR1 PD13/B set 1; NBS1 PD13/B set 1; NWAIT PD14/A set 1; NANDRDY PD14/A set 1; BA0 A16/X1; BA1 A17/X1; BA2 A18/X1
FLEXCOM0 at 0xF801C000 (FLEXCOM)
  pins: FLEXCOM0_IO4 PA6/A set 1; FLEXCOM0_IO3 PA7/A set 1; FLEXCOM0_IO2 PA8/A set 1; FLEXCOM0_IO0 PA30/A set 1; FLEXCOM0_IO1 PA31/A set 1; FLEXCOM0_IO7 PB6/B set 1
  parameters: INSTANCE_ID=5 (Flexcom 0), CLOCK_ID=5, DMAC_ID_TX=0, DMAC_ID_RX=1, USART_FIFO_SIZE=16, SPI_FIFO_SIZE=16, TWI_FIFO_SIZE=16
FLEXCOM1 at 0xF8020000 (FLEXCOM)
  pins: FLEXCOM1_IO0 PA28/A set 1; FLEXCOM1_IO1 PA29/A set 1; FLEXCOM1_IO7 PC17/B set 1; FLEXCOM1_IO4 PC27/C set 1; FLEXCOM1_IO3 PC28/C set 1; FLEXCOM1_IO2 PC29/C set 1
  parameters: INSTANCE_ID=6 (Flexcom 1), CLOCK_ID=6, DMAC_ID_TX=2, DMAC_ID_RX=3, USART_FIFO_SIZE=16, SPI_FIFO_SIZE=16, TWI_FIFO_SIZE=16
FLEXCOM2 at 0xF8024000 (FLEXCOM)
  pins: FLEXCOM2_IO0 PA13/A set 1; FLEXCOM2_IO1 PA14/A set 1; FLEXCOM2_IO7 PA23/C set 1; FLEXCOM2_IO4 PB0/B set 1; FLEXCOM2_IO3 PB1/B set 1; FLEXCOM2_IO2 PB2/B set 1
  parameters: INSTANCE_ID=7 (Flexcom 2), CLOCK_ID=7, DMAC_ID_TX=4, DMAC_ID_RX=5, USART_FIFO_SIZE=16, SPI_FIFO_SIZE=16, TWI_FIFO_SIZE=16
FLEXCOM3 at 0xF8028000 (FLEXCOM)
  pins: FLEXCOM3_IO0 PC22/B set 1; FLEXCOM3_IO1 PC23/B set 1; FLEXCOM3_IO4 PC24/B set 1; FLEXCOM3_IO3 PC25/B set 1; FLEXCOM3_IO2 PC26/B set 1; FLEXCOM3_IO7 PC30/C set 1
  parameters: INSTANCE_ID=8 (Flexcom 3), CLOCK_ID=8, DMAC_ID_TX=6, DMAC_ID_RX=7, USART_FIFO_SIZE=16, SPI_FIFO_SIZE=16, TWI_FIFO_SIZE=16
FLEXCOM4 at 0xF0000000 (FLEXCOM)
  pins: FLEXCOM4_IO1 PA9/A set 1 2; FLEXCOM4_IO0 PA10/A set 1 2; FLEXCOM4_IO2 PA11/A set 1 2; FLEXCOM4_IO3 PA12/A set 1 2; FLEXCOM4_IO4 PA13/B set 1 or PA30/C set 2; FLEXCOM4_IO5 PA14/C set 1 or PA31/B set 2; FLEXCOM4_IO6 PB3/B set 1
  parameters: INSTANCE_ID=13 (Flexcom 4), CLOCK_ID=13, DMAC_ID_TX=8, DMAC_ID_RX=9, USART_FIFO_SIZE=16, SPI_FIFO_SIZE=16, TWI_FIFO_SIZE=16
FLEXCOM5 at 0xF0004000 (FLEXCOM)
  pins: FLEXCOM5_IO4 PA12/C set 1 or PA30/B set 2; FLEXCOM5_IO3 PA14/B set 1 2; FLEXCOM5_IO1 PA15/B set 1 2; FLEXCOM5_IO0 PA16/B set 1 2; FLEXCOM5_IO2 PA17/B set 1 2; FLEXCOM5_IO6 PA24/B set 1; FLEXCOM5_IO5 PA25/B set 1
  parameters: INSTANCE_ID=14 (Flexcom 5), CLOCK_ID=14, DMAC_ID_TX=10, DMAC_ID_RX=11, USART_FIFO_SIZE=16, SPI_FIFO_SIZE=16, TWI_FIFO_SIZE=16
FLEXCOM6 at 0xF8010000 (FLEXCOM)
  pins: FLEXCOM6_IO0 PA24/A set 1; FLEXCOM6_IO1 PA25/A set 1; FLEXCOM6_IO2 PB7/C set 1; FLEXCOM6_IO3 PB8/C set 1; FLEXCOM6_IO4 PB9/C set 1
  parameters: INSTANCE_ID=9 (Flexcom 6), CLOCK_ID=9, DMAC_ID_TX=12, DMAC_ID_RX=13, USART_FIFO_SIZE=16, SPI_FIFO_SIZE=16, TWI_FIFO_SIZE=16
FLEXCOM7 at 0xF8014000 (FLEXCOM)
  pins: FLEXCOM7_IO0 PC0/C set 1; FLEXCOM7_IO1 PC1/C set 1; FLEXCOM7_IO2 PD0/C set 1; FLEXCOM7_IO3 PD1/C set 1; FLEXCOM7_IO4 PD2/C set 1
  parameters: INSTANCE_ID=10 (Flexcom 7), CLOCK_ID=10, DMAC_ID_TX=14, DMAC_ID_RX=15, USART_FIFO_SIZE=16, SPI_FIFO_SIZE=16, TWI_FIFO_SIZE=16
FLEXCOM8 at 0xF8018000 (FLEXCOM)
  pins: FLEXCOM8_IO0 PB4/B set 1; FLEXCOM8_IO1 PB5/B set 1; FLEXCOM8_IO2 PB10/C set 1; FLEXCOM8_IO3 PB11/C set 1; FLEXCOM8_IO4 PB12/C set 1
  parameters: INSTANCE_ID=11 (Flexcom 8), CLOCK_ID=11, DMAC_ID_TX=16, DMAC_ID_RX=17, USART_FIFO_SIZE=16, SPI_FIFO_SIZE=16, TWI_FIFO_SIZE=16
FLEXCOM9 at 0xF8040000 (FLEXCOM)
  pins: FLEXCOM9_IO2 PB22/C set 1; FLEXCOM9_IO3 PB23/C set 1; FLEXCOM9_IO4 PB24/C set 1; FLEXCOM9_IO0 PC8/C set 1; FLEXCOM9_IO1 PC9/C set 1
  parameters: INSTANCE_ID=15 (Flexcom 9), CLOCK_ID=15, DMAC_ID_TX=18, DMAC_ID_RX=19, USART_FIFO_SIZE=16, SPI_FIFO_SIZE=16, TWI_FIFO_SIZE=16
FLEXCOM10 at 0xF8044000 (FLEXCOM)
  pins: FLEXCOM10_IO0 PC16/C set 1; FLEXCOM10_IO1 PC17/C set 1; FLEXCOM10_IO2 PC18/B set 1; FLEXCOM10_IO3 PC19/B set 1; FLEXCOM10_IO4 PC20/B set 1
  parameters: INSTANCE_ID=16 (Flexcom 10), CLOCK_ID=16, DMAC_ID_TX=20, DMAC_ID_RX=21, USART_FIFO_SIZE=16, SPI_FIFO_SIZE=16, TWI_FIFO_SIZE=16
FLEXCOM11 at 0xF0020000 (FLEXCOM)
  pins: FLEXCOM11_IO0 PB15/C set 1; FLEXCOM11_IO1 PB16/C set 1; FLEXCOM11_IO2 PD3/C set 1; FLEXCOM11_IO3 PD4/C set 1; FLEXCOM11_IO4 PD5/C set 1
  parameters: INSTANCE_ID=32 (Flexcom 11), CLOCK_ID=32, DMAC_ID_TX=22, DMAC_ID_RX=23, USART_FIFO_SIZE=16, SPI_FIFO_SIZE=16, TWI_FIFO_SIZE=16
FLEXCOM12 at 0xF0024000 (FLEXCOM)
  pins: FLEXCOM12_IO0 PB17/C set 1; FLEXCOM12_IO1 PB18/C set 1; FLEXCOM12_IO2 PB19/C set 1; FLEXCOM12_IO3 PB20/C set 1; FLEXCOM12_IO4 PB21/C set 1
  parameters: INSTANCE_ID=33 (Flexcom 12), CLOCK_ID=33, DMAC_ID_TX=24, DMAC_ID_RX=25, USART_FIFO_SIZE=16, SPI_FIFO_SIZE=16, TWI_FIFO_SIZE=16
GFX2D at 0xF0018000
  parameters: INSTANCE_ID=36 (2D Graphic Controller), CLOCK_ID=36
GMAC at 0xF802C000
  pins: GTSUCOMP PA31/C set 1; GRX2 PB0/A set 1; GRXER PB0/C set 1; GRX3 PB1/A set 1; G125CK PB2/A set 1; GCRSDV PB3/A set 1; GRXCTL PB3/A set 1; GTX2 PB4/A set 1; GTX3 PB5/A set 1; GTXCK PB6/A set 1; GREFCK PB6/A set 1; GTXEN PB7/A set 1; GTXCTL PB7/A set 1; GRXCK PB8/A set 1; GMDIO PB9/A set 1; GMDC PB10/A set 1; GRX0 PB11/A set 1; GRX1 PB12/A set 1; GTX0 PB13/A set 1; GTX1 PB14/A set 1
  parameters: INSTANCE_ID=24 (Gigabit Ethernet MAC), CLOCK_ID=24, INSTANCE_ID_Q{n}={n+59} (GMAC Queue {n} Interrupt signal toggled on a DMA write to the first word of each DMA data buffer associated with queue {n}) (n=1..5), INSTANCE_ID_EMAC=65 (Gigabit Ethernet MAC - Express MAC), INSTANCE_ID_MMSL=66 (Gigabit Ethernet MAC - Mac Merge SubLayer), INSTANCE_ID_TSU=67 (Gigabit Ethernet MAC - Time Stamp Unit), CLOCK_ID_TSU=67
GPBR at 0xFFFFFE60
I2SMCC at 0xF001C000
  pins: I2SMCC_WS PB15/D set 1; I2SMCC_DIN0 PB16/D set 1; I2SMCC_DOUT0 PB17/D set 1; I2SMCC_MCK PB25/D set 1; I2SMCC_CK PB26/D set 1
  parameters: INSTANCE_ID=34 (I2S Multi Channel Controller), CLOCK_ID=34, DMAC_ID_TX=36, DMAC_ID_RX=37
ISC at 0xF8048000
  pins: ISC_D{n} PC{n}/B set 1 (n=0..11); ISC_PCK PC12/B set 1; ISC_VSYNC PC13/B set 1; ISC_HSYNC PC14/B set 1; ISC_MCK PC15/B set 1; ISC_FIELD PC16/B set 1
  parameters: INSTANCE_ID=43 (Camera Interface), CLOCK_ID=43
XLCDC at 0xF8038000 (LCDC)
  parameters: INSTANCE_ID=25 (LCD Controller), CLOCK_ID=25
LVDSC at 0xF8060000
  parameters: INSTANCE_ID=56 (Display Serial Interface between XLCDC and LVDS interface), CLOCK_ID=56
LVDSPHY
  pins: LVDS_A0M PC2/X1; LVDS_A0P PC3/X1; LVDS_A1M PC4/X1; LVDS_A1P PC5/X1; LVDS_A2M PC6/X1; LVDS_A2P PC7/X1; LVDS_CLK1M PC10/X1; LVDS_CLK1P PC11/X1; LVDS_A3M PC12/X1; LVDS_A3P PC13/X1
  parameters: INSTANCE_ID=57 (LVDS PHY)
MATRIX at 0xFFFFDE00
  parameters: INSTANCE_ID=21 (Matrix)
MCAN0 at 0xF8000000 (MCAN)
  pins: CANRX0 PA26/B set 1; CANTX0 PA27/B set 1
  parameters: INSTANCE_ID=29 (Master CAN 0), CLOCK_ID=29, ID_MCAN0_INT0=29 (Master CAN 0 interrupt 0), ID_MCAN0_INT1=68 (Master CAN 0 interrupt 1)
MCAN1 at 0xF8004000 (MCAN)
  pins: CANTX1 PA28/B set 1; CANRX1 PA29/B set 1
  parameters: INSTANCE_ID=30 (Master CAN 1), CLOCK_ID=30, ID_MCAN1_INT0=30 (Master CAN 1 interrupt 0), ID_MCAN1_INT1=69 (Master CAN 1 interrupt 1)
MIPIPHY
  parameters: INSTANCE_ID=55 (MIPI DPHY interface)
MPDDRC at 0xFFFFE800
  parameters: INSTANCE_ID=49 (logical-OR interrupt of MPDDRC and SMC), CLOCK_ID=49
OTPC at 0xEFF00000
  parameters: INSTANCE_ID=46 (OTP Controller), EMULATION_ADDRESS=0x00400000, EMULATION_SIZE=0x00001000
PIOA at 0xFFFFF400 (PIO)
  pins: P{n} PA{n} (n=0..31)
  parameters: INSTANCE_ID=2 (Parallel I/O Controller A), CLOCK_ID=2, OSR_DEFAULT_VAL=0x00000000 (Register value at reset), PSR_DEFAULT_VAL=0xFFFFFFFF (Register value at reset), PUSR_DEFAULT_VAL=0x00000000 (Register value at reset), PPDSR_DEFAULT_VAL=0xFFFFFFFF (Register value at reset), ABCDSR1_DEFAULT_VAL=0x00000000 (Register value at reset), ABCDSR2_DEFAULT_VAL=0x00000000 (Register value at reset)
PIOB at 0xFFFFF600 (PIO)
  pins: P{n} PB{n-32} (n=32..58)
  parameters: INSTANCE_ID=3 (Parallel I/O Controller B), CLOCK_ID=3, OSR_DEFAULT_VAL=0x00000000 (Register value at reset), PSR_DEFAULT_VAL=0xFFFFFFFF (Register value at reset), PUSR_DEFAULT_VAL=0xF8000000 (Register value at reset), PPDSR_DEFAULT_VAL=0xFFFFFFFF (Register value at reset), ABCDSR1_DEFAULT_VAL=0x00000000 (Register value at reset), ABCDSR2_DEFAULT_VAL=0x00000000 (Register value at reset)
PIOC at 0xFFFFF800 (PIO)
  pins: P{n} PC{n-64} (n=64..95)
  parameters: INSTANCE_ID=4 (Parallel I/O Controller C), CLOCK_ID=4, OSR_DEFAULT_VAL=0x02000000 (Register value at reset), PSR_DEFAULT_VAL=0xFDFFFFFF (Register value at reset), PUSR_DEFAULT_VAL=0x02000000 (Register value at reset), PPDSR_DEFAULT_VAL=0xFDFFFFFF (Register value at reset), ABCDSR1_DEFAULT_VAL=0x00000000 (Register value at reset), ABCDSR2_DEFAULT_VAL=0x02000000 (Register value at reset)
PIOD at 0xFFFFFA00 (PIO)
  pins: P{n} PD{n-96} (n=96..110)
  parameters: INSTANCE_ID=44 (Parallel I/O Controller D), CLOCK_ID=44, OSR_DEFAULT_VAL=0x0000000C (Register value at reset), PSR_DEFAULT_VAL=0xFFFFFFF3 (Register value at reset), PUSR_DEFAULT_VAL=0xFFFF800C (Register value at reset), PPDSR_DEFAULT_VAL=0xFFFFFFF3 (Register value at reset), ABCDSR1_DEFAULT_VAL=0x00000000 (Register value at reset), ABCDSR2_DEFAULT_VAL=0x00000000 (Register value at reset)
PIT at 0xFFFFFE40
PIT64B0 at 0xF0028000 (PIT64B)
  parameters: INSTANCE_ID=37 (64-b Timer 0), CLOCK_ID=37
PIT64B1 at 0xF0040000 (PIT64B)
  parameters: INSTANCE_ID=58 (64-b Timer 1), CLOCK_ID=58
PMC at 0xFFFFFC00
  pins: PCK1 PB9/B set 1 or PC31/C set 2; PCK0 PB10/B set 1 or PC15/C set 2
  parameters: PMC_PROG_CLK_NB=2 (Number of PCKs in the product - 1 SAM9X60, SAM9X7: 1 SAMA7G5: 7)
PMECC at 0xFFFFE000
  parameters: INSTANCE_ID=48 (logical-OR interrupt of PMECC and PMERRLOC), CLOCK_ID=48
PMERRLOC at 0xFFFFE600
PUF at 0xF8030000
  parameters: INSTANCE_ID=59 (HW PUF QuiddiKey IP), CLOCK_ID=59
PWM at 0xF8034000
  pins: PWM0 PB11/B set 2 or PC10/C set 3 or PC18/C set 1; PWM1 PB12/B set 2 or PC11/C set 3 or PC19/C set 1; PWM2 PB13/B set 2 or PC20/C set 1; PWM3 PB14/B set 2 or PC21/C set 1
  parameters: INSTANCE_ID=18 (Pulse Width Modulation Controller), CLOCK_ID=18
QSPI at 0xF0014000
  pins: QIO5 PB15/A set 1; QIO6 PB16/A set 1; QIO7 PB17/A set 1; QDQS PB18/A set 1; QSCK PB19/A set 1; QCS PB20/A set 1; QIO0 PB21/A set 1; QIO1 PB22/A set 1; QIO2 PB23/A set 1; QIO3 PB24/A set 1; QINT PB25/A set 1; QIO4 PB26/A set 1
  parameters: INSTANCE_ID=35 (Quad I/O SPI Controller), CLOCK_ID=35, DMAC_ID_TX=26, DMAC_ID_RX=27
RSTC at 0xFFFFFE00
RTC at 0xFFFFFEA8
RTT at 0xFFFFFE20
SCKC at 0xFFFFFE50
SDMMC0 at 0x80000000 (SDMMC)
  pins: SDMMC0_DAT0 PA0/A set 1; SDMMC0_CMD PA1/A set 1; SDMMC0_CK PA2/A set 1; SDMMC0_DAT1 PA3/A set 1; SDMMC0_DAT2 PA4/A set 1; SDMMC0_DAT3 PA5/A set 1
  parameters: INSTANCE_ID=12 (Secure Data Memory Card Controller 0), CLOCK_ID=12
SDMMC1 at 0x90000000 (SDMMC)
  pins: SDMMC1_DAT1 PA6/B set 1; SDMMC1_DAT2 PA7/B set 1; SDMMC1_DAT3 PA8/B set 1; SDMMC1_DAT0 PA9/B set 1; SDMMC1_CMD PA10/B set 1; SDMMC1_CK PA11/B set 1
  parameters: INSTANCE_ID=26 (Secure Data Memory Card Controller 1), CLOCK_ID=26
SFR at 0xF8050000
SHA at 0xF002C000
  parameters: INSTANCE_ID=41 (Secure Hash Algorithm), CLOCK_ID=41, DMAC_ID_TX=34
SHDWC at 0xFFFFFE10
SMC at 0xFFFFEA00
SSC at 0xF0010000
  pins: TK PA18/B set 1; TF PA19/B set 1; TD PA20/B set 1; RD PA21/B set 1; RK PA22/B set 1; RF PA23/B set 1
  parameters: INSTANCE_ID=28 (Synchronous Serial Controller), CLOCK_ID=28, DMAC_ID_TX=38, DMAC_ID_RX=39
SYSCWP at 0xFFFFFEDC
TC0 at 0xF8008000 (TC)
  pins: TIOA0 PA15/A set 1; TIOA1 PA16/A set 1; TIOA2 PA17/A set 1; TCLK0 PA18/A set 1; TCLK1 PA19/A set 1; TCLK2 PA20/A set 1; TIOB0 PA21/A set 1; TIOB1 PA22/A set 1; TIOB2 PA23/A set 1
  parameters: INSTANCE_ID=17 (TC 0,1,2), CLOCK_ID=17, DMAC_ID_RX=41, TCCLKS_=0 (MCK), TCCLKS_TIMER_CLOCK1=1 (GCLK), TCCLKS_TIMER_CLOCK2=2 (MCK/8), TCCLKS_TIMER_CLOCK3=3 (MCK/32), TCCLKS_TIMER_CLOCK4=4 (MCK/128), TCCLKS_TIMER_CLOCK5=5 (MD_SLCK), TCCLKS_XC0=6 (XC0), TCCLKS_XC1=7 (XC1), TCCLKS_XC2=8 (XC2), NUM_INTERRUPT_LINES=1, TIMER_WIDTH=32
TC1 at 0xF800C000 (TC)
  pins: TIOA3 PC2/C set 1; TIOB3 PC3/C set 1; TCLK3 PC4/C set 1; TIOA4 PC5/C set 1; TIOB4 PC6/C set 1; TCLK4 PC7/C set 1; TIOA5 PC12/C set 1; TIOB5 PC13/C set 1; TCLK5 PC14/C set 1
  parameters: INSTANCE_ID=45 (TC 3,4,5), CLOCK_ID=45, DMAC_ID_RX=42, TCCLKS_=0 (MCK), TCCLKS_TIMER_CLOCK1=1 (GCLK), TCCLKS_TIMER_CLOCK2=2 (MCK/8), TCCLKS_TIMER_CLOCK3=3 (MCK/32), TCCLKS_TIMER_CLOCK4=4 (MCK/128), TCCLKS_TIMER_CLOCK5=5 (MD_SLCK), TCCLKS_XC0=6 (XC0), TCCLKS_XC1=7 (XC1), TCCLKS_XC2=8 (XC2), NUM_INTERRUPT_LINES=1, TIMER_WIDTH=32
TDES at 0xF0038000
  parameters: INSTANCE_ID=40 (Triple Data Encryption Standard), CLOCK_ID=40, DMAC_ID_RX=30, DMAC_ID_TX=31
TRNG at 0xF0030000
  parameters: INSTANCE_ID=38 (True Random Number Generator), CLOCK_ID=38
UDPHS at 0xF803C000
  parameters: INSTANCE_ID=23 (USB Device High Speed), CLOCK_ID=23
UHPHS_OHCI at 0x00600000 (UHPFS)
UHPHS at 0x00700000
  parameters: INSTANCE_ID=22 (USB Host High Speed), CLOCK_ID=22
UHPHS_EHCI at 0x00700000 (UHPHS)
WDT at 0xFFFFFF80
XDMAC at 0xF0008000
  parameters: INSTANCE_ID=20 (Extended DMA Controller), CLOCK_ID=20

## Interrupts
0 EXT_FIQ (AIC) — Advanced Interrupt Controller
1 SYSC (PMC WDT PIT RSTC RTT RTC) — Logical-OR interrupt of PMC, WDT, PIT, RSTC, RTT, RTC
2 PIOA — Parallel I/O Controller A
3 PIOB — Parallel I/O Controller B
4 PIOC — Parallel I/O Controller C
5 FLEXCOM0
6 FLEXCOM1
7 FLEXCOM2
8 FLEXCOM3
9 FLEXCOM6
10 FLEXCOM7
11 FLEXCOM8
12 SDMMC0 — Secure Data Memory Card Controller 0
13 FLEXCOM4
14 FLEXCOM5
15 FLEXCOM9
16 FLEXCOM10
17 TC0 — TC 0,1,2
18 PWM — Pulse Width Modulation Controller
19 ADC — ADC Controller
20 XDMAC — Extended DMA Controller
21 MATRIX
22 UHPHS — USB Host High Speed
23 UDPHS — USB Device High Speed
24 GMAC — Gigabit Ethernet MAC
25 XLCDC — LCD Controller
26 SDMMC1 — Secure Data Memory Card Controller 1
28 SSC — Synchronous Serial Controller
29 MCAN0_INT0 (MCAN0) — Master CAN 0
30 MCAN1_INT0 (MCAN1) — Master CAN 1
31 EXT_IRQ (AIC) — Advanced Interrupt Controller
32 FLEXCOM11
33 FLEXCOM12
34 I2SMCC — I2S Multi Channel Controller
35 QSPI — Quad I/O SPI Controller
36 GFX2D — 2D Graphic Controller
37 PIT64B0 — 64-b Timer 0
38 TRNG — True Random Number Generator
39 AES — Advanced Encryption Standard
40 TDES — Triple Data Encryption Standard
41 SHA — Secure Hash Algorithm
42 CLASSD — CLASS D Controller
43 ISC — Camera Interface
44 PIOD — Parallel I/O Controller D
45 TC1 — TC 3,4,5
46 OTPC — OTP Controller
47 DBGU
48 ECC (PMECC PMERRLOC) — logical-OR interrupt of PMECC and PMERRLOC
49 MC (MPDDRC SMC) — logical-OR interrupt of MPDDRC and SMC
52 CSI2DC — CSI to Demultiplexer Controller
53 CSI — Camera Serial Interface 2 4-Lanes
54 DSI — Display Serial Interface 4-Lanes
55 MIPIPHY — MIPI DPHY interface
56 LVDSC — Display Serial Interface between XLCDC and LVDS interface
57 LVDSPHY
58 PIT64B1 — 64-b Timer 1
60 GMAC_Q1 (GMAC) — GMAC Queue 1 Interrupt signal toggled on a DMA write to the first word of each DMA data buffer associated with queue 1
61 GMAC_Q2 (GMAC) — GMAC Queue 2 Interrupt signal toggled on a DMA write to the first word of each DMA data buffer associated with queue 2
62 GMAC_Q3 (GMAC) — GMAC Queue 3 Interrupt signal toggled on a DMA write to the first word of each DMA data buffer associated with queue 3
63 GMAC_Q4 (GMAC) — GMAC Queue 4 Interrupt signal toggled on a DMA write to the first word of each DMA data buffer associated with queue 4
64 GMAC_Q5 (GMAC) — GMAC Queue 5 Interrupt signal toggled on a DMA write to the first word of each DMA data buffer associated with queue 5
65 GMAC_EMAC (GMAC) — Gigabit Ethernet MAC - Express MAC
66 GMAC_MMSL (GMAC) — Gigabit Ethernet MAC - Mac Merge SubLayer
68 MCAN0_INT1 (MCAN0) — Master CAN 0 interrupt 1
69 MCAN1_INT1 (MCAN1) — Master CAN 1 interrupt 1

## Properties
NAMING_RULES: SUBSTRUCTURE_PREFIX=true
SIGNATURES: JTAGID=0x00000000, CHIPID_CIDR=0x89750030, CHIPID_EXID=0x00000085

## Pinouts (pin number, pad)
BGA240: A1 GND, A2 PC8, A3 PC20, A4 PC24, A5 PC28, A6 PC2, A7 PC4, A8 PC6, A9 PC10, A10 PC12, A11 PB17, A12 PB25, A13 D15, A14 D12, A15 NDQS1, A16 GND, B1 MIPI_DN0, B2 MIPI_DP0, B3 PC18, B4 PC22, B5 PC26, B6 PC3, B7 PC5, B8 PC7, B9 PC11, B10 PC13, B11 PB19, B12 PB23, B13 D13, B14 D14, B15 DQS1, B16 D11, C1 MIPI_DN1, C2 MIPI_DP1, C3 GND, C4 PC14, C5 PC16, C6 PC23, C7 GND, C8 PC30, C9 PB15, C10 GND, C11 PB21, C12 PB24, C13 VDDQSPI, C14 GND, C15 DQM1, C16 D8, D1 MIPI_CLKN, D2 MIPI_CLKP, D3 PC0, D4 PC15, D5 VDDCORE, D6 PC9, D7 VDDIOP1, D8 PC29, D9 PB16, D10 VDDLVDS, D11 PB20, D12 PB26, D13 D10, D14 D9, D15 D6, D16 D1, E1 MIPI_DN2, E2 MIPI_DP2, E3 PC21, E4 PC19, E5 VDDCORE, E6 PC25, E7 GND, E8 PC27, E9 PB18, E10 GND, E11 PB22, E12 VDDIOM, E13 D5, E14 D3, E15 D2, E16 D4, F1 MIPI_DN3, F2 MIPI_DP3, F3 PC1, F4 PC17, F5 NRST, F7 VDDCORE, F8 VDDOUT25, F9 PC31, F10 VDDCORE, F12 D7, F13 DQS0, F14 NDQS0, F15 DQM0, F16 DDR_VREF, G1 XIN, G2 XOUT, G3 GND, G4 VDDIN33, G5 GND, G6 VDDMIPI, G11 GND, G12 VDDIOM, G13 GND, G14 D0, G15 A18, G16 SDCKE, H1 HHSDMA, H2 HHSDPA, H3 PA15, H4 TDI, H5 TCK, H6 MIPI_REXT, H8 GND, H9 GND, H11 DDR_CAL, H12 SDWE, H13 RAS, H14 CAS, H15 A15, H16 NCS1, J1 HHSDMB, J2 HHSDPB, J3 PA21, J4 PA18, J5 AUDIO_CLK, J6 SHDN, J8 GND, J9 TST, J11 RESETN, J12 SDA10, J13 SDCKN, J14 SDCK, J15 A14, J16 A17, K1 HHSDMC, K2 HHSDPC, K3 GND, K4 VDDIN33, K5 GNDANA, K6 HHSRTUNE, K11 GND, K12 VDDIOM, K13 GND, K14 A5, K15 A7, K16 A8, L1 PA30, L2 PA27, L3 PA26, L4 PA29, L5 WKUP0, L7 VDDANA, L8 GND, L9 PB11, L10 VDDCORE, L12 A16, L13 A2, L14 A4, L15 A3, L16 A6, M1 PA25, M2 PA31, M3 PA24, M4 PA28, M5 VDDBU, M6 PA20, M7 GND, M8 PA11, M9 PB7, M10 GND, M11 PD11, M12 VDDIOM, M13 A11, M14 A9, M15 A10, M16 A13, N1 ADVREFN, N2 ADVREFP, N3 PA5, N4 VDDBU, N5 PA13, N6 PA16, N7 VDDIOP0, N8 PA1, N9 PB5, N10 VDDIOP2, N11 PB1, N12 PD9, N13 VDDNF, N14 PD5, N15 PD4, N16 PD1, P1 JTAGSEL, P2 TMS, P3 GND, P4 PA9, P5 PA7, P6 PA3, P7 GND, P8 PB9, P9 PB13, P10 GND, P11 PD13, P12 PD7, P13 PD8, P14 GND, P15 PD2, P16 PD3, R1 XOUT32, R2 XIN32, R3 RTCK, R4 PA23, R5 PA17, R6 PA12, R7 PA10, R8 PA4, R9 PB14, R10 PB10, R11 PB6, R12 PB2, R13 PB0, R14 PD10, R15 PD6, R16 PD0, T1 GND, T2 TDO, T3 PA22, T4 PA19, T5 PA14, T6 PA8, T7 PA6, T8 PA2, T9 PA0, T10 PB3, T11 PB12, T12 PB8, T13 PB4, T14 PD12, T15 PD14, T16 GND
BGA256: A1 GND, A2 PC8, A3 PC14, A4 PC18, A5 PC20, A6 PC26, A7 PC2, A8 PC4, A9 PC6, A10 PC10, A11 PC12, A12 PB19, A13 PB25, A14 D15, A15 DQSN1, A16 DQS1, A17 GND, B1 MIPI_DN0, B2 MIPI_DP0, B3 PC0, B4 PC17, B5 PC23, B6 PC28, B7 PC3, B8 PC5, B9 PC7, B10 PC11, B11 PC13, B12 PB21, B13 PB23, B14 D14, B15 D12, B16 D11, B17 DQM1, C1 MIPI_DN1, C2 MIPI_DP1, C3 PC1, C4 PC16, C5 PC22, C6 PC24, C7 PC30, C8 VDDOUT25, C9 PB15, C10 PB17, C11 PB18, C12 VDDQSPI, C13 PB26, C14 D13, C15 D8, C16 D9, C17 D4, D1 MIPI_CLKN, D2 MIPI_CLKP, D3 PC9, D4 VDDMIPI, D5 PC15, D6 VDDCORE, D7 PC21, D8 VDDIOP1, D9 PC31, D10 GND, D11 PB20, D12 PB24, D13 GND, D14 D10, D15 D3, D16 D6, D17 D7, E1 MIPI_DN2, E2 MIPI_DP2, E3 GND, E4 GND, E5 VDDCORE, E6 PC19, E7 PC25, E8 GND, E9 VDDLVDS, E10 GND, E11 PB16, E12 PB22, E13 GND, E14 D5, E15 D0, E16 D2, E17 DQM0, F1 MIPI_DN3, F2 MIPI_DP3, F3 GND, F4 MIPI_REXT, F5 VDDCORE, F13 VDDCORE, F14 VDDCORE, F15 A18, F16 D1, F17 DQSN0, G1 GND, G2 GND, G3 XIN, G4 XOUT, G5 VDDIN33, G7 PC27, G8 PC29, G9 GND, G10 GND, G11 GND, G13 GND, G14 VDDIOM, G15 A16, G16 A17, G17 DQS0, H1 HHSDMA, H2 HHSDPA, H3 GND, H4 GND, H5 GND, H7 SHDN, H11 GND, H13 GND, H14 RESETN, H15 A15, H16 A8, H17 SDCKE, J1 HHSDPB, J2 HHSDMB, J3 GND, J4 VDDOUT25, J5 PA24, J7 TDI, J11 VDDIOM, J13 SDWE, J14 RAS, J15 A7, J16 CAS, J17 NCS1, K1 HHSDPC, K2 HHSDMC, K3 VDDIN33, K4 VDDANA, K5 PA26, K7 PA18, K11 VDDIOM, K13 GND, K14 VDDIOM, K15 A5, K16 A2, K17 DDR_VREF, L1 GND, L2 VDDANA, L3 GND, L4 AUDIO_CLK, L5 PA21, L7 TCK, L8 PA7, L9 GND, L10 VDDCORE, L11 VDDCORE, L13 SDA10, L14 GND, L15 A3, L16 A6, L17 SDCK, M1 VDDANA, M2 HHSRTUNE, M3 GNDANA, M4 PA28, M5 NRST, M13 GND, M14 DDR_CAL, M15 A11, M16 A4, M17 SDCKN, N1 ADVREFP, N2 ADVREFN, N3 PA29, N4 PA25, N5 PA30, N6 TDO, N7 PA11, N8 GND, N9 PA5, N10 PB11, N11 GND, N12 PB1, N13 GND, N14 VDDIOM, N15 A10, N16 A14, N17 A13, P1 JTAGSEL, P2 PA31, P3 PA27, P4 PA23, P5 VDDBU, P6 GND, P7 PA15, P8 PA9, P9 PA1, P10 PB13, P11 PB7, P12 PB5, P13 PD13, P14 PD4, P15 PD0, P16 A9, P17 PD2, R1 TST, R2 TMS, R3 RTCK, R4 PA17, R5 PA16, R6 PA12, R7 PA2, R8 VDDIOP0, R9 GND, R10 PB9, R11 PB3, R12 PB0, R13 PD9, R14 GND, R15 PD6, R16 VDDNF, R17 PD1, T1 XIN32, T2 XOUT32, T3 WKUP0, T4 PA20, T5 PA14, T6 PA10, T7 PA4, T8 PB14, T9 PB10, T10 PB6, T11 VDDIOP2, T12 PB2, T13 PD10, T14 PD11, T15 PD7, T16 GND, T17 PD3, U1 GND, U2 VDDBU, U3 PA22, U4 PA19, U5 PA13, U6 PA8, U7 PA6, U8 PA3, U9 PA0, U10 PB12, U11 PB8, U12 PB4, U13 PD14, U14 PD12, U15 PD8, U16 PD5, U17 GND

## Notices in the file
Copyright (c) 2024 Microchip Technology Inc.
SPDX-License-Identifier: Apache-2.0
Licensed under the Apache License, Version 2.0 (the "License");
you may not use this file except in compliance with the License.
You may obtain a copy of the License at
http://www.apache.org/licenses/LICENSE-2.0
Unless required by applicable law or agreed to in writing, software
distributed under the License is distributed on an "AS IS" BASIS,
WITHOUT WARRANTIES OR CONDITIONS OF ANY KIND, either express or implied.
See the License for the specific language governing permissions and
limitations under the License.
