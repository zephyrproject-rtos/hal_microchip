# ATSAMA5D27WLSOM1 device description
Architecture: CORTEX-A5; Family: SAMA5; Series: SAMA5D2
Parameters: __CA_REV=0x0001 (CA5 Core Revision), __CORTEX_A=5 (Core type number (Cortex-A5)), __FPU_PRESENT=1 (FPU is present on core), __GIC_PRESENT=0 (GIC is present on core), __TIM_PRESENT=0 (Private Timer is present on core), __L2CC_PRESENT=1 (L2C-310 cache controller is present), L2C_310_BASE=0x00A00000 (Base address for L2C-310 cache controller interface)
Programming and debug interfaces: JTAG, SWD
Registers are 32-bit, read-write, no defined reset value unless marked. A register's access mark holds for its fields unless they carry their own. Offsets are from the block's base; lines under a group give offsets from that group; [hi:lo] are bit positions; {n}, {i} and the like mark numbered series; 'fields as' and 'values as' point back to an identical list; <NAME> marks a mode.

## Ordering variants
ATSAMA5D27-WLSOM1: TFBGA361, -40 to 85 C, 1.6 to 3.6 V

## Memory
base space: start 0 size 0x100000000, little endian
  0x10000000 EBI_CS0 size 0x10000000 other, executable
  0x20000000 DDR_CS size 0x20000000 other, executable
  0x40000000 DDR_AES_CS size 0x20000000 other
  0x60000000 EBI_CS1 size 0x10000000 other, executable
  0x70000000 EBI_CS2 size 0x10000000 other, executable
  0x80000000 EBI_CS3 size 0x08000000 other, executable
  0x90000000 QSPI_AES0 size 0x08000000 other
  0x98000000 QSPI_AES1 size 0x08000000 other
  0xA0000000 SDMMC0 size 0x00001000 other, executable
  0xB0000000 SDMMC1 size 0x00001000 other, executable
  0xC0000000 NFC size 0x10000000 other
  0xD0000000 QSPI0MEM size 0x08000000 other, executable
  0xD8000000 QSPI1MEM size 0x08000000 other, executable
  0xF0000000 PERIPHERALS size 0x10000000 io, rw
  0x00000000 IROM size 0x00010000 rom
  0x00040000 ECC_ROM size 0x00018000 other
  0x00100000 NFC_RAM size 0x00002400 other
  0x00200000 SRAM0 size 0x00020000 other, executable
  0x00220000 SRAM1 size 0x00020000 other, executable
  0x00300000 UDPHS_RAM size 0x00100000 other
  0x00400000 UHPHS_OHCI size 0x00100000 other
  0x00500000 UHPHS_EHCI size 0x00100000 other
  0x00600000 AXIMX size 0x00100000 other
  0x00700000 DAP size 0x00100000 other
  0x00800000 PTCMEM size 0x00100000 other
  0xF8044000 SECURAM size 0x00004000 other
  0x00A00000 L2CC size 0x100000 ram, rw, executable

## Peripheral instances (address, pins/pin function, parameters)
ACC at 0xF804A000
  parameters: INSTANCE_ID=75, HAS_INVERTED_COMPARATOR=1
ADC at 0xFC030000
  pins: ADTRG PD31/A; AD{n} PD{n+19}/X1 (n=0..11)
  parameters: INSTANCE_ID=40, CLOCK_ID=40, DMAC_ID_RX=25
AES at 0xF002C000
  parameters: INSTANCE_ID=9, CLOCK_ID=9, DMAC_ID_TX=26, DMAC_ID_RX=27
AESB at 0xF001C000
  parameters: INSTANCE_ID=10, CLOCK_ID=10
AIC at 0xFC020000
  pins: IRQ PA12/B or PA21/A or PB3/C or PD31/C
  parameters: INSTANCE_ID=62, ID_AIC_IRQ=49
SAIC at 0xF803C000 (AIC)
  pins: FIQ PB4/C or PC8/C or PC9/A or PD3/B
  parameters: INSTANCE_ID=61, ID_SAIC_FIQ=0
AXIMX at 0x00600000
CHIPID at 0xFC069000
  parameters: INSTANCE_ID=78
CLASSD at 0xFC048000
  pins: CLASSD_L0 PA28/F; CLASSD_L1 PA29/F; CLASSD_L2 PA30/F; CLASSD_L3 PA31/F; CLASSD_R0 PB1/F; CLASSD_R1 PB2/F; CLASSD_R2 PB3/F; CLASSD_R3 PB4/F
  parameters: INSTANCE_ID=59, CLOCK_ID=59, DMAC_ID_TX=47
FLEXCOM0 at 0xF8034000 (FLEXCOM)
  pins: FLEXCOM0_IO0 PB28/C; FLEXCOM0_IO1 PB29/C; FLEXCOM0_IO2 PB30/C; FLEXCOM0_IO3 PB31/C; FLEXCOM0_IO4 PC0/C
  parameters: INSTANCE_ID=19, CLOCK_ID=19, DMAC_ID_TX=11, DMAC_ID_RX=12, USART_FIFO_SIZE=32, SPI_FIFO_SIZE=32, TWI_FIFO_SIZE=16
FLEXCOM1 at 0xF8038000 (FLEXCOM)
  pins: FLEXCOM1_IO0 PA24/A; FLEXCOM1_IO1 PA23/A; FLEXCOM1_IO2 PA22/A; FLEXCOM1_IO3 PA25/A; FLEXCOM1_IO4 PA26/A
  parameters: INSTANCE_ID=20, CLOCK_ID=20, DMAC_ID_TX=13, DMAC_ID_RX=14, USART_FIFO_SIZE=32, SPI_FIFO_SIZE=32, TWI_FIFO_SIZE=16
FLEXCOM2 at 0xFC010000 (FLEXCOM)
  pins: FLEXCOM2_IO0 PA6/E or PD26/C; FLEXCOM2_IO1 PA7/E or PD27/C; FLEXCOM2_IO2 PA8/E or PD28/C; FLEXCOM2_IO3 PA9/E or PD29/C; FLEXCOM2_IO4 PA10/E or PD30/C
  parameters: INSTANCE_ID=21, CLOCK_ID=21, DMAC_ID_TX=15, DMAC_ID_RX=16, USART_FIFO_SIZE=32, SPI_FIFO_SIZE=32, TWI_FIFO_SIZE=16
FLEXCOM3 at 0xFC014000 (FLEXCOM)
  pins: FLEXCOM3_IO0 PA15/E or PB23/E or PC20/E; FLEXCOM3_IO1 PA13/E or PB22/E or PC19/E; FLEXCOM3_IO2 PA14/E or PB21/E or PC18/E; FLEXCOM3_IO3 PA16/E or PB24/E or PC21/E; FLEXCOM3_IO4 PA17/E or PB25/E or PC22/E
  parameters: INSTANCE_ID=22, CLOCK_ID=22, DMAC_ID_TX=17, DMAC_ID_RX=18, USART_FIFO_SIZE=32, SPI_FIFO_SIZE=32, TWI_FIFO_SIZE=16
FLEXCOM4 at 0xFC018000 (FLEXCOM)
  pins: FLEXCOM4_IO0 PC28/B or PD12/B or PD21/C; FLEXCOM4_IO1 PC29/B or PD13/B or PD22/C; FLEXCOM4_IO2 PC30/B or PD14/B or PD23/C; FLEXCOM4_IO3 PC31/B or PD15/B or PD24/C; FLEXCOM4_IO4 PD0/B or PD16/B or PD25/C
  parameters: INSTANCE_ID=23, CLOCK_ID=23, DMAC_ID_TX=19, DMAC_ID_RX=20, USART_FIFO_SIZE=32, SPI_FIFO_SIZE=32, TWI_FIFO_SIZE=16
GMAC at 0xF8008000
  pins: GCOL PB9/F or PC23/B or PD4/D; GCRS PB8/F or PC22/B or PD3/D; GMDC PB22/F or PC18/B or PD17/D; GMDIO PB23/F or PC19/B or PD18/D; GRXCK PB7/F or PC20/B or PD1/D; GRXDV PB16/F or PC12/B or PD11/D; GRXER PB17/F or PC13/B or PD12/D; GRX0 PB18/F or PC14/B or PD13/D; GRX1 PB19/F or PC15/B or PD14/D; GRX2 PB10/F or PC24/B or PD5/D; GRX3 PB11/F or PC25/B or PD6/D; GTSUCOMP PB5/F or PC9/B or PD0/D; GTXCK PB14/F or PC10/B or PD9/D; GTXEN PB15/F or PC11/B or PD10/D; GTXER PB6/F or PC21/B or PD2/D; GTX0 PB20/F or PC16/B or PD15/D; GTX1 PB21/F or PC17/B or PD16/D; GTX2 PB12/F or PC26/B or PD7/D; GTX3 PB13/F or PC27/B or PD8/D
  parameters: INSTANCE_ID=5, CLOCK_ID=5
I2SC0 at 0xF8050000 (I2SC)
  pins: I2SC0_CK PC1/E or PD19/E; I2SC0_DI0 PC4/E or PD22/E; I2SC0_DO0 PC5/E or PD23/E; I2SC0_MCK PC2/E or PD20/E; I2SC0_WS PC3/E or PD21/E
  parameters: INSTANCE_ID=54, CLOCK_ID=54, DMAC_ID_TX=31, DMAC_ID_RX=32
I2SC1 at 0xFC04C000 (I2SC)
  pins: I2SC1_CK PA15/D or PB15/D; I2SC1_DI0 PA17/D or PB17/D; I2SC1_DO0 PA18/D or PB18/D; I2SC1_MCK PA14/D or PB14/D; I2SC1_WS PA16/D or PB16/D
  parameters: INSTANCE_ID=55, CLOCK_ID=55, DMAC_ID_TX=33, DMAC_ID_RX=34
ICE
  pins: TDI PA23/C or PD7/A or PD15/A or PD28/B; TDO PA24/C or PD8/A or PD16/A or PD29/B; TMS PA25/C or PD9/A or PD17/A or PD30/B; TCK PA22/C or PD6/A or PD14/A or PD27/B; NTRST PA26/C or PD10/A or PD18/A or PD31/B
ICM at 0xF8040000
  parameters: INSTANCE_ID=8, CLOCK_ID=8
ISC at 0xF0008000
  pins: ISC_D0 PB26/F or PC9/C or PD7/E; ISC_D1 PB27/F or PC10/C or PD8/E; ISC_D2 PB28/F or PC11/C or PD9/E; ISC_D3 PB29/F or PC12/C or PD10/E; ISC_D4 PB30/F or PC13/C or PD11/E or PD12/F; ISC_D5 PB31/F or PC14/C or PD12/E or PD13/F; ISC_D6 PC0/F or PC15/C or PD13/E or PD14/F; ISC_D7 PC1/F or PC16/C or PD14/E or PD15/F; ISC_D8 PC2/F or PC17/C or PD6/E or PD16/F; ISC_D9 PC3/F or PC18/C or PD5/E or PD17/F; ISC_D10 PB24/F or PC19/C or PD4/E or PD18/F; ISC_D11 PB25/F or PC20/C or PD3/E or PD19/F; ISC_FIELD PC8/F or PC25/C or PD18/E or PD23/F; ISC_HSYNC PC6/F or PC23/C or PD17/E or PD22/F; ISC_MCK PC7/F or PC24/C or PD2/E or PD11/F; ISC_PCK PC4/F or PC21/C or PD15/E or PD20/F; ISC_VSYNC PC5/F or PC22/C or PD16/E or PD21/F
  parameters: INSTANCE_ID=46, CLOCK_ID=46
L2CC at 0x00A00000
  parameters: INSTANCE_ID=63
LCDC at 0xF0000000
  pins: LCDDAT0 PB11/A; LCDDAT1 PB12/A; LCDDAT2 PB13/A or PC10/A; LCDDAT3 PB14/A or PC11/A; LCDDAT4 PB15/A or PC12/A; LCDDAT5 PB16/A or PC13/A; LCDDAT6 PB17/A or PC14/A; LCDDAT7 PB18/A or PC15/A; LCDDAT8 PB19/A; LCDDAT9 PB20/A; LCDDAT10 PB21/A or PC16/A; LCDDAT11 PB22/A or PC17/A; LCDDAT12 PB23/A or PC18/A; LCDDAT13 PB24/A or PC19/A; LCDDAT14 PB25/A or PC20/A; LCDDAT15 PB26/A or PC21/A; LCDDAT16 PB27/A; LCDDAT17 PB28/A; LCDDAT18 PB29/A or PC22/A; LCDDAT19 PB30/A or PC23/A; LCDDAT20 PB31/A or PC24/A; LCDDAT21 PC0/A or PC25/A; LCDDAT22 PC1/A or PC26/A; LCDDAT23 PC2/A or PC27/A; LCDDEN PC8/A or PD1/A; LCDDISP PC4/A or PC29/A; LCDHSYNC PC6/A or PC31/A; LCDPCK PC7/A or PD0/A; LCDPWM PC3/A or PC28/A; LCDVSYNC PC5/A or PC30/A
  parameters: INSTANCE_ID=45, CLOCK_ID=45
MATRIX0 at 0xF0018000 (MATRIX)
  parameters: INSTANCE_ID=15, CLOCK_ID=15
MATRIX1 at 0xFC03C000 (MATRIX)
  parameters: INSTANCE_ID=14, CLOCK_ID=14
MCAN0 at 0xF8054000 (MCAN)
  pins: CANRX0 PC2/C or PC11/E; CANTX0 PC1/C or PC10/E
  parameters: INSTANCE_ID=56, CLOCK_ID=56, ID_MCAN0_INT0=56, ID_MCAN0_INT1=64
MCAN1 at 0xFC050000 (MCAN)
  pins: CANRX1 PC27/D; CANTX1 PC26/D
  parameters: INSTANCE_ID=57, CLOCK_ID=57, ID_MCAN1_INT0=57, ID_MCAN1_INT1=65
MPDDRC at 0xF000C000
  parameters: INSTANCE_ID=13, CLOCK_ID=13
PDMIC at 0xF8018000
  pins: PDMIC_CLK PB12/D or PB27/D; PDMIC_DAT PB11/D or PB26/D
  parameters: INSTANCE_ID=48, CLOCK_ID=48, DMAC_ID_RX=50
PIO at 0xFC038000
  pins: P{n} PA{n} (n=0..31); P{n} PB{n-32} (n=32..63); P{n} PC{n-64} (n=64..95); P{n} PD{n-96} (n=96..127)
  parameters: CLOCK_ID=18
PIOA
  parameters: INSTANCE_ID=18
PIOB
  parameters: INSTANCE_ID=68
PIOC
  parameters: INSTANCE_ID=69
PIOD
  parameters: INSTANCE_ID=70
PIT at 0xF8048030
  parameters: INSTANCE_ID=3
PMC at 0xF0014000
  pins: PCK0 PC8/D or PD19/A or PD31/E; PCK1 PB13/C or PB20/E or PC27/C or PD6/B; PCK2 PA21/B or PC28/C or PD11/B
PTC at 0xFC060000
  pins: PTC_X{n} PD{n+3}/X1 (n=0..7); PTC_Y{n} PD{n+11}/X1 (n=0..7)
  parameters: INSTANCE_ID=58, CLOCK_ID=58
PWM at 0xF802C000
  pins: PWMEXTRG1 PB3/D; PWMEXTRG2 PB10/C; PWMFI0 PB2/D; PWMFI1 PB9/C; PWMH0 PA30/D; PWMH1 PB0/D; PWMH2 PB5/C; PWMH3 PB7/C; PWML0 PA31/D; PWML1 PB1/D; PWML2 PB6/C; PWML3 PB8/C
  parameters: INSTANCE_ID=38, CLOCK_ID=38, DMAC_ID_TX=10, FAULT_PWM_ID0=0x0 (Fault 0 - PWM0_PWMFI0 Input pin), FAULT_PWM_ID1=0x1 (Fault 1 - PWM0_PWMFI1 Input pin), FAULT_PWM_ID2=0x2 (Fault 2 - MAIN_OSC_PMC), FAULT_PWM_ID3=0x3 (Fault 3 - ADC), FAULT_PWM_ID4=0x4 (Fault 4 - TIMER0), FAULT_PWM_ID5=0x5 (Fault 5 - TIMER1)
QSPI0 at 0xF0020000 (QSPI)
  pins: QSPI0_CS PA1/B or PA15/C or PA23/F; QSPI0_IO0 PA2/B or PA16/C or PA24/F; QSPI0_IO1 PA3/B or PA17/C or PA25/F; QSPI0_IO2 PA4/B or PA18/C or PA26/F; QSPI0_IO3 PA5/B or PA19/C or PA27/F; QSPI0_SCK PA0/B or PA14/C or PA22/F
  parameters: INSTANCE_ID=52, CLOCK_ID=52, DMAC_ID_TX=4, DMAC_ID_RX=5
QSPI1 at 0xF0024000 (QSPI)
  pins: QSPI1_CS PA11/B or PB6/D or PB15/E; QSPI1_IO0 PA7/B or PB7/D or PB16/E; QSPI1_IO1 PA8/B or PB8/D or PB17/E; QSPI1_IO2 PA9/B or PB9/D or PB18/E; QSPI1_IO3 PA10/B or PB10/D or PB19/E; QSPI1_SCK PA6/B or PB5/D or PB14/E
  parameters: INSTANCE_ID=53, CLOCK_ID=53, DMAC_ID_TX=48, DMAC_ID_RX=49
RSTC at 0xF8048000
RTC at 0xF80480B0
RXLP at 0xF8049000
  parameters: INSTANCE_ID=76
SCKC at 0xF8048050
SDMMC0 at 0xA0000000 (SDMMC)
  pins: SDMMC0_CD PA13/A; SDMMC0_CK PA0/A; SDMMC0_CMD PA1/A; SDMMC0_DAT{n} PA{n+2}/A (n=0..7); SDMMC0_RSTN PA10/A; SDMMC0_WP PA12/A; SDMMC0_1V8SEL PA11/A
  parameters: INSTANCE_ID=31, CLOCK_ID=31
SDMMC1 at 0xB0000000 (SDMMC)
  pins: SDMMC1_CD PA30/E; SDMMC1_CK PA22/E; SDMMC1_CMD PA28/E; SDMMC1_DAT0 PA18/E; SDMMC1_DAT1 PA19/E; SDMMC1_DAT2 PA20/E; SDMMC1_DAT3 PA21/E; SDMMC1_RSTN PA27/E; SDMMC1_WP PA29/E
  parameters: INSTANCE_ID=32, CLOCK_ID=32
SECUMOD at 0xFC040000
  parameters: INSTANCE_ID=16, CLOCK_ID=16
SFC at 0xF804C000
  parameters: INSTANCE_ID=50, CLOCK_ID=50
SFR at 0xF8030000
  parameters: INSTANCE_ID=60
SFRBU at 0xFC05C000
  parameters: INSTANCE_ID=77
SHA at 0xF0028000
  parameters: INSTANCE_ID=12, CLOCK_ID=12, DMAC_ID_TX=30
SHDWC at 0xF8048010
HSMC at 0xF8014000 (SMC)
  pins: NCS0 PC5/B or PD4/F; NCS1 PD5/F; NCS2 PC7/B or PD6/F; NCS3 PA9/F or PA31/B; NANDOE PA12/F or PB2/B; NANDNWE PA8/F or PA30/B; A0 PB11/B or PC11/F; NWR1 PC4/B or PD7/F; A{n} PB{n+11}/B or PC{n+11}/C (n=1..20); A23 PC0/B or PD0/C; A24 PC1/B or PD1/C; A25 PC2/B or PD2/C; D{n} PA{n}/F or PA{n+22}/B (n=0..7); D{n} PA{n+5}/F or PB{n-5}/B (n=8..15); NWAIT PC3/B or PD3/F; NANDRDY PA21/F or PC8/B or PD8/F; A21 PA10/F or PB0/B; A22 PA11/F or PB1/B
  parameters: INSTANCE_ID=17, CLOCK_ID=17
SPI0 at 0xF8000000 (SPI)
  pins: SPI0_MISO PA16/A or PA31/C; SPI0_MOSI PA15/A or PB0/C; SPI0_NPCS0 PA17/A or PA30/C; SPI0_NPCS1 PA18/A or PA29/C; SPI0_NPCS2 PA19/A or PA27/C; SPI0_NPCS3 PA20/A or PA28/C; SPI0_SPCK PA14/A or PB1/C
  parameters: INSTANCE_ID=33, CLOCK_ID=33, DMAC_ID_TX=6, DMAC_ID_RX=7
SPI1 at 0xFC000000 (SPI)
  pins: SPI1_MISO PA24/D or PC3/D or PD27/A; SPI1_MOSI PA23/D or PC2/D or PD26/A; SPI1_NPCS0 PA25/D or PC4/D or PD28/A; SPI1_NPCS1 PA26/D or PC5/D or PD29/A; SPI1_NPCS2 PA27/D or PC6/D or PD30/A; SPI1_NPCS3 PA28/D or PC7/D; SPI1_SPCK PA22/D or PC1/D or PD25/A
  parameters: INSTANCE_ID=34, CLOCK_ID=34, DMAC_ID_TX=8, DMAC_ID_RX=9
SSC0 at 0xF8004000 (SSC)
  pins: RD0 PB23/C or PC15/E; RF0 PB25/C or PC17/E; RK0 PB24/C or PC16/E; TD0 PB22/C or PC14/E; TF0 PB21/C or PC13/E; TK0 PB20/C or PC12/E
  parameters: INSTANCE_ID=43, CLOCK_ID=43, DMAC_ID_TX=21, DMAC_ID_RX=22
SSC1 at 0xFC004000 (SSC)
  pins: RD1 PA17/B or PB17/C; RF1 PA19/B or PB19/C; RK1 PA18/B or PB18/C; TD1 PA16/B or PB16/C; TF1 PA15/B or PB15/C; TK1 PA14/B or PB14/C
  parameters: INSTANCE_ID=44, CLOCK_ID=44, DMAC_ID_TX=23, DMAC_ID_RX=24
SYSCWP at 0xF8048194
TC0 at 0xF800C000 (TC)
  pins: TCLK0 PA21/D; TCLK1 PA29/A or PC5/C or PD13/A; TCLK2 PB5/A or PB24/D or PD22/A; TIOA0 PA19/D; TIOA1 PA27/A or PC3/C or PD11/A; TIOA2 PB6/A or PB22/D or PD20/A; TIOB0 PA20/D; TIOB1 PA28/A or PC4/C or PD12/A; TIOB2 PB7/A or PB23/D or PD21/A
  parameters: INSTANCE_ID=35, CLOCK_ID=35, DMAC_ID_RX=45, TCCLKS_=0 (MCK), TCCLKS_TIMER_CLOCK1=1 (GCLK), TCCLKS_TIMER_CLOCK2=2 (MCK/8), TCCLKS_TIMER_CLOCK3=3 (MCK/32), TCCLKS_TIMER_CLOCK4=4 (MCK/128), TCCLKS_TIMER_CLOCK5=5 (SLCK), TCCLKS_XC0=6 (XC0), TCCLKS_XC1=7 (XC1), TCCLKS_XC2=8 (XC2), NUM_INTERRUPT_LINES=1, TIMER_WIDTH=32
TC1 at 0xF8010000 (TC)
  pins: TCLK3 PB8/A or PB21/D or PD31/D; TCLK4 PA11/D or PC11/D; TCLK5 PA8/D or PB30/D; TIOA3 PB9/A or PB19/D or PD29/D; TIOA4 PA9/D or PC9/D; TIOA5 PA6/D or PB28/D; TIOB3 PB10/A or PB20/D or PD30/D; TIOB4 PA10/D or PC10/D; TIOB5 PA7/D or PB29/D
  parameters: INSTANCE_ID=36, CLOCK_ID=36, DMAC_ID_RX=46, TCCLKS_=0 (MCK), TCCLKS_TIMER_CLOCK1=1 (GCLK), TCCLKS_TIMER_CLOCK2=2 (MCK/8), TCCLKS_TIMER_CLOCK3=3 (MCK/32), TCCLKS_TIMER_CLOCK4=4 (MCK/128), TCCLKS_TIMER_CLOCK5=5 (SLCK), TCCLKS_XC0=6 (XC0), TCCLKS_XC1=7 (XC1), TCCLKS_XC2=8 (XC2), NUM_INTERRUPT_LINES=1, TIMER_WIDTH=32
TDES at 0xFC044000
  parameters: INSTANCE_ID=11, CLOCK_ID=11, DMAC_ID_TX=28, DMAC_ID_RX=29
TRNG at 0xFC01C000
  parameters: INSTANCE_ID=47, CLOCK_ID=47
TWIHS0 at 0xF8028000 (TWIHS)
  pins: TWCK0 PC0/D or PC28/E or PD22/B or PD30/E; TWD0 PB31/D or PC27/E or PD21/B or PD29/E
  parameters: INSTANCE_ID=29, CLOCK_ID=29, DMAC_ID_TX=0, DMAC_ID_RX=1
TWIHS1 at 0xFC028000 (TWIHS)
  pins: TWCK1 PC7/C or PD5/A or PD20/B; TWD1 PC6/C or PD4/A or PD19/B
  parameters: INSTANCE_ID=30, CLOCK_ID=30, DMAC_ID_TX=2, DMAC_ID_RX=3
UART0 at 0xF801C000 (UART)
  pins: URXD0 PB26/C; UTXD0 PB27/C
  parameters: INSTANCE_ID=24, CLOCK_ID=24, DMAC_ID_TX=35, DMAC_ID_RX=36, BRSRCCK_PERIPH_CLK=0 (MCK), BRSRCCK_GCLK=0 (GCLK)
UART1 at 0xF8020000 (UART)
  pins: URXD1 PC7/E or PD2/A; UTXD1 PC8/E or PD3/A
  parameters: INSTANCE_ID=25, CLOCK_ID=25, DMAC_ID_TX=37, DMAC_ID_RX=38, BRSRCCK_PERIPH_CLK=0 (MCK), BRSRCCK_GCLK=0 (GCLK)
UART2 at 0xF8024000 (UART)
  pins: URXD2 PD4/B or PD19/C or PD23/A; UTXD2 PD5/B or PD20/C or PD24/A
  parameters: INSTANCE_ID=26, CLOCK_ID=26, DMAC_ID_TX=39, DMAC_ID_RX=40, BRSRCCK_PERIPH_CLK=0 (MCK), BRSRCCK_GCLK=0 (GCLK)
UART3 at 0xFC008000 (UART)
  pins: URXD3 PB11/C or PC12/D or PC31/C; UTXD3 PB12/C or PC13/D or PD0/C
  parameters: INSTANCE_ID=27, CLOCK_ID=27, DMAC_ID_TX=41, DMAC_ID_RX=42, BRSRCCK_PERIPH_CLK=0 (MCK), BRSRCCK_GCLK=0 (GCLK)
UART4 at 0xFC00C000 (UART)
  pins: URXD4 PB3/A; UTXD4 PB4/A
  parameters: INSTANCE_ID=28, CLOCK_ID=28, DMAC_ID_TX=43, DMAC_ID_RX=44, BRSRCCK_PERIPH_CLK=0 (MCK), BRSRCCK_GCLK=0 (GCLK)
UDPHS at 0xFC02C000
  parameters: INSTANCE_ID=42, CLOCK_ID=42
WDT at 0xF8048040
  parameters: INSTANCE_ID=4
XDMAC0 at 0xF0010000 (XDMAC)
  parameters: INSTANCE_ID=6, CLOCK_ID=6
XDMAC1 at 0xF0004000 (XDMAC)
  parameters: INSTANCE_ID=7, CLOCK_ID=7

## Interrupts
0 SAIC — FIQ Internal Interrupt Request
2 PMU — Internal Performance Monitor Unit
3 PIT — Periodic Interval Timer Interrupt
4 WDT — Watchdog Timer Interrupt
5 GMAC — Ethernet MAC
6 XDMAC0 — DMA Controller 0
7 XDMAC1 — DMA Controller 1
8 ICM — Integritry Check Monitor
9 AES — Advanced Enion Standard
10 AESB — AES Bridge
11 TDES — Triple Data Enion Standard
12 SHA — SHA Signature
13 MPDDRC — MPDDR Controller
14 MATRIX1 — H32MX, 32-bit AHB Matrix
15 MATRIX0 — H64MX, 64-bit AHB Matrix
16 SECUMOD — Secure Module
17 HSMC — Multibit ECC Interrupt
18 PIOA — Parallel I/O Controller
19 FLEXCOM0
20 FLEXCOM1
21 FLEXCOM2
22 FLEXCOM3
23 FLEXCOM4
24 UART0
25 UART1
26 UART2
27 UART3
28 UART4
29 TWIHS0 — Two-Wire Interface 0
30 TWIHS1 — Two-Wire Interface 1
31 SDMMC0 — Secure Data Memory Card Controller 0
32 SDMMC1 — Secure Data Memory Card Controller 1
33 SPI0 — Serial Peripheral Interface 0
34 SPI1 — Serial Peripheral Interface 1
35 TC0 — Timer Counter 0 (ch. 0, 1, 2)
36 TC1 — Timer Counter 1 (ch. 3, 4, 5)
38 PWM — Pulse Width Modulation Controller0 (ch. 0, 1, 2, 3)
40 ADC — Touch Screen ADC Controller
41 UHPHS — USB Host High Speed
42 UDPHS — USB Device High Speed
43 SSC0 — Synchronous Serial Controller 0
44 SSC1 — Synchronous Serial Controller 1
45 LCDC — LCD Controller
46 ISC — Camera Interface
47 TRNG — True Random Number Generator
48 PDMIC — Pulse Density Modulation Interface Controller
49 AIC — IRQ Internal Interrupt Request
50 SFC — Fuse Controller
51 SECURAM — Secured RAM
52 QSPI0
53 QSPI1
54 I2SC0 — Inter-IC Sound Controller 0
55 I2SC1 — Inter-IC Sound Controller 1
56 MCAN0_INT0 (MCAN0) — Internal MCAN 0 Interrupt 0
57 MCAN1_INT0 (MCAN1) — Internal MCAN 1 Interrupt 0
58 PTC — Peripheral Touch Controller
59 CLASSD — Audio Class D amplifier
63 L2CC — L2 Cache Controller
64 MCAN0_INT1 (MCAN0) — Internal MCAN 0 Interrupt 1
65 MCAN1_INT1 (MCAN1) — Internal MCAN 1 Interrupt 1
66 GMAC_Q1 (GMAC) — GMAC Queue 1 Interrupt
67 GMAC_Q2 (GMAC) — GMAC Queue 2 Interrupt
68 PIOB — Parallel I/O Controller
69 PIOC — Parallel I/O Controller
70 PIOD — Parallel I/O Controller
71 SDMMC0_TIMER (SDMMC0) — Secure Digital MultiMedia Card 0 Timer
72 SDMMC1_TIMER (SDMMC1) — Secure Digital MultiMedia Card 1 Timer
74 SYSC (PMC RSTC RTC) — System Controller Interrupt
75 ACC — Analog Comparator
76 RXLP — Uart Low Power

## Properties
SIGNATURES: JTAGID=0x05B3F03F, CHIPID_CIDR=0x8A5C08C2, CHIPID_EXID=0x00000062

## Pinouts (pin number, pad)
TFBGA361: W11 PA0, R9 PA1, W12 PA2, V11 PA3, W14 PA4, V10 PA5, W15 PA6, W16 PA7, V12 PA8, V16 PA9, V14 PA10, L18 PA11, T16 PA12, K18 PA13, R19 PA14, L17 PA15, N19 PA16, M16 PA17, V19 PA18, V15 PA19, T10 PA20, U19 PA21, V17 PA22, U18 PA23, W17 PA24, W18 PA25, U14 PA26, M18 PA27, U13 PA28, U16 PA29, U12 PA30, U17 PA31, C7 PB0, A9 PB1, A10 PB2, A11 PB3, A12 PB4, A7 PB5, B7 PB6, C5 PB7, B8 PB8, B6 PB9, G6 PB10, B5 PB11, A6 PB12, C4 PB13, G4 PB14, H4 PB15, A4 PB16, B3 PB17, D3 PB18, F4 PB19, F2 PB20, F3 PB21, E4 PB22, H2 PB23, A3 PB24, H1 PB25, G2 PB26, H5 PB27, J2 PB28, J3 PB29, A2 PB30, J4 PB31, T14 PC0, R16 PC1, T15 PC2, T13 PC3, P16 PC4, L19 PC5, R15 PC6, N15 PC7, P11 PC8, B2 PC9, K5 PC10, C2 PC11, D2 PC12, K2 PC13, K6 PC14, B1 PC15, K9 PC16, C1 PC17, L9 PC18, D1 PC19, L8 PC20, E3 PC21, E2 PC22, L7 PC23, E1 PC24, L4 PC25, D6 PC26, E7 PC27, J5 PC28, C6 PC29, D7 PC30, C8 PC31, J7 PD0, D8 PD1, J6 PD2, M3 PD3, L6 PD4, L2 PD5, J1 PD6, L5 PD7, K1 PD8, L3 PD9, L1 PD10, N3 PD11, M7 PD12, N2 PD13, M6 PD14, M5 PD15, M1 PD16, M2 PD17, M4 PD18, M8 PD19, N1 PD20, P3 PD21, N6 PD22, P1 PD23, N8 PD24, P8 PD25, P2 PD26, N5 PD27, N4 PD28, R2 PD29, N10 PD30, P7 PD31, M9 ADVREF, G1 VDDANA, H6 VDDANA, F1 GNDANA, G5 GNDANA, M12 DDR_VREF, J10 DDR_VREF, C19 ZQ, E11 VDDIODDR, E8 VDDIODDR, H10 VDDIODDR, J13 VDDIODDR, J8 VDDIODDR, L10 VDDIODDR, P12 VDDIODDR, E10 GNDIODDR, F8 GNDIODDR, G10 GNDIODDR, J9 GNDIODDR, L11 GNDIODDR, M13 GNDIODDR, N12 GNDIODDR, C3 VDDCORE, C9 VDDCORE, K3 VDDCORE, U9 VDDCORE, V5 VDDCORE, W6 VDDCORE, K8 VDDCORE, A1 GNDCORE, D9 GNDCORE, J11 GNDCORE, K4 GNDCORE, K7 GNDCORE, V9 GNDCORE, W1 GNDCORE, B4 VDDIOP0, D5 VDDIOP1, A5 GNDIOP0, D4 GNDIOP0, V13 VDDIOP1, V18 VDDIOP1, P13 GNDIOP1, R13 GNDIOP2, W13 GNDIOP3, W19 GNDIOP4, A8 VDDIOP2, B9 GNDIOP2, T7 VDDSDMMC, T8 GNDSDMMC, G3 VDDISC, H3 GNDISC, U15 VDDFUSE, P9 VDDPLLA, P10 GNDPLLA, R6 VDDAUDIOPLL, N9 GNDDPLL, P6 GNDAUDIOPLL, W2 CLK_AUDIO, W5 XIN, W4 XOUT, R10 VDDOSC, T11 GNDOSC, R8 VDDUTMII, U7 VDDHSIC, R7 GNDUTMII, W7 HHSDPA, V7 HHSDMA, W8 HHSDPB, V8 HHSDMB, W9 HHSDPDATC, W10 HHSDMSTRC, T6 VDDUTMIC, U6 GNDUTMIC, V6 VBG, T2 TST, W3 NRST, T3 JTAGSEL, U2 WKUP, R1 RXD, P4 SHDN, R4 PIOBU0, R5 PIOBU1, R3 PIOBU2, T4 PIOBU3, U3 PIOBU4, T5 PIOBU5, U5 PIOBU6, P5 PIOBU7, V3 VDDBU, U4 GNDBU, U1 XIN32, T1 XOUT32, V1 COMPP, V2 COMPN, A14 DDRM_VSS, A19 DDRM_VSS, B14 DDRM_VSS, B18 DDRM_VSS, C14 DDRM_VSS, C18 DDRM_VSS, D14 DDRM_VSS, D18 DDRM_VSS, E14 DDRM_VSS, E18 DDRM_VSS, F14 DDRM_VSS, F18 DDRM_VSS, G14 DDRM_VSS, G18 DDRM_VSS, H14 DDRM_VSS, H18 DDRM_VSS, N14 DDRM_VSS, N17 DDRM_VSS, N18 DDRM_VSS, P14 DDRM_VSS, P18 DDRM_VSS, R14 DDRM_VSS, R18 DDRM_VSS, T18 DDRM_VSS, B15 DDRM_VDD12, B17 DDRM_VDD13, B19 DDRM_VDD14, D15 DDRM_VDD15, D17 DDRM_VDD16, D19 DDRM_VDD17, F15 DDRM_VDD18, F17 DDRM_VDD19, F19 DDRM_VDD20, H15 DDRM_VDD21, H17 DDRM_VDD22, H19 DDRM_VDD23, K15 DDRM_VDD24, K17 DDRM_VDD25, K19 DDRM_VDD26, M15 DDRM_VDD27, M17 DDRM_VDD28, M19 DDRM_VDD29, P15 DDRM_VDD30, P17 DDRM_VDD31, P19 DDRM_VDD32, T17 DDRM_VDD33, T19 DDRM_VDD34, B11 DDRM_VDD18, B13 DDRM_VDD19, D11 DDRM_VDD20, D13 DDRM_VDD21, K13 DDRM_VDD22, K16 DDRM_VDD23, A13 NC, A15 NC, A16 NC, A17 NC, A18 NC, B10 NC, B12 NC, B16 NC, C10 NC, C11 NC, C12 NC, C13 NC, C15 NC, C16 NC, C17 NC, D10 NC, D12 NC, D16 NC, E12 NC, E13 NC, E15 NC, E16 NC, E17 NC, E19 NC, E5 NC, E6 NC, E9 NC, F10 NC, F11 NC, F12 NC, F13 NC, F16 NC, F5 NC, F6 NC, F7 NC, F9 NC, G11 NC, G12 NC, G13 NC, G15 NC, G16 NC, G17 NC, G19 NC, G7 NC, G8 NC, G9 NC, H11 NC, H12 NC, H13 NC, H16 NC, H7 NC, H8 NC, H9 NC, J12 NC, J14 NC, J15 NC, J16 NC, J17 NC, J18 NC, J19 NC, K10 NC, K11 NC, K12 NC, K14 NC, L12 NC, L13 NC, L14 NC, L15 NC, L16 NC, M10 NC, M11 NC, M14 NC, N11 NC, N13 NC, N16 NC, N7 NC, R11 NC, R12 NC, R17 NC, T12 NC, T9 NC, U10 NC, U11 NC, U8 NC, V4 NC

## Notices in the file
Copyright (c) 2020 Microchip Technology Inc.
SPDX-License-Identifier: Apache-2.0
Licensed under the Apache License, Version 2.0 (the "License");
you may not use this file except in compliance with the License.
You may obtain a copy of the License at
http://www.apache.org/licenses/LICENSE-2.0
Unless required by applicable law or agreed to in writing, software
distributed under the License is distributed on an "AS IS" BASIS,
WITHOUT WARRANTIES OR CONDITIONS OF ANY KIND, either express or implied.
See the License for the specific language governing permissions and
limitations under the License.
