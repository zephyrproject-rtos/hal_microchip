# PIC32CX2051BZ62132 device description
Architecture: CORTEX-M4; Family: PIC32CX; Series: PIC32CXBZ62

## Peripheral instances (address, pins/pin function, parameters) (continued)
PPS at 0x44001000
  pins: RPA{n} PA{n} (n=0..15); RPB{n} PB{n} (n=0..15); RPC0 PC0; RPC1 PC1; RPC7 PC7; RPC8 PC8; RPC9 PC9; RPC10 PC10; RPC11 PC11; RPD{n} PD{n} (n=0..7); RPE0 PE0; RPE1 PE1; RPE2 PE2; RPE3 PE3; RPE4 PE4; RPE5 PE5; RPE6 PE6
  parameters: PB_ADDRL=0x1000, PB_ADDRH=0x14FF
QEI at 0x44005000
  pins: HOME0 PA00/1 set 1 or PA06/2 set 1 or PA11/3 set 1 or PB00/4 set 1 or PB06/5 set 1 or PB11/6 set 1 or PC00/7 set 1 or PD06/8 set 1 or PE00/9 set 1 or PE06/10 set 1 or PB01/11 set 1 or PC09/12 set 1 or PD03/13 set 1 or PE04/14 set 1 or PA03/15 set 1 or PA07/16 set 1 or PB04/17 set 1 or PB08/18 set 1 or PB12/19 set 1 or PA02/20 set 1 or PA10/21 set 1 or PA14/22 set 1 or PB03/23 set 1 or PB07/24 set 1 or PA09/25 set 1 or PA01/1 set 2 or PA07/2 set 2 or PA12/3 set 2 or PB01/4 set 2 or PB07/5 set 2 or PC01/6 set 2 or PC07/7 set 2 or PD07/8 set 2 or PE01/9 set 2 or PA03/10 set 2 or PB02/11 set 2 or PC00/12 set 2 or PD04/13 set 2 or PE06/14 set 2 or PA04/15 set 2 or PA08/16 set 2 or PB12/17 set 2 or PB05/18 set 2 or PB09/19 set 2 or PB13/20 set 2 or PB00/21 set 2 or PB04/22 set 2 or PB08/23 set 2 or PA00/24 set 2 or PA11/25 set 2; INDX0 PA01/1 set 2 or PA07/2 set 2 or PA12/3 set 2 or PB01/4 set 2 or PB07/5 set 2 or PC01/6 set 2 or PC07/7 set 2 or PD07/8 set 2 or PE01/9 set 2 or PA03/10 set 2 or PB02/11 set 2 or PC00/12 set 2 or PD04/13 set 2 or PE06/14 set 2 or PA04/15 set 2 or PA08/16 set 2 or PB12/17 set 2 or PB05/18 set 2 or PB09/19 set 2 or PB13/20 set 2 or PB00/21 set 2 or PB04/22 set 2 or PB08/23 set 2 or PA00/24 set 2 or PA11/25 set 2 or PA02/1 set 3 or PA08/2 set 3 or PA13/3 set 3 or PB02/4 set 3 or PB08/5 set 3 or PB13/6 set 3 or PC08/7 set 3 or PD02/8 set 3 or PE02/9 set 3 or PA04/10 set 3 or PB03/11 set 3 or PC01/12 set 3 or PD06/13 set 3 or PE00/14 set 3 or PA05/15 set 3 or PA09/16 set 3 or PB06/17 set 3 or PB10/18 set 3 or PA00/19 set 3 or PB01/20 set 3 or PB05/21 set 3 or PB09/22 set 3 or PA01/23 set 3 or PA12/24 set 3; QEA0 PA02/1 set 3 or PA08/2 set 3 or PA13/3 set 3 or PB02/4 set 3 or PB08/5 set 3 or PB13/6 set 3 or PC08/7 set 3 or PD02/8 set 3 or PE02/9 set 3 or PA04/10 set 3 or PB03/11 set 3 or PC01/12 set 3 or PD06/13 set 3 or PE00/14 set 3 or PA05/15 set 3 or PA09/16 set 3 or PB06/17 set 3 or PB10/18 set 3 or PA00/19 set 3 or PB01/20 set 3 or PB05/21 set 3 or PB09/22 set 3 or PA01/23 set 3 or PA12/24 set 3 or PA03/1 set 4 or PA09/2 set 4 or PA14/3 set 4 or PB03/4 set 4 or PC09/5 set 4 or PD03/6 set 4 or PE03/7 set 4 or PA00/8 set 4 or PB04/9 set 4 or PC07/10 set 4 or PD07/11 set 4 or PE01/12 set 4 or PA06/13 set 4 or PA10/14 set 4 or PB07/15 set 4 or PB11/16 set 4 or PA01/17 set 4 or PA05/18 set 4 or PA13/19 set 4 or PB02/20 set 4 or PB06/21 set 4 or PB10/22 set 4 or PA08/23 set 4 or PA02/24 set 4; QEB0 PA03/1 set 4 or PA09/2 set 4 or PA14/3 set 4 or PB03/4 set 4 or PC09/5 set 4 or PD03/6 set 4 or PE03/7 set 4 or PA00/8 set 4 or PB04/9 set 4 or PC07/10 set 4 or PD07/11 set 4 or PE01/12 set 4 or PA06/13 set 4 or PA10/14 set 4 or PB07/15 set 4 or PB11/16 set 4 or PA01/17 set 4 or PA05/18 set 4 or PA13/19 set 4 or PB02/20 set 4 or PB06/21 set 4 or PB10/22 set 4 or PA08/23 set 4 or PA02/24 set 4 or PA04/1 set 5 or PA10/2 set 5 or PB04/3 set 5 or PB10/4 set 5 or PD04/5 set 5 or PE04/6 set 5 or PA01/7 set 5 or PB00/8 set 5 or PC08/9 set 5 or PD02/10 set 5 or PE02/11 set 5 or PC10/12 set 5 or PC11/13 set 5 or PA15/14 set 5 or PB14/15 set 5 or PB15/16 set 5 or PD00/17 set 5 or PD01/18 set 5; CCMP0 PA00/31 set 1 or PA02/31 set 1 or PA03/31 set 1 or PA06/31 set 1 or PA07/31 set 1 or PA09/31 set 1 or PA10/31 set 1 or PA11/31 set 1 or PA14/31 set 1 or PB00/31 set 1 or PB01/31 set 1 or PB03/31 set 1 or PB04/31 set 1 or PB06/31 set 1 or PB07/31 set 1 or PB08/31 set 1 or PB11/31 set 1 or PB12/31 set 1 or PC00/31 set 1 or PC09/31 set 1 or PD03/31 set 1 or PD06/31 set 1 or PE00/31 set 1 or PE04/31 set 1 or PE06/31 set 1 or PA01/13 set 5 or PA04/13 set 5 or PA10/13 set 5 or PA15/13 set 5 or PB00/13 set 5 or PB04/13 set 5 or PB10/13 set 5 or PB14/13 set 5 or PB15/13 set 5 or PC08/13 set 5 or PC10/13 set 5 or PC11/13 set 5 or PD00/13 set 5 or PD01/13 set 5 or PD02/13 set 5 or PD04/13 set 5 or PE02/13 set 5 or PE04/13 set 5
  parameters: UPB_ADDRL=0x500, SET_CLR_INV_PRESENT=1 (Present)
QSPI at 0x42000000
  pins: CS PB13/SQI or PA00/27 set 1 or PA02/27 set 1 or PA03/27 set 1 or PA06/27 set 1 or PA07/27 set 1 or PA09/27 set 1 or PA10/27 set 1 or PA11/27 set 1 or PA14/27 set 1 or PB00/27 set 1 or PB01/27 set 1 or PB03/27 set 1 or PB04/27 set 1 or PB06/27 set 1 or PB07/27 set 1 or PB08/27 set 1 or PB11/27 set 1 or PB12/27 set 1 or PC00/27 set 1 or PC09/27 set 1 or PD03/27 set 1 or PD06/27 set 1 or PE00/27 set 1 or PE04/27 set 1 or PE06/27 set 1 or PA00/34 set 2 or PA01/34 set 2 or PA03/34 set 2 or PA04/34 set 2 or PA07/34 set 2 or PA08/34 set 2 or PA11/34 set 2 or PA12/34 set 2 or PB00/34 set 2 or PB01/34 set 2 or PB02/34 set 2 or PB04/34 set 2 or PB05/34 set 2 or PB07/34 set 2 or PB08/34 set 2 or PB09/34 set 2 or PB12/34 set 2 or PB13/34 set 2 or PC00/34 set 2 or PC01/34 set 2 or PC07/34 set 2 or PD04/34 set 2 or PD07/34 set 2 or PE01/34 set 2 or PE06/34 set 2 or PA00/34 set 3 or PA01/34 set 3 or PA02/34 set 3 or PA04/34 set 3 or PA05/34 set 3 or PA08/34 set 3 or PA09/34 set 3 or PA12/34 set 3 or PA13/34 set 3 or PB01/34 set 3 or PB02/34 set 3 or PB03/34 set 3 or PB05/34 set 3 or PB06/34 set 3 or PB08/34 set 3 or PB09/34 set 3 or PB10/34 set 3 or PB13/34 set 3 or PC01/34 set 3 or PC08/34 set 3 or PD02/34 set 3 or PD06/34 set 3 or PE00/34 set 3 or PE02/34 set 3 or PA00/30 set 4 or PA01/30 set 4 or PA02/30 set 4 or PA03/30 set 4 or PA05/30 set 4 or PA06/30 set 4 or PA08/30 set 4 or PA09/30 set 4 or PA10/30 set 4 or PA13/30 set 4 or PA14/30 set 4 or PB02/30 set 4 or PB03/30 set 4 or PB04/30 set 4 or PB06/30 set 4 or PB07/30 set 4 or PB10/30 set 4 or PB11/30 set 4 or PC07/30 set 4 or PC09/30 set 4 or PD03/30 set 4 or PD07/30 set 4 or PE01/30 set 4 or PE03/30 set 4 or PA01/12 set 5 or PA04/12 set 5 or PA10/12 set 5 or PA15/12 set 5 or PB00/12 set 5 or PB04/12 set 5 or PB10/12 set 5 or PB14/12 set 5 or PB15/12 set 5 or PC08/12 set 5 or PC10/12 set 5 or PC11/12 set 5 or PD00/12 set 5 or PD01/12 set 5 or PD02/12 set 5 or PD04/12 set 5 or PE02/12 set 5 or PE04/12 set 5; DATA0 PA0/SQI; DATA1 PB12/SQI; DATA2 PB11/SQI; DATA3 PA2/SQI; SCK PA1/SQI or PA03/7 set 6 or PA05/7 set 6 or PA06/7 set 6 or PA07/7 set 6 or PB05/7 set 6 or PB06/7 set 6 or PB08/7 set 6 or PB09/7 set 6 or PD05/7 set 6 or PE05/7 set 6; DATA_OUT0 PA00/35 set 2 or PA01/35 set 2 or PA03/35 set 2 or PA04/35 set 2 or PA07/35 set 2 or PA08/35 set 2 or PA11/35 set 2 or PA12/35 set 2 or PB00/35 set 2 or PB01/35 set 2 or PB02/35 set 2 or PB04/35 set 2 or PB05/35 set 2 or PB07/35 set 2 or PB08/35 set 2 or PB09/35 set 2 or PB12/35 set 2 or PB13/35 set 2 or PC00/35 set 2 or PC01/35 set 2 or PC07/35 set 2 or PD04/35 set 2 or PD07/35 set 2 or PE01/35 set 2 or PE06/35 set 2 or PA00/36 set 3 or PA01/36 set 3 or PA02/36 set 3 or PA04/36 set 3 or PA05/36 set 3 or PA08/36 set 3 or PA09/36 set 3 or PA12/36 set 3 or PA13/36 set 3 or PB01/36 set 3 or PB02/36 set 3 or PB03/36 set 3 or PB05/36 set 3 or PB06/36 set 3 or PB08/36 set 3 or PB09/36 set 3 or PB10/36 set 3 or PB13/36 set 3 or PC01/36 set 3 or PC08/36 set 3 or PD02/36 set 3 or PD06/36 set 3 or PE00/36 set 3 or PE02/36 set 3 or PA00/33 set 4 or PA01/33 set 4 or PA02/33 set 4 or PA03/33 set 4 or PA05/33 set 4 or PA06/33 set 4 or PA08/33 set 4 or PA09/33 set 4 or PA10/33 set 4 or PA13/33 set 4 or PA14/33 set 4 or PB02/33 set 4 or PB03/33 set 4 or PB04/33 set 4 or PB06/33 set 4 or PB07/33 set 4 or PB10/33 set 4 or PB11/33 set 4 or PC07/33 set 4 or PC09/33 set 4 or PD03/33 set 4 or PD07/33 set 4 or PE01/33 set 4 or PE03/33 set 4; DATA_IN0 PA03/1 set 4 or PA09/2 set 4 or PA14/3 set 4 or PB03/4 set 4 or PC09/5 set 4 or PD03/6 set 4 or PE03/7 set 4 or PA00/8 set 4 or PB04/9 set 4 or PC07/10 set 4 or PD07/11 set 4 or PE01/12 set 4 or PA06/13 set 4 or PA10/14 set 4 or PB07/15 set 4 or PB11/16 set 4 or PA01/17 set 4 or PA05/18 set 4 or PA13/19 set 4 or PB02/20 set 4 or PB06/21 set 4 or PB10/22 set 4 or PA08/23 set 4 or PA02/24 set 4; DATA_IN1 PA00/1 set 1 or PA06/2 set 1 or PA11/3 set 1 or PB00/4 set 1 or PB06/5 set 1 or PB11/6 set 1 or PC00/7 set 1 or PD06/8 set 1 or PE00/9 set 1 or PE06/10 set 1 or PB01/11 set 1 or PC09/12 set 1 or PD03/13 set 1 or PE04/14 set 1 or PA03/15 set 1 or PA07/16 set 1 or PB04/17 set 1 or PB08/18 set 1 or PB12/19 set 1 or PA02/20 set 1 or PA10/21 set 1 or PA14/22 set 1 or PB03/23 set 1 or PB07/24 set 1 or PA09/25 set 1; DATA_OUT1 PA00/30 set 1 or PA02/30 set 1 or PA03/30 set 1 or PA06/30 set 1 or PA07/30 set 1 or PA09/30 set 1 or PA10/30 set 1 or PA11/30 set 1 or PA14/30 set 1 or PB00/30 set 1 or PB01/30 set 1 or PB03/30 set 1 or PB04/30 set 1 or PB06/30 set 1 or PB07/30 set 1 or PB08/30 set 1 or PB11/30 set 1 or PB12/30 set 1 or PC00/30 set 1 or PC09/30 set 1 or PD03/30 set 1 or PD06/30 set 1 or PE00/30 set 1 or PE04/30 set 1 or PE06/30 set 1 or PA00/35 set 3 or PA01/35 set 3 or PA02/35 set 3 or PA04/35 set 3 or PA05/35 set 3 or PA08/35 set 3 or PA09/35 set 3 or PA12/35 set 3 or PA13/35 set 3 or PB01/35 set 3 or PB02/35 set 3 or PB03/35 set 3 or PB05/35 set 3 or PB06/35 set 3 or PB08/35 set 3 or PB09/35 set 3 or PB10/35 set 3 or PB13/35 set 3 or PC01/35 set 3 or PC08/35 set 3 or PD02/35 set 3 or PD06/35 set 3 or PE00/35 set 3 or PE02/35 set 3 or PA00/32 set 4 or PA01/32 set 4 or PA02/32 set 4 or PA03/32 set 4 or PA05/32 set 4 or PA06/32 set 4 or PA08/32 set 4 or PA09/32 set 4 or PA10/32 set 4 or PA13/32 set 4 or PA14/32 set 4 or PB02/32 set 4 or PB03/32 set 4 or PB04/32 set 4 or PB06/32 set 4 or PB07/32 set 4 or PB10/32 set 4 or PB11/32 set 4 or PC07/32 set 4 or PC09/32 set 4 or PD03/32 set 4 or PD07/32 set 4 or PE01/32 set 4 or PE03/32 set 4; DATA_OUT2 PA00/29 set 1 or PA02/29 set 1 or PA03/29 set 1 or PA06/29 set 1 or PA07/29 set 1 or PA09/29 set 1 or PA10/29 set 1 or PA11/29 set 1 or PA14/29 set 1 or PB00/29 set 1 or PB01/29 set 1 or PB03/29 set 1 or PB04/29 set 1 or PB06/29 set 1 or PB07/29 set 1 or PB08/29 set 1 or PB11/29 set 1 or PB12/29 set 1 or PC00/29 set 1 or PC09/29 set 1 or PD03/29 set 1 or PD06/29 set 1 or PE00/29 set 1 or PE04/29 set 1 or PE06/29 set 1 or PA00/37 set 2 or PA01/37 set 2 or PA03/37 set 2 or PA04/37 set 2 or PA07/37 set 2 or PA08/37 set 2 or PA11/37 set 2 or PA12/37 set 2 or PB00/37 set 2 or PB01/37 set 2 or PB02/37 set 2 or PB04/37 set 2 or PB05/37 set 2 or PB07/37 set 2 or PB08/37 set 2 or PB09/37 set 2 or PB12/37 set 2 or PB13/37 set 2 or PC00/37 set 2 or PC01/37 set 2 or PC07/37 set 2 or PD04/37 set 2 or PD07/37 set 2 or PE01/37 set 2 or PE06/37 set 2 or PA00/31 set 4 or PA01/31 set 4 or PA02/31 set 4 or PA03/31 set 4 or PA05/31 set 4 or PA06/31 set 4 or PA08/31 set 4 or PA09/31 set 4 or PA10/31 set 4 or PA13/31 set 4 or PA14/31 set 4 or PB02/31 set 4 or PB03/31 set 4 or PB04/31 set 4 or PB06/31 set 4 or PB07/31 set 4 or PB10/31 set 4 or PB11/31 set 4 or PC07/31 set 4 or PC09/31 set 4 or PD03/31 set 4 or PD07/31 set 4 or PE01/31 set 4 or PE03/31 set 4; DATA_IN2 PA01/1 set 2 or PA07/2 set 2 or PA12/3 set 2 or PB01/4 set 2 or PB07/5 set 2 or PC01/6 set 2 or PC07/7 set 2 or PD07/8 set 2 or PE01/9 set 2 or PA03/10 set 2 or PB02/11 set 2 or PC00/12 set 2 or PD04/13 set 2 or PE06/14 set 2 or PA04/15 set 2 or PA08/16 set 2 or PB12/17 set 2 or PB05/18 set 2 or PB09/19 set 2 or PB13/20 set 2 or PB00/21 set 2 or PB04/22 set 2 or PB08/23 set 2 or PA00/24 set 2 or PA11/25 set 2; DATA_OUT3 PA00/28 set 1 or PA02/28 set 1 or PA03/28 set 1 or PA06/28 set 1 or PA07/28 set 1 or PA09/28 set 1 or PA10/28 set 1 or PA11/28 set 1 or PA14/28 set 1 or PB00/28 set 1 or PB01/28 set 1 or PB03/28 set 1 or PB04/28 set 1 or PB06/28 set 1 or PB07/28 set 1 or PB08/28 set 1 or PB11/28 set 1 or PB12/28 set 1 or PC00/28 set 1 or PC09/28 set 1 or PD03/28 set 1 or PD06/28 set 1 or PE00/28 set 1 or PE04/28 set 1 or PE06/28 set 1 or PA00/36 set 2 or PA01/36 set 2 or PA03/36 set 2 or PA04/36 set 2 or PA07/36 set 2 or PA08/36 set 2 or PA11/36 set 2 or PA12/36 set 2 or PB00/36 set 2 or PB01/36 set 2 or PB02/36 set 2 or PB04/36 set 2 or PB05/36 set 2 or PB07/36 set 2 or PB08/36 set 2 or PB09/36 set 2 or PB12/36 set 2 or PB13/36 set 2 or PC00/36 set 2 or PC01/36 set 2 or PC07/36 set 2 or PD04/36 set 2 or PD07/36 set 2 or PE01/36 set 2 or PE06/36 set 2 or PA00/37 set 3 or PA01/37 set 3 or PA02/37 set 3 or PA04/37 set 3 or PA05/37 set 3 or PA08/37 set 3 or PA09/37 set 3 or PA12/37 set 3 or PA13/37 set 3 or PB01/37 set 3 or PB02/37 set 3 or PB03/37 set 3 or PB05/37 set 3 or PB06/37 set 3 or PB08/37 set 3 or PB09/37 set 3 or PB10/37 set 3 or PB13/37 set 3 or PC01/37 set 3 or PC08/37 set 3 or PD02/37 set 3 or PD06/37 set 3 or PE00/37 set 3 or PE02/37 set 3; DATA_IN3 PA02/1 set 3 or PA08/2 set 3 or PA13/3 set 3 or PB02/4 set 3 or PB08/5 set 3 or PB13/6 set 3 or PC08/7 set 3 or PD02/8 set 3 or PE02/9 set 3 or PA04/10 set 3 or PB03/11 set 3 or PC01/12 set 3 or PD06/13 set 3 or PE00/14 set 3 or PA05/15 set 3 or PA09/16 set 3 or PB06/17 set 3 or PB10/18 set 3 or PA00/19 set 3 or PB01/20 set 3 or PB05/21 set 3 or PB09/22 set 3 or PA01/23 set 3 or PA12/24 set 3
  parameters: DMAC_ID_RX=65, DMAC_ID_TX=66, INSTANCE_ID=64 (Instance index for QSPI), PAC_ID=64 (Index for QSPI registers write protection)
RAMECC at 0x41008000
  parameters: INSTANCE_ID=36 (Instance index for RAMECC), PAC_ID=36 (Index for RAMECC registers write protection)
RCON at 0x44000A00
ROT at 0x44003000
  parameters: ROM_SIZE=64 (In Kbytes), NUM_FUSE_BLKS=3 (CAL bits and die info a part of the NVR region), CAL_NUM=0 (Number of CAL bits), RST_CAL_BITS=0 (Reset value of CAL bits), SYMMETRIC_SECURE_BOOT=0 (Secure boot using ECCDSA authentication), MACRO_AUX_IN_WIDTH=4, PB_WAIT_ROM=0, START_OSC_PERIOD=125, PB_ADDRL=0x300 (PB start address), PB_ADDRH=0x3FF (PB end address), EXT_VDDQ_SW=1, TPWRUP_VDDQ_NS=4000
RTC at 0x42010000
  pins: EVENT PB13/RTCC; IN0 PA3/RTCC; IN1 PA2/RTCC; IN2 PA1/RTCC; IN3 PA0/RTCC; OUT PA4/RTCC
  parameters: DMAC_ID_TIMESTAMP=1, CHIP_RTC_PADDR_MSB=9, CHIP_RTC_NUM_OF_ALARMS=2, CHIP_RTC_NUM_OF_BKREGS=1, CHIP_RTC_NUM_OF_COMP16=4, CHIP_RTC_NUM_OF_TAMPERS=4
SERCOM0 at 0x40000C00 (SERCOM)
  pins: PAD0 PA5/MSSP_SPI_I2C; PAD1 PA6/MSSP_SPI_I2C; PAD2 PB9/MSSP_SPI_I2C; PAD3 PA4/MSSP_SPI_I2C; PAD_IN3 PA00/1 set 1 or PA06/2 set 1 or PA11/3 set 1 or PB00/4 set 1 or PB06/5 set 1 or PB11/6 set 1 or PC00/7 set 1 or PD06/8 set 1 or PE00/9 set 1 or PE06/10 set 1 or PB01/11 set 1 or PC09/12 set 1 or PD03/13 set 1 or PE04/14 set 1 or PA03/15 set 1 or PA07/16 set 1 or PB04/17 set 1 or PB08/18 set 1 or PB12/19 set 1 or PA02/20 set 1 or PA10/21 set 1 or PA14/22 set 1 or PB03/23 set 1 or PB07/24 set 1 or PA09/25 set 1; PAD_OUT3 PA00/1 set 1 or PA02/1 set 1 or PA03/1 set 1 or PA06/1 set 1 or PA07/1 set 1 or PA09/1 set 1 or PA10/1 set 1 or PA11/1 set 1 or PA14/1 set 1 or PB00/1 set 1 or PB01/1 set 1 or PB03/1 set 1 or PB04/1 set 1 or PB06/1 set 1 or PB07/1 set 1 or PB08/1 set 1 or PB11/1 set 1 or PB12/1 set 1 or PC00/1 set 1 or PC09/1 set 1 or PD03/1 set 1 or PD06/1 set 1 or PE00/1 set 1 or PE04/1 set 1 or PE06/1 set 1 or PA00/3 set 2 or PA01/3 set 2 or PA03/3 set 2 or PA04/3 set 2 or PA07/3 set 2 or PA08/3 set 2 or PA11/3 set 2 or PA12/3 set 2 or PB00/3 set 2 or PB01/3 set 2 or PB02/3 set 2 or PB04/3 set 2 or PB05/3 set 2 or PB07/3 set 2 or PB08/3 set 2 or PB09/3 set 2 or PB12/3 set 2 or PB13/3 set 2 or PC00/3 set 2 or PC01/3 set 2 or PC07/3 set 2 or PD04/3 set 2 or PD07/3 set 2 or PE01/3 set 2 or PE06/3 set 2 or PA00/3 set 3 or PA01/3 set 3 or PA02/3 set 3 or PA04/3 set 3 or PA05/3 set 3 or PA08/3 set 3 or PA09/3 set 3 or PA12/3 set 3 or PA13/3 set 3 or PB01/3 set 3 or PB02/3 set 3 or PB03/3 set 3 or PB05/3 set 3 or PB06/3 set 3 or PB08/3 set 3 or PB09/3 set 3 or PB10/3 set 3 or PB13/3 set 3 or PC01/3 set 3 or PC08/3 set 3 or PD02/3 set 3 or PD06/3 set 3 or PE00/3 set 3 or PE02/3 set 3; PAD_OUT2 PA02/2 set 1 or PA03/2 set 1 or PA06/2 set 1 or PA07/2 set 1 or PA09/2 set 1 or PA10/2 set 1 or PA11/2 set 1 or PA12/2 set 1 or PA14/2 set 1 or PB00/2 set 1 or PB01/2 set 1 or PB03/2 set 1 or PB04/2 set 1 or PB06/2 set 1 or PB07/2 set 1 or PB08/2 set 1 or PB11/2 set 1 or PB12/2 set 1 or PC00/2 set 1 or PC09/2 set 1 or PD03/2 set 1 or PD06/2 set 1 or PE00/2 set 1 or PE04/2 set 1 or PE06/2 set 1 or PA00/4 set 2 or PA01/4 set 2 or PA03/4 set 2 or PA04/4 set 2 or PA07/4 set 2 or PA08/4 set 2 or PA11/4 set 2 or PA12/4 set 2 or PB00/4 set 2 or PB01/4 set 2 or PB02/4 set 2 or PB04/4 set 2 or PB05/4 set 2 or PB07/4 set 2 or PB08/4 set 2 or PB09/4 set 2 or PB12/4 set 2 or PB13/4 set 2 or PC00/4 set 2 or PC01/4 set 2 or PC07/4 set 2 or PD04/4 set 2 or PD07/4 set 2 or PE01/4 set 2 or PE06/4 set 2 or PA00/2 set 4 or PA01/2 set 4 or PA02/2 set 4 or PA03/2 set 4 or PA05/2 set 4 or PA06/2 set 4 or PA08/2 set 4 or PA09/2 set 4 or PA10/2 set 4 or PA13/2 set 4 or PA14/2 set 4 or PB02/2 set 4 or PB03/2 set 4 or PB04/2 set 4 or PB06/2 set 4 or PB07/2 set 4 or PB10/2 set 4 or PB11/2 set 4 or PC07/2 set 4 or PC09/2 set 4 or PD03/2 set 4 or PD07/2 set 4 or PE01/2 set 4 or PE03/2 set 4; PAD_IN0 PA01/2 set 2 or PA07/2 set 2 or PA12/2 set 2 or PB01/2 set 2 or PB07/2 set 2 or PC01/2 set 2 or PC07/2 set 2 or PD07/2 set 2 or PE01/2 set 2 or PA03/10 set 2 or PB02/11 set 2 or PC00/12 set 2 or PD04/13 set 2 or PE06/14 set 2 or PA04/15 set 2 or PA08/16 set 2 or PB12/17 set 2 or PB05/18 set 2 or PB09/19 set 2 or PB13/20 set 2 or PB00/21 set 2 or PB04/22 set 2 or PB08/23 set 2 or PA00/24 set 2 or PA11/25 set 2; PAD_OUT0 PA00/2 set 2 or PA01/2 set 2 or PA03/2 set 2 or PA04/2 set 2 or PA07/2 set 2 or PA08/2 set 2 or PA11/2 set 2 or PA12/2 set 2 or PB00/2 set 2 or PB01/2 set 2 or PB02/2 set 2 or PB04/2 set 2 or PB05/2 set 2 or PB07/2 set 2 or PB08/2 set 2 or PB09/2 set 2 or PB12/2 set 2 or PB13/2 set 2 or PC00/2 set 2 or PC01/2 set 2 or PC07/2 set 2 or PD04/2 set 2 or PD07/2 set 2 or PE01/2 set 2 or PE06/2 set 2 or PA00/2 set 3 or PA01/2 set 3 or PA02/2 set 3 or PA04/2 set 3 or PA05/2 set 3 or PA08/2 set 3 or PA09/2 set 3 or PA12/2 set 3 or PA13/2 set 3 or PB01/2 set 3 or PB02/2 set 3 or PB03/2 set 3 or PB05/2 set 3 or PB06/2 set 3 or PB08/2 set 3 or PB09/2 set 3 or PB10/2 set 3 or PB13/2 set 3 or PC01/2 set 3 or PC08/2 set 3 or PD02/2 set 3 or PD06/2 set 3 or PE00/2 set 3 or PE02/2 set 3 or PA00/3 set 4 or PA01/3 set 4 or PA02/3 set 4 or PA03/3 set 4 or PA05/3 set 4 or PA06/3 set 4 or PA08/3 set 4 or PA09/3 set 4 or PA10/3 set 4 or PA13/3 set 4 or PA14/3 set 4 or PB02/3 set 4 or PB03/3 set 4 or PB04/3 set 4 or PB06/3 set 4 or PB07/3 set 4 or PB10/3 set 4 or PB11/3 set 4 or PC07/3 set 4 or PC09/3 set 4 or PD03/3 set 4 or PD07/3 set 4 or PE01/3 set 4 or PE03/3 set 4; PAD_IN2 PA03/1 set 4 or PA09/2 set 4 or PA14/3 set 4 or PB03/4 set 4 or PC09/5 set 4 or PD03/6 set 4 or PE03/7 set 4 or PA00/8 set 4 or PB04/9 set 4 or PC07/10 set 4 or PD07/11 set 4 or PE01/12 set 4 or PA06/13 set 4 or PA10/14 set 4 or PB07/15 set 4 or PB11/16 set 4 or PA01/17 set 4 or PA05/18 set 4 or PA13/19 set 4 or PB02/20 set 4 or PB06/21 set 4 or PB10/22 set 4 or PA08/23 set 4 or PA02/24 set 4; PAD_IN1 PA05/0 set 6 or PB05/1 set 6 or PB09/2 set 6 or PD05/3 set 6 or PE05/4 set 6 or PA03/5 set 6 or PA06/6 set 6 or PA07/7 set 6 or PB06/8 set 6 or PB08/9 set 6; PAD_OUT1 PA03/1 set 6 or PA05/1 set 6 or PA06/1 set 6 or PA07/1 set 6 or PB05/1 set 6 or PB06/1 set 6 or PB08/1 set 6 or PB09/1 set 6 or PD05/1 set 6 or PE05/1 set 6
  parameters: GCLK_ID_SLOW=4, GCLK_ID_CORE=4, DMAC_ID_RX=4, DMAC_ID_TX=5, CHIP_SERCOM_PADDR_MSB=9, CHIP_SERCOM_CLK_REDUCTION=1, CHIP_SERCOM_DMA=1, CHIP_SERCOM_FIFO_DEPTH_POWER=1, CHIP_SERCOM_RETENTION_SUPPORT=0, CHIP_SERCOM_SPI=1, CHIP_SERCOM_SPI_HW_SS_CTRL=1, CHIP_SERCOM_SPI_ICSPACE_EXT=1, CHIP_SERCOM_SPI_OZMO=0, CHIP_SERCOM_SPI_WAKE_ON_SSL=1, CHIP_SERCOM_TTBIT_EXTENSION=1, CHIP_SERCOM_TWIM=1, CHIP_SERCOM_TWIS=1, CHIP_SERCOM_TWIS_AUTO_ACK=1, CHIP_SERCOM_TWIS_GROUP_CMD=1, CHIP_SERCOM_TWIS_SDASETUP_CNT_SIZE=8, CHIP_SERCOM_TWIS_SDASETUP_SIZE=4, CHIP_SERCOM_TWIS_SUDAT=1, CHIP_SERCOM_TWI_FASTMP=1, CHIP_SERCOM_TWI_HSMODE=1, CHIP_SERCOM_TWI_SCLSM_MODE=1, CHIP_SERCOM_TWI_SMB_TIMEOUTS=1, CHIP_SERCOM_TWI_TENBIT_ADR=1, CHIP_SERCOM_USART=1, CHIP_SERCOM_USART_AUTOBAUD=1, CHIP_SERCOM_USART_COLDET=1, CHIP_SERCOM_USART_FLOW_CTRL=1, CHIP_SERCOM_USART_FRAC_BAUD=1, CHIP_SERCOM_USART_IRDA=1, CHIP_SERCOM_USART_ISO7816=1, CHIP_SERCOM_USART_LIN_MASTER=1, CHIP_SERCOM_USART_RS485=1, CHIP_SERCOM_USART_SAMPA_EXT=1, CHIP_SERCOM_USART_SAMPR_EXT=1, CHIP_SERCOM_DLY_COMPENSATION=1, CHIP_SERCOM_SE_CNT=1, INSTANCE_ID=3 (Instance index for SERCOM0), PAC_ID=3 (Index for SERCOM0 registers write protection)
SERCOM1 at 0x40001000 (SERCOM)
  pins: PAD0 PA7/MSSP_SPI_I2C; PAD1 PA8/MSSP_SPI_I2C; PAD2 PA9/MSSP_SPI_I2C; PAD3 PA10/MSSP_SPI_I2C; PAD_IN2 PA00/1 set 1 or PA06/2 set 1 or PA11/3 set 1 or PB00/4 set 1 or PB06/5 set 1 or PB11/6 set 1 or PC00/7 set 1 or PD06/8 set 1 or PE00/9 set 1 or PE06/10 set 1 or PB01/11 set 1 or PC09/12 set 1 or PD03/13 set 1 or PE04/14 set 1 or PA03/15 set 1 or PA07/16 set 1 or PB04/17 set 1 or PB08/18 set 1 or PB12/19 set 1 or PA02/20 set 1 or PA10/21 set 1 or PA14/22 set 1 or PB03/23 set 1 or PB07/24 set 1 or PA09/25 set 1; PAD_OUT2 PA02/4 set 1 or PA03/4 set 1 or PA06/4 set 1 or PA07/4 set 1 or PA09/4 set 1 or PA10/4 set 1 or PA11/4 set 1 or PA14/4 set 1 or PB00/4 set 1 or PB01/4 set 1 or PB03/4 set 1 or PB04/4 set 1 or PB06/4 set 1 or PB07/4 set 1 or PB08/4 set 1 or PB11/4 set 1 or PB12/4 set 1 or PC00/4 set 1 or PC09/4 set 1 or PD03/4 set 1 or PD06/4 set 1 or PE00/4 set 1 or PE04/4 set 1 or PE06/4 set 1 or PA00/6 set 2 or PA01/6 set 2 or PA03/6 set 2 or PA04/6 set 2 or PA07/6 set 2 or PA08/6 set 2 or PA11/6 set 2 or PA12/6 set 2 or PB00/6 set 2 or PB01/6 set 2 or PB02/6 set 2 or PB04/6 set 2 or PB05/6 set 2 or PB07/6 set 2 or PB08/6 set 2 or PB09/6 set 2 or PB12/6 set 2 or PB13/6 set 2 or PC00/6 set 2 or PC01/6 set 2 or PC07/6 set 2 or PD04/6 set 2 or PD07/6 set 2 or PE01/6 set 2 or PE06/6 set 2 or PA00/4 set 3 or PA01/4 set 3 or PA02/4 set 3 or PA04/4 set 3 or PA05/4 set 3 or PA08/4 set 3 or PA09/4 set 3 or PA12/4 set 3 or PA13/4 set 3 or PB01/4 set 3 or PB02/4 set 3 or PB03/4 set 3 or PB05/4 set 3 or PB06/4 set 3 or PB08/4 set 3 or PB09/4 set 3 or PB10/4 set 3 or PB13/4 set 3 or PC01/4 set 3 or PC08/4 set 3 or PD02/4 set 3 or PD06/4 set 3 or PE00/4 set 3 or PE02/4 set 3; PAD_OUT0 PA02/3 set 1 or PA03/3 set 1 or PA06/3 set 1 or PA07/3 set 1 or PA09/3 set 1 or PA10/3 set 1 or PA11/3 set 1 or PA14/3 set 1 or PB00/3 set 1 or PB01/3 set 1 or PB03/3 set 1 or PB04/3 set 1 or PB06/3 set 1 or PB07/3 set 1 or PB08/3 set 1 or PB11/3 set 1 or PB12/3 set 1 or PC00/3 set 1 or PC09/3 set 1 or PD03/3 set 1 or PD06/3 set 1 or PE00/3 set 1 or PE04/3 set 1 or PE06/3 set 1 or PA00/5 set 3 or PA01/5 set 3 or PA02/5 set 3 or PA04/5 set 3 or PA05/5 set 3 or PA08/5 set 3 or PA09/5 set 3 or PA12/5 set 3 or PA13/5 set 3 or PB01/5 set 3 or PB02/5 set 3 or PB03/5 set 3 or PB05/5 set 3 or PB06/5 set 3 or PB08/5 set 3 or PB09/5 set 3 or PB10/5 set 3 or PB13/5 set 3 or PC01/5 set 3 or PC08/5 set 3 or PD02/5 set 3 or PD06/5 set 3 or PE00/5 set 3 or PE02/5 set 3 or PA00/5 set 4 or PA01/5 set 4 or PA02/5 set 4 or PA03/5 set 4 or PA05/5 set 4 or PA06/5 set 4 or PA08/5 set 4 or PA09/5 set 4 or PA10/5 set 4 or PA13/5 set 4 or PA14/5 set 4 or PB02/5 set 4 or PB03/5 set 4 or PB04/5 set 4 or PB06/5 set 4 or PB07/5 set 4 or PB10/5 set 4 or PB11/5 set 4 or PC07/5 set 4 or PC09/5 set 4 or PD03/5 set 4 or PD07/5 set 4 or PE01/5 set 4 or PE03/5 set 4; PAD_IN3 PA01/1 set 2 or PA07/2 set 2 or PA12/3 set 2 or PB01/4 set 2 or PB07/5 set 2 or PC01/6 set 2 or PC07/7 set 2 or PD07/8 set 2 or PE01/9 set 2 or PA03/10 set 2 or PB02/11 set 2 or PC00/12 set 2 or PD04/13 set 2 or PE06/14 set 2 or PA04/15 set 2 or PA08/16 set 2 or PB12/17 set 2 or PB05/18 set 2 or PB09/19 set 2 or PB13/20 set 2 or PB00/21 set 2 or PB04/22 set 2 or PB08/23 set 2 or PA00/24 set 2 or PA11/25 set 2; PAD_OUT3 PA00/5 set 2 or PA01/5 set 2 or PA03/5 set 2 or PA04/5 set 2 or PA07/5 set 2 or PA08/5 set 2 or PA11/5 set 2 or PA12/5 set 2 or PB00/5 set 2 or PB01/5 set 2 or PB02/5 set 2 or PB04/5 set 2 or PB05/5 set 2 or PB07/5 set 2 or PB08/5 set 2 or PB09/5 set 2 or PB12/5 set 2 or PB13/5 set 2 or PC00/5 set 2 or PC01/5 set 2 or PC07/5 set 2 or PD04/5 set 2 or PD07/5 set 2 or PE01/5 set 2 or PE06/5 set 2 or PA00/6 set 3 or PA01/6 set 3 or PA02/6 set 3 or PA04/6 set 3 or PA05/6 set 3 or PA08/6 set 3 or PA09/6 set 3 or PA12/6 set 3 or PA13/6 set 3 or PB01/6 set 3 or PB02/6 set 3 or PB03/6 set 3 or PB05/6 set 3 or PB06/6 set 3 or PB08/6 set 3 or PB09/6 set 3 or PB10/6 set 3 or PB13/6 set 3 or PC01/6 set 3 or PC08/6 set 3 or PD02/6 set 3 or PD06/6 set 3 or PE00/6 set 3 or PE02/6 set 3 or PA00/4 set 4 or PA01/4 set 4 or PA02/4 set 4 or PA03/4 set 4 or PA05/4 set 4 or PA06/4 set 4 or PA08/4 set 4 or PA09/4 set 4 or PA10/4 set 4 or PA13/4 set 4 or PA14/4 set 4 or PB02/4 set 4 or PB03/4 set 4 or PB04/4 set 4 or PB06/4 set 4 or PB07/4 set 4 or PB10/4 set 4 or PB11/4 set 4 or PC07/4 set 4 or PC09/4 set 4 or PD03/4 set 4 or PD07/4 set 4 or PE01/4 set 4 or PE03/4 set 4 or PA01/2 set 5 or PA04/2 set 5 or PA10/2 set 5 or PA15/2 set 5 or PB00/2 set 5 or PB04/2 set 5 or PB10/2 set 5 or PB14/2 set 5 or PB15/2 set 5 or PC08/2 set 5 or PC10/2 set 5 or PC11/2 set 5 or PD00/2 set 5 or PD01/2 set 5 or PD02/2 set 5 or PD04/2 set 5 or PE02/2 set 5 or PE04/2 set 5; PAD_IN0 PA02/1 set 3 or PA08/2 set 3 or PA13/3 set 3 or PB02/4 set 3 or PB08/5 set 3 or PB13/6 set 3 or PC08/7 set 3 or PD02/8 set 3 or PE02/9 set 3 or PA04/10 set 3 or PB03/11 set 3 or PC01/12 set 3 or PD06/13 set 3 or PE00/14 set 3 or PA05/15 set 3 or PA09/16 set 3 or PB06/17 set 3 or PB10/18 set 3 or PA00/19 set 3 or PB01/20 set 3 or PB05/21 set 3 or PB09/22 set 3 or PA01/23 set 3 or PA12/24 set 3; PAD_IN1 PA05/0 set 6 or PB05/1 set 6 or PB09/2 set 6 or PD05/3 set 6 or PE05/4 set 6 or PA03/5 set 6 or PA06/6 set 6 or PA07/7 set 6 or PB06/8 set 6 or PB08/9 set 6; PAD_OUT1 PA03/2 set 6 or PA05/2 set 6 or PA06/2 set 6 or PA07/2 set 6 or PB05/2 set 6 or PB06/2 set 6 or PB08/2 set 6 or PB09/2 set 6 or PD05/2 set 6 or PE05/2 set 6
  parameters: GCLK_ID_SLOW=4, GCLK_ID_CORE=4, DMAC_ID_RX=6, DMAC_ID_TX=7, CHIP_SERCOM_PADDR_MSB=9, CHIP_SERCOM_CLK_REDUCTION=1, CHIP_SERCOM_DMA=1, CHIP_SERCOM_FIFO_DEPTH_POWER=1, CHIP_SERCOM_RETENTION_SUPPORT=0, CHIP_SERCOM_SPI=1, CHIP_SERCOM_SPI_HW_SS_CTRL=1, CHIP_SERCOM_SPI_ICSPACE_EXT=1, CHIP_SERCOM_SPI_OZMO=0, CHIP_SERCOM_SPI_WAKE_ON_SSL=1, CHIP_SERCOM_TTBIT_EXTENSION=1, CHIP_SERCOM_TWIM=1, CHIP_SERCOM_TWIS=1, CHIP_SERCOM_TWIS_AUTO_ACK=1, CHIP_SERCOM_TWIS_GROUP_CMD=1, CHIP_SERCOM_TWIS_SDASETUP_CNT_SIZE=8, CHIP_SERCOM_TWIS_SDASETUP_SIZE=4, CHIP_SERCOM_TWIS_SUDAT=1, CHIP_SERCOM_TWI_FASTMP=1, CHIP_SERCOM_TWI_HSMODE=1, CHIP_SERCOM_TWI_SCLSM_MODE=1, CHIP_SERCOM_TWI_SMB_TIMEOUTS=1, CHIP_SERCOM_TWI_TENBIT_ADR=1, CHIP_SERCOM_USART=1, CHIP_SERCOM_USART_AUTOBAUD=1, CHIP_SERCOM_USART_COLDET=1, CHIP_SERCOM_USART_FLOW_CTRL=1, CHIP_SERCOM_USART_FRAC_BAUD=1, CHIP_SERCOM_USART_IRDA=1, CHIP_SERCOM_USART_ISO7816=1, CHIP_SERCOM_USART_LIN_MASTER=1, CHIP_SERCOM_USART_RS485=1, CHIP_SERCOM_USART_SAMPA_EXT=1, CHIP_SERCOM_USART_SAMPR_EXT=1, CHIP_SERCOM_DLY_COMPENSATION=1, CHIP_SERCOM_SE_CNT=1, INSTANCE_ID=4 (Instance index for SERCOM1), PAC_ID=4 (Index for SERCOM1 registers write protection)
SERCOM2 at 0x46000000 (SERCOM)
  pins: PAD0 PE0/MSSP_SPI_I2C; PAD1 PE1/MSSP_SPI_I2C; PAD2 PC0/MSSP_SPI_I2C; PAD3 PC1/MSSP_SPI_I2C; PAD_IN3 PA00/1 set 1 or PA06/2 set 1 or PA11/3 set 1 or PB00/4 set 1 or PB06/5 set 1 or PB11/6 set 1 or PC00/7 set 1 or PD06/8 set 1 or PE00/9 set 1 or PE06/10 set 1 or PB01/11 set 1 or PC09/12 set 1 or PD03/13 set 1 or PE04/14 set 1 or PA03/15 set 1 or PA07/16 set 1 or PB04/17 set 1 or PB08/18 set 1 or PB12/19 set 1 or PA02/20 set 1 or PA10/21 set 1 or PA14/22 set 1 or PB03/23 set 1 or PB07/24 set 1 or PA09/25 set 1; PAD_OUT3 PA00/5 set 1 or PA02/5 set 1 or PA03/5 set 1 or PA06/5 set 1 or PA07/5 set 1 or PA09/5 set 1 or PA10/5 set 1 or PA11/5 set 1 or PA14/5 set 1 or PB00/5 set 1 or PB01/5 set 1 or PB03/5 set 1 or PB04/5 set 1 or PB06/5 set 1 or PB07/5 set 1 or PB08/5 set 1 or PB11/5 set 1 or PB12/5 set 1 or PC00/5 set 1 or PC09/5 set 1 or PD03/5 set 1 or PD06/5 set 1 or PE00/5 set 1 or PE04/5 set 1 or PE06/5 set 1 or PA00/8 set 2 or PA01/8 set 2 or PA03/8 set 2 or PA04/8 set 2 or PA07/8 set 2 or PA08/8 set 2 or PA11/8 set 2 or PA12/8 set 2 or PB00/8 set 2 or PB01/8 set 2 or PB02/8 set 2 or PB04/8 set 2 or PB05/8 set 2 or PB07/8 set 2 or PB08/8 set 2 or PB09/8 set 2 or PB12/8 set 2 or PB13/8 set 2 or PC00/8 set 2 or PC01/8 set 2 or PC07/8 set 2 or PD04/8 set 2 or PD07/8 set 2 or PE01/8 set 2 or PE06/8 set 2 or PA00/8 set 3 or PA01/8 set 3 or PA02/8 set 3 or PA04/8 set 3 or PA05/8 set 3 or PA08/8 set 3 or PA09/8 set 3 or PA12/8 set 3 or PA13/8 set 3 or PB01/8 set 3 or PB02/8 set 3 or PB03/8 set 3 or PB05/8 set 3 or PB06/8 set 3 or PB08/8 set 3 or PB09/8 set 3 or PB10/8 set 3 or PB13/8 set 3 or PC01/8 set 3 or PC08/8 set 3 or PD02/8 set 3 or PD06/8 set 3 or PE00/8 set 3 or PE02/8 set 3; PAD_OUT2 PA00/6 set 1 or PA02/6 set 1 or PA03/6 set 1 or PA06/6 set 1 or PA07/6 set 1 or PA09/6 set 1 or PA10/6 set 1 or PA11/6 set 1 or PA14/6 set 1 or PB00/6 set 1 or PB01/6 set 1 or PB03/6 set 1 or PB04/6 set 1 or PB06/6 set 1 or PB07/6 set 1 or PB08/6 set 1 or PB11/6 set 1 or PB12/6 set 1 or PC00/6 set 1 or PC09/6 set 1 or PD03/6 set 1 or PD06/6 set 1 or PE00/6 set 1 or PE04/6 set 1 or PE06/6 set 1 or PA00/9 set 2 or PA01/9 set 2 or PA03/9 set 2 or PA04/9 set 2 or PA07/9 set 2 or PA08/9 set 2 or PA11/9 set 2 or PA12/9 set 2 or PB00/9 set 2 or PB01/9 set 2 or PB02/9 set 2 or PB04/9 set 2 or PB05/9 set 2 or PB07/9 set 2 or PB08/9 set 2 or PB09/9 set 2 or PB12/9 set 2 or PB13/9 set 2 or PC00/9 set 2 or PC01/9 set 2 or PC07/9 set 2 or PD04/9 set 2 or PD07/9 set 2 or PE01/9 set 2 or PE06/9 set 2 or PA00/6 set 4 or PA01/6 set 4 or PA02/6 set 4 or PA03/6 set 4 or PA05/6 set 4 or PA06/6 set 4 or PA08/6 set 4 or PA09/6 set 4 or PA10/6 set 4 or PA13/6 set 4 or PA14/6 set 4 or PB02/6 set 4 or PB03/6 set 4 or PB04/6 set 4 or PB06/6 set 4 or PB07/6 set 4 or PB10/6 set 4 or PB11/6 set 4 or PC07/6 set 4 or PC09/6 set 4 or PD03/6 set 4 or PD07/6 set 4 or PE01/6 set 4 or PE03/6 set 4; PAD_IN0 PA01/1 set 2 or PA07/2 set 2 or PA12/3 set 2 or PB01/4 set 2 or PB07/5 set 2 or PC01/6 set 2 or PC07/7 set 2 or PD07/8 set 2 or PE01/9 set 2 or PA03/10 set 2 or PB02/11 set 2 or PC00/12 set 2 or PD04/13 set 2 or PE06/14 set 2 or PA04/15 set 2 or PA08/16 set 2 or PB12/17 set 2 or PB05/18 set 2 or PB09/19 set 2 or PB13/20 set 2 or PB00/21 set 2 or PB04/22 set 2 or PB08/23 set 2 or PA00/24 set 2 or PA11/25 set 2; PAD_OUT0 PA00/7 set 2 or PA01/7 set 2 or PA03/7 set 2 or PA04/7 set 2 or PA07/7 set 2 or PA08/7 set 2 or PA11/7 set 2 or PA12/7 set 2 or PB00/7 set 2 or PB01/7 set 2 or PB02/7 set 2 or PB04/7 set 2 or PB05/7 set 2 or PB07/7 set 2 or PB08/7 set 2 or PB09/7 set 2 or PB12/7 set 2 or PB13/7 set 2 or PC00/7 set 2 or PC01/7 set 2 or PC07/7 set 2 or PD04/7 set 2 or PD07/7 set 2 or PE01/7 set 2 or PE06/7 set 2 or PA00/7 set 3 or PA01/7 set 3 or PA02/7 set 3 or PA04/7 set 3 or PA05/7 set 3 or PA08/7 set 3 or PA09/7 set 3 or PA12/7 set 3 or PA13/7 set 3 or PB01/7 set 3 or PB02/7 set 3 or PB03/7 set 3 or PB05/7 set 3 or PB06/7 set 3 or PB08/7 set 3 or PB09/7 set 3 or PB10/7 set 3 or PB13/7 set 3 or PC01/7 set 3 or PC08/7 set 3 or PD02/7 set 3 or PD06/7 set 3 or PE00/7 set 3 or PE02/7 set 3 or PA00/7 set 4 or PA01/7 set 4 or PA02/7 set 4 or PA03/7 set 4 or PA05/7 set 4 or PA06/7 set 4 or PA08/7 set 4 or PA09/7 set 4 or PA10/7 set 4 or PA13/7 set 4 or PA14/7 set 4 or PB02/7 set 4 or PB03/7 set 4 or PB04/7 set 4 or PB06/7 set 4 or PB07/7 set 4 or PB10/7 set 4 or PB11/7 set 4 or PC07/7 set 4 or PC09/7 set 4 or PD03/7 set 4 or PD07/7 set 4 or PE01/7 set 4 or PE03/7 set 4 or PA01/3 set 5 or PA04/3 set 5 or PA10/3 set 5 or PA15/3 set 5 or PB00/3 set 5 or PB04/3 set 5 or PB10/3 set 5 or PB14/3 set 5 or PB15/3 set 5 or PC08/3 set 5 or PC10/3 set 5 or PC11/3 set 5 or PD00/3 set 5 or PD01/3 set 5 or PD02/3 set 5 or PD04/3 set 5 or PE02/3 set 5 or PE04/3 set 5; PAD_IN2 PA03/1 set 4 or PA09/2 set 4 or PA14/3 set 4 or PB03/4 set 4 or PC09/5 set 4 or PD03/6 set 4 or PE03/7 set 4 or PA00/8 set 4 or PB04/9 set 4 or PC07/10 set 4 or PD07/11 set 4 or PE01/12 set 4 or PA06/13 set 4 or PA10/14 set 4 or PB07/15 set 4 or PB11/16 set 4 or PA01/17 set 4 or PA05/18 set 4 or PA13/19 set 4 or PB02/20 set 4 or PB06/21 set 4 or PB10/22 set 4 or PA08/23 set 4 or PA02/24 set 4; PAD_IN1 PA05/1 set 6 or PB05/2 set 6 or PB09/3 set 6 or PD05/4 set 6 or PE05/5 set 6 or PA03/6 set 6 or PA06/7 set 6 or PA07/8 set 6 or PB06/9 set 6 or PB08/10 set 6; PAD_OUT1 PA03/3 set 6 or PA05/3 set 6 or PA06/3 set 6 or PA07/3 set 6 or PB05/3 set 6 or PB06/3 set 6 or PB08/3 set 6 or PB09/3 set 6 or PD05/3 set 6 or PE05/3 set 6
  parameters: GCLK_ID_SLOW=4, GCLK_ID_CORE=4, DMAC_ID_RX=8, DMAC_ID_TX=9, CHIP_SERCOM_PADDR_MSB=9, CHIP_SERCOM_CLK_REDUCTION=1, CHIP_SERCOM_DMA=1, CHIP_SERCOM_FIFO_DEPTH_POWER=1, CHIP_SERCOM_RETENTION_SUPPORT=0, CHIP_SERCOM_SPI=1, CHIP_SERCOM_SPI_HW_SS_CTRL=1, CHIP_SERCOM_SPI_ICSPACE_EXT=1, CHIP_SERCOM_SPI_OZMO=0, CHIP_SERCOM_SPI_WAKE_ON_SSL=1, CHIP_SERCOM_TTBIT_EXTENSION=1, CHIP_SERCOM_TWIM=1, CHIP_SERCOM_TWIS=1, CHIP_SERCOM_TWIS_AUTO_ACK=1, CHIP_SERCOM_TWIS_GROUP_CMD=1, CHIP_SERCOM_TWIS_SDASETUP_CNT_SIZE=8, CHIP_SERCOM_TWIS_SDASETUP_SIZE=4, CHIP_SERCOM_TWIS_SUDAT=1, CHIP_SERCOM_TWI_FASTMP=1, CHIP_SERCOM_TWI_HSMODE=1, CHIP_SERCOM_TWI_SCLSM_MODE=1, CHIP_SERCOM_TWI_SMB_TIMEOUTS=1, CHIP_SERCOM_TWI_TENBIT_ADR=1, CHIP_SERCOM_USART=1, CHIP_SERCOM_USART_AUTOBAUD=1, CHIP_SERCOM_USART_COLDET=1, CHIP_SERCOM_USART_FLOW_CTRL=1, CHIP_SERCOM_USART_FRAC_BAUD=1, CHIP_SERCOM_USART_IRDA=1, CHIP_SERCOM_USART_ISO7816=1, CHIP_SERCOM_USART_LIN_MASTER=1, CHIP_SERCOM_USART_RS485=1, CHIP_SERCOM_USART_SAMPA_EXT=1, CHIP_SERCOM_USART_SAMPR_EXT=1, CHIP_SERCOM_DLY_COMPENSATION=1, CHIP_SERCOM_SE_CNT=1, INSTANCE_ID=96 (Instance index for SERCOM2), PAC_ID=96 (Index for SERCOM2 registers write protection)

## Notices in the file
Copyright (c) 2023 Microchip Technology Inc.
SPDX-License-Identifier: Apache-2.0
Licensed under the Apache License, Version 2.0 (the "License");
you may not use this file except in compliance with the License.
You may obtain a copy of the License at
http://www.apache.org/licenses/LICENSE-2.0
Unless required by applicable law or agreed to in writing, software
distributed under the License is distributed on an "AS IS" BASIS,
WITHOUT WARRANTIES OR CONDITIONS OF ANY KIND, either express or implied.
See the License for the specific language governing permissions and
limitations under the License.
