# PIC32CX2051BZ62132 device description
Architecture: CORTEX-M4; Family: PIC32CX; Series: PIC32CXBZ62

## Peripheral instances (address, pins/pin function, parameters) (continued)
TC4 at 0x40002400 (TC)
  pins: WO_OUT0 PA00/22 set 1 or PA02/22 set 1 or PA03/22 set 1 or PA06/22 set 1 or PA07/22 set 1 or PA09/22 set 1 or PA10/22 set 1 or PA11/22 set 1 or PA14/22 set 1 or PB00/22 set 1 or PB01/22 set 1 or PB03/22 set 1 or PB04/22 set 1 or PB06/22 set 1 or PB07/22 set 1 or PB08/22 set 1 or PB11/22 set 1 or PB12/22 set 1 or PC00/22 set 1 or PC09/22 set 1 or PD03/22 set 1 or PD06/22 set 1 or PE00/22 set 1 or PE04/22 set 1 or PE06/22 set 1 or PA00/28 set 3 or PA01/28 set 3 or PA02/28 set 3 or PA04/28 set 3 or PA05/28 set 3 or PA08/28 set 3 or PA09/28 set 3 or PA12/28 set 3 or PA13/28 set 3 or PB01/28 set 3 or PB02/28 set 3 or PB03/28 set 3 or PB05/28 set 3 or PB06/28 set 3 or PB08/28 set 3 or PB09/28 set 3 or PB10/28 set 3 or PB13/28 set 3 or PC01/28 set 3 or PC08/28 set 3 or PD02/28 set 3 or PD06/28 set 3 or PE00/28 set 3 or PE02/28 set 3; WO_OUT1 PA00/28 set 2 or PA01/28 set 2 or PA03/28 set 2 or PA04/28 set 2 or PA07/28 set 2 or PA08/28 set 2 or PA11/28 set 2 or PA12/28 set 2 or PB00/28 set 2 or PB01/28 set 2 or PB02/28 set 2 or PB04/28 set 2 or PB05/28 set 2 or PB07/28 set 2 or PB08/28 set 2 or PB09/28 set 2 or PB12/28 set 2 or PB13/28 set 2 or PC00/28 set 2 or PC01/28 set 2 or PC07/28 set 2 or PD04/28 set 2 or PD07/28 set 2 or PE01/28 set 2 or PE06/28 set 2 or PA00/25 set 4 or PA01/25 set 4 or PA02/25 set 4 or PA03/25 set 4 or PA05/25 set 4 or PA06/25 set 4 or PA08/25 set 4 or PA09/25 set 4 or PA10/25 set 4 or PA13/25 set 4 or PA14/25 set 4 or PB02/25 set 4 or PB03/25 set 4 or PB04/25 set 4 or PB06/25 set 4 or PB07/25 set 4 or PB10/25 set 4 or PB11/25 set 4 or PC07/25 set 4 or PC09/25 set 4 or PD03/25 set 4 or PD07/25 set 4 or PE01/25 set 4 or PE03/25 set 4; WO_IN0 PA00/1 set 1 or PA06/2 set 1 or PA11/3 set 1 or PB00/4 set 1 or PB06/5 set 1 or PB11/6 set 1 or PC00/7 set 1 or PD06/8 set 1 or PE00/9 set 1 or PE06/10 set 1 or PB01/11 set 1 or PC09/12 set 1 or PD03/13 set 1 or PE04/14 set 1 or PA03/15 set 1 or PA07/16 set 1 or PB04/17 set 1 or PB08/18 set 1 or PB12/19 set 1 or PA02/20 set 1 or PA10/21 set 1 or PA14/22 set 1 or PB03/23 set 1 or PB07/24 set 1 or PA09/25 set 1 or PA02/1 set 3 or PA08/2 set 3 or PA13/3 set 3 or PB02/4 set 3 or PB08/5 set 3 or PB13/6 set 3 or PC08/7 set 3 or PD02/8 set 3 or PE02/9 set 3 or PA04/10 set 3 or PB03/11 set 3 or PC01/12 set 3 or PD06/13 set 3 or PE00/14 set 3 or PA05/15 set 3 or PA09/16 set 3 or PB06/17 set 3 or PB10/18 set 3 or PA00/19 set 3 or PB01/20 set 3 or PB05/21 set 3 or PB09/22 set 3 or PA01/23 set 3 or PA12/24 set 3; WO_IN1 PA01/1 set 2 or PA07/2 set 2 or PA12/3 set 2 or PB01/4 set 2 or PB07/5 set 2 or PC01/6 set 2 or PC07/7 set 2 or PD07/8 set 2 or PE01/9 set 2 or PA03/10 set 2 or PB02/11 set 2 or PC00/12 set 2 or PD04/13 set 2 or PE06/14 set 2 or PA04/15 set 2 or PA08/16 set 2 or PB12/17 set 2 or PB05/18 set 2 or PB09/19 set 2 or PB13/20 set 2 or PB00/21 set 2 or PB04/22 set 2 or PB08/23 set 2 or PA00/24 set 2 or PA11/25 set 2 or PA03/1 set 4 or PA09/2 set 4 or PA14/3 set 4 or PB03/4 set 4 or PC09/5 set 4 or PD03/6 set 4 or PE03/7 set 4 or PA00/8 set 4 or PB04/9 set 4 or PC07/10 set 4 or PD07/11 set 4 or PE01/12 set 4 or PA06/13 set 4 or PA10/14 set 4 or PB07/15 set 4 or PB11/16 set 4 or PA01/17 set 4 or PA05/18 set 4 or PA13/19 set 4 or PB02/20 set 4 or PB06/21 set 4 or PB10/22 set 4 or PA08/23 set 4 or PA02/24 set 4
  parameters: GCLK_ID=9, DMAC_ID_OVF=47, DMAC_ID_MC0=48, DMAC_ID_MC1=49, INSTANCE_ID=9 (Instance index for TC4), MASTER_SLAVE_MODE=1, PAC_ID=9 (Index for TC4 registers write protection)
TC5 at 0x40002800 (TC)
  pins: WO_OUT0 PA00/23 set 1 or PA02/23 set 1 or PA03/23 set 1 or PA06/23 set 1 or PA07/23 set 1 or PA09/23 set 1 or PA10/23 set 1 or PA11/23 set 1 or PA14/23 set 1 or PB00/23 set 1 or PB01/23 set 1 or PB03/23 set 1 or PB04/23 set 1 or PB06/23 set 1 or PB07/23 set 1 or PB08/23 set 1 or PB11/23 set 1 or PB12/23 set 1 or PC00/23 set 1 or PC09/23 set 1 or PD03/23 set 1 or PD06/23 set 1 or PE00/23 set 1 or PE04/23 set 1 or PE06/23 set 1 or PA00/29 set 3 or PA01/29 set 3 or PA02/29 set 3 or PA04/29 set 3 or PA05/29 set 3 or PA08/29 set 3 or PA09/29 set 3 or PA12/29 set 3 or PA13/29 set 3 or PB01/29 set 3 or PB02/29 set 3 or PB03/29 set 3 or PB05/29 set 3 or PB06/29 set 3 or PB08/29 set 3 or PB09/29 set 3 or PB10/29 set 3 or PB13/29 set 3 or PC01/29 set 3 or PC08/29 set 3 or PD02/29 set 3 or PD06/29 set 3 or PE00/29 set 3 or PE02/29 set 3; WO_OUT1 PA00/29 set 2 or PA01/29 set 2 or PA03/29 set 2 or PA04/29 set 2 or PA07/29 set 2 or PA08/29 set 2 or PA11/29 set 2 or PA12/29 set 2 or PB00/29 set 2 or PB01/29 set 2 or PB02/29 set 2 or PB04/29 set 2 or PB05/29 set 2 or PB07/29 set 2 or PB08/29 set 2 or PB09/29 set 2 or PB12/29 set 2 or PB13/29 set 2 or PC00/29 set 2 or PC01/29 set 2 or PC07/29 set 2 or PD04/29 set 2 or PD07/29 set 2 or PE01/29 set 2 or PE06/29 set 2 or PA00/26 set 4 or PA01/26 set 4 or PA02/26 set 4 or PA03/26 set 4 or PA05/26 set 4 or PA06/26 set 4 or PA08/26 set 4 or PA09/26 set 4 or PA10/26 set 4 or PA13/26 set 4 or PA14/26 set 4 or PB02/26 set 4 or PB03/26 set 4 or PB04/26 set 4 or PB06/26 set 4 or PB07/26 set 4 or PB10/26 set 4 or PB11/26 set 4 or PC07/26 set 4 or PC09/26 set 4 or PD03/26 set 4 or PD07/26 set 4 or PE01/26 set 4 or PE03/26 set 4; WO_IN0 PA00/1 set 1 or PA06/2 set 1 or PA11/3 set 1 or PB00/4 set 1 or PB06/5 set 1 or PB11/6 set 1 or PC00/7 set 1 or PD06/8 set 1 or PE00/9 set 1 or PE06/10 set 1 or PB01/11 set 1 or PC09/12 set 1 or PD03/13 set 1 or PE04/14 set 1 or PA03/15 set 1 or PA07/16 set 1 or PB04/17 set 1 or PB08/18 set 1 or PB12/19 set 1 or PA02/20 set 1 or PA10/21 set 1 or PA14/22 set 1 or PB03/23 set 1 or PB07/24 set 1 or PA09/25 set 1 or PA02/1 set 3 or PA08/2 set 3 or PA13/3 set 3 or PB02/4 set 3 or PB08/5 set 3 or PB13/6 set 3 or PC08/7 set 3 or PD02/8 set 3 or PE02/9 set 3 or PA04/10 set 3 or PB03/11 set 3 or PC01/12 set 3 or PD06/13 set 3 or PE00/14 set 3 or PA05/15 set 3 or PA09/16 set 3 or PB06/17 set 3 or PB10/18 set 3 or PA00/19 set 3 or PB01/20 set 3 or PB05/21 set 3 or PB09/22 set 3 or PA01/23 set 3 or PA12/24 set 3; WO_IN1 PA01/1 set 2 or PA07/2 set 2 or PA12/3 set 2 or PB01/4 set 2 or PB07/5 set 2 or PC01/6 set 2 or PC07/7 set 2 or PD07/8 set 2 or PE01/9 set 2 or PA03/10 set 2 or PB02/11 set 2 or PC00/12 set 2 or PD04/13 set 2 or PE06/14 set 2 or PA04/15 set 2 or PA08/16 set 2 or PB12/17 set 2 or PB05/18 set 2 or PB09/19 set 2 or PB13/20 set 2 or PB00/21 set 2 or PB04/22 set 2 or PB08/23 set 2 or PA00/24 set 2 or PA11/25 set 2 or PA03/1 set 4 or PA09/2 set 4 or PA14/3 set 4 or PB03/4 set 4 or PC09/5 set 4 or PD03/6 set 4 or PE03/7 set 4 or PA00/8 set 4 or PB04/9 set 4 or PC07/10 set 4 or PD07/11 set 4 or PE01/12 set 4 or PA06/13 set 4 or PA10/14 set 4 or PB07/15 set 4 or PB11/16 set 4 or PA01/17 set 4 or PA05/18 set 4 or PA13/19 set 4 or PB02/20 set 4 or PB06/21 set 4 or PB10/22 set 4 or PA08/23 set 4 or PA02/24 set 4
  parameters: GCLK_ID=9, DMAC_ID_OVF=50, DMAC_ID_MC0=51, DMAC_ID_MC1=52, INSTANCE_ID=10 (Instance index for TC5), MASTER_SLAVE_MODE=2, PAC_ID=10 (Index for TC5 registers write protection)
TC6 at 0x40002C00 (TC)
  pins: WO_OUT0 PA00/24 set 1 or PA02/24 set 1 or PA03/24 set 1 or PA06/24 set 1 or PA07/24 set 1 or PA09/24 set 1 or PA10/24 set 1 or PA11/24 set 1 or PA14/24 set 1 or PB00/24 set 1 or PB01/24 set 1 or PB03/24 set 1 or PB04/24 set 1 or PB06/24 set 1 or PB07/24 set 1 or PB08/24 set 1 or PB11/24 set 1 or PB12/24 set 1 or PC00/24 set 1 or PC09/24 set 1 or PD03/24 set 1 or PD06/24 set 1 or PE00/24 set 1 or PE04/24 set 1 or PE06/24 set 1 or PA00/30 set 3 or PA01/30 set 3 or PA02/30 set 3 or PA04/30 set 3 or PA05/30 set 3 or PA08/30 set 3 or PA09/30 set 3 or PA12/30 set 3 or PA13/30 set 3 or PB01/30 set 3 or PB02/30 set 3 or PB03/30 set 3 or PB05/30 set 3 or PB06/30 set 3 or PB08/30 set 3 or PB09/30 set 3 or PB10/30 set 3 or PB13/30 set 3 or PC01/30 set 3 or PC08/30 set 3 or PD02/30 set 3 or PD06/30 set 3 or PE00/30 set 3 or PE02/30 set 3; WO_OUT1 PA00/30 set 2 or PA01/30 set 2 or PA03/30 set 2 or PA04/30 set 2 or PA07/30 set 2 or PA08/30 set 2 or PA11/30 set 2 or PA12/30 set 2 or PB00/30 set 2 or PB01/30 set 2 or PB02/30 set 2 or PB04/30 set 2 or PB05/30 set 2 or PB07/30 set 2 or PB08/30 set 2 or PB09/30 set 2 or PB12/30 set 2 or PB13/30 set 2 or PC00/30 set 2 or PC01/30 set 2 or PC07/30 set 2 or PD04/30 set 2 or PD07/30 set 2 or PE01/30 set 2 or PE06/30 set 2 or PA00/27 set 4 or PA01/27 set 4 or PA02/27 set 4 or PA03/27 set 4 or PA05/27 set 4 or PA06/27 set 4 or PA08/27 set 4 or PA09/27 set 4 or PA10/27 set 4 or PA13/27 set 4 or PA14/27 set 4 or PB02/27 set 4 or PB03/27 set 4 or PB04/27 set 4 or PB06/27 set 4 or PB07/27 set 4 or PB10/27 set 4 or PB11/27 set 4 or PC07/27 set 4 or PC09/27 set 4 or PD03/27 set 4 or PD07/27 set 4 or PE01/27 set 4 or PE03/27 set 4; WO_IN0 PA00/1 set 1 or PA06/2 set 1 or PA11/3 set 1 or PB00/4 set 1 or PB06/5 set 1 or PB11/6 set 1 or PC00/7 set 1 or PD06/8 set 1 or PE00/9 set 1 or PE06/10 set 1 or PB01/11 set 1 or PC09/12 set 1 or PD03/13 set 1 or PE04/14 set 1 or PA03/15 set 1 or PA07/16 set 1 or PB04/17 set 1 or PB08/18 set 1 or PB12/19 set 1 or PA02/20 set 1 or PA10/21 set 1 or PA14/22 set 1 or PB03/23 set 1 or PB07/24 set 1 or PA09/25 set 1 or PA02/1 set 3 or PA08/2 set 3 or PA13/3 set 3 or PB02/4 set 3 or PB08/5 set 3 or PB13/6 set 3 or PC08/7 set 3 or PD02/8 set 3 or PE02/9 set 3 or PA04/10 set 3 or PB03/11 set 3 or PC01/12 set 3 or PD06/13 set 3 or PE00/14 set 3 or PA05/15 set 3 or PA09/16 set 3 or PB06/17 set 3 or PB10/18 set 3 or PA00/19 set 3 or PB01/20 set 3 or PB05/21 set 3 or PB09/22 set 3 or PA01/23 set 3 or PA12/24 set 3; WO_IN1 PA01/1 set 2 or PA07/2 set 2 or PA12/3 set 2 or PB01/4 set 2 or PB07/5 set 2 or PC01/6 set 2 or PC07/7 set 2 or PD07/8 set 2 or PE01/9 set 2 or PA03/10 set 2 or PB02/11 set 2 or PC00/12 set 2 or PD04/13 set 2 or PE06/14 set 2 or PA04/15 set 2 or PA08/16 set 2 or PB12/17 set 2 or PB05/18 set 2 or PB09/19 set 2 or PB13/20 set 2 or PB00/21 set 2 or PB04/22 set 2 or PB08/23 set 2 or PA00/24 set 2 or PA11/25 set 2 or PA03/1 set 4 or PA09/2 set 4 or PA14/3 set 4 or PB03/4 set 4 or PC09/5 set 4 or PD03/6 set 4 or PE03/7 set 4 or PA00/8 set 4 or PB04/9 set 4 or PC07/10 set 4 or PD07/11 set 4 or PE01/12 set 4 or PA06/13 set 4 or PA10/14 set 4 or PB07/15 set 4 or PB11/16 set 4 or PA01/17 set 4 or PA05/18 set 4 or PA13/19 set 4 or PB02/20 set 4 or PB06/21 set 4 or PB10/22 set 4 or PA08/23 set 4 or PA02/24 set 4
  parameters: GCLK_ID=10, DMAC_ID_OVF=53, DMAC_ID_MC0=54, DMAC_ID_MC1=55, INSTANCE_ID=11 (Instance index for TC6), MASTER_SLAVE_MODE=1, PAC_ID=11 (Index for TC6 registers write protection)
TC7 at 0x40003000 (TC)
  pins: WO_OUT0 PA00/25 set 1 or PA02/25 set 1 or PA03/25 set 1 or PA06/25 set 1 or PA07/25 set 1 or PA09/25 set 1 or PA10/25 set 1 or PA11/25 set 1 or PA14/25 set 1 or PB00/25 set 1 or PB01/25 set 1 or PB03/25 set 1 or PB04/25 set 1 or PB06/25 set 1 or PB07/25 set 1 or PB08/25 set 1 or PB11/25 set 1 or PB12/25 set 1 or PC00/25 set 1 or PC09/25 set 1 or PD03/25 set 1 or PD06/25 set 1 or PE00/25 set 1 or PE04/25 set 1 or PE06/25 set 1 or PA00/31 set 3 or PA01/31 set 3 or PA02/31 set 3 or PA04/31 set 3 or PA05/31 set 3 or PA08/31 set 3 or PA09/31 set 3 or PA12/31 set 3 or PA13/31 set 3 or PB01/31 set 3 or PB02/31 set 3 or PB03/31 set 3 or PB05/31 set 3 or PB06/31 set 3 or PB08/31 set 3 or PB09/31 set 3 or PB10/31 set 3 or PB13/31 set 3 or PC01/31 set 3 or PC08/31 set 3 or PD02/31 set 3 or PD06/31 set 3 or PE00/31 set 3 or PE02/31 set 3; WO_OUT1 PA00/31 set 2 or PA01/31 set 2 or PA03/31 set 2 or PA04/31 set 2 or PA07/31 set 2 or PA08/31 set 2 or PA11/31 set 2 or PA12/31 set 2 or PB00/31 set 2 or PB01/31 set 2 or PB02/31 set 2 or PB04/31 set 2 or PB05/31 set 2 or PB07/31 set 2 or PB08/31 set 2 or PB09/31 set 2 or PB12/31 set 2 or PB13/31 set 2 or PC00/31 set 2 or PC01/31 set 2 or PC07/31 set 2 or PD04/31 set 2 or PD07/31 set 2 or PE01/31 set 2 or PE06/31 set 2 or PA00/28 set 4 or PA01/28 set 4 or PA02/28 set 4 or PA03/28 set 4 or PA05/28 set 4 or PA06/28 set 4 or PA08/28 set 4 or PA09/28 set 4 or PA10/28 set 4 or PA13/28 set 4 or PA14/28 set 4 or PB02/28 set 4 or PB03/28 set 4 or PB04/28 set 4 or PB06/28 set 4 or PB07/28 set 4 or PB10/28 set 4 or PB11/28 set 4 or PC07/28 set 4 or PC09/28 set 4 or PD03/28 set 4 or PD07/28 set 4 or PE01/28 set 4 or PE03/28 set 4; WO_IN0 PA00/1 set 1 or PA06/2 set 1 or PA11/3 set 1 or PB00/4 set 1 or PB06/5 set 1 or PB11/6 set 1 or PC00/7 set 1 or PD06/8 set 1 or PE00/9 set 1 or PE06/10 set 1 or PB01/11 set 1 or PC09/12 set 1 or PD03/13 set 1 or PE04/14 set 1 or PA03/15 set 1 or PA07/16 set 1 or PB04/17 set 1 or PB08/18 set 1 or PB12/19 set 1 or PA02/20 set 1 or PA10/21 set 1 or PA14/22 set 1 or PB03/23 set 1 or PB07/24 set 1 or PA09/25 set 1 or PA02/1 set 3 or PA08/2 set 3 or PA13/3 set 3 or PB02/4 set 3 or PB08/5 set 3 or PB13/6 set 3 or PC08/7 set 3 or PD02/8 set 3 or PE02/9 set 3 or PA04/10 set 3 or PB03/11 set 3 or PC01/12 set 3 or PD06/13 set 3 or PE00/14 set 3 or PA05/15 set 3 or PA09/16 set 3 or PB06/17 set 3 or PB10/18 set 3 or PA00/19 set 3 or PB01/20 set 3 or PB05/21 set 3 or PB09/22 set 3 or PA01/23 set 3 or PA12/24 set 3; WO_IN1 PA01/1 set 2 or PA07/2 set 2 or PA12/3 set 2 or PB01/4 set 2 or PB07/5 set 2 or PC01/6 set 2 or PC07/7 set 2 or PD07/8 set 2 or PE01/9 set 2 or PA03/10 set 2 or PB02/11 set 2 or PC00/12 set 2 or PD04/13 set 2 or PE06/14 set 2 or PA04/15 set 2 or PA08/16 set 2 or PB12/17 set 2 or PB05/18 set 2 or PB09/19 set 2 or PB13/20 set 2 or PB00/21 set 2 or PB04/22 set 2 or PB08/23 set 2 or PA00/24 set 2 or PA11/25 set 2 or PA03/1 set 4 or PA09/2 set 4 or PA14/3 set 4 or PB03/4 set 4 or PC09/5 set 4 or PD03/6 set 4 or PE03/7 set 4 or PA00/8 set 4 or PB04/9 set 4 or PC07/10 set 4 or PD07/11 set 4 or PE01/12 set 4 or PA06/13 set 4 or PA10/14 set 4 or PB07/15 set 4 or PB11/16 set 4 or PA01/17 set 4 or PA05/18 set 4 or PA13/19 set 4 or PB02/20 set 4 or PB06/21 set 4 or PB10/22 set 4 or PA08/23 set 4 or PA02/24 set 4
  parameters: GCLK_ID=10, DMAC_ID_OVF=56, DMAC_ID_MC0=57, DMAC_ID_MC1=58, INSTANCE_ID=12 (Instance index for TC7), MASTER_SLAVE_MODE=2, PAC_ID=12 (Index for TC7 registers write protection)
TC8 at 0x46001000 (TC)
  pins: WO_OUT0 PA00/26 set 1 or PA02/26 set 1 or PA03/26 set 1 or PA06/26 set 1 or PA07/26 set 1 or PA09/26 set 1 or PA10/26 set 1 or PA11/26 set 1 or PA14/26 set 1 or PB00/26 set 1 or PB01/26 set 1 or PB03/26 set 1 or PB04/26 set 1 or PB06/26 set 1 or PB07/26 set 1 or PB08/26 set 1 or PB11/26 set 1 or PB12/26 set 1 or PC00/26 set 1 or PC09/26 set 1 or PD03/26 set 1 or PD06/26 set 1 or PE00/26 set 1 or PE04/26 set 1 or PE06/26 set 1 or PA00/32 set 3 or PA01/32 set 3 or PA02/32 set 3 or PA04/32 set 3 or PA05/32 set 3 or PA08/32 set 3 or PA09/32 set 3 or PA12/32 set 3 or PA13/32 set 3 or PB01/32 set 3 or PB02/32 set 3 or PB03/32 set 3 or PB05/32 set 3 or PB06/32 set 3 or PB08/32 set 3 or PB09/32 set 3 or PB10/32 set 3 or PB13/32 set 3 or PC01/32 set 3 or PC08/32 set 3 or PD02/32 set 3 or PD06/32 set 3 or PE00/32 set 3 or PE02/32 set 3; WO_OUT1 PA00/32 set 2 or PA01/32 set 2 or PA03/32 set 2 or PA04/32 set 2 or PA07/32 set 2 or PA08/32 set 2 or PA11/32 set 2 or PA12/32 set 2 or PB00/32 set 2 or PB01/32 set 2 or PB02/32 set 2 or PB04/32 set 2 or PB05/32 set 2 or PB07/32 set 2 or PB08/32 set 2 or PB09/32 set 2 or PB12/32 set 2 or PB13/32 set 2 or PC00/32 set 2 or PC01/32 set 2 or PC07/32 set 2 or PD04/32 set 2 or PD07/32 set 2 or PE01/32 set 2 or PE06/32 set 2 or PA01/10 set 5 or PA04/10 set 5 or PA10/10 set 5 or PA15/10 set 5 or PB00/10 set 5 or PB04/10 set 5 or PB10/10 set 5 or PB14/10 set 5 or PB15/10 set 5 or PC08/10 set 5 or PC10/10 set 5 or PC11/10 set 5 or PD00/10 set 5 or PD01/10 set 5 or PD02/10 set 5 or PD04/10 set 5 or PE02/10 set 5 or PE04/10 set 5; WO_IN0 PA00/1 set 1 or PA06/2 set 1 or PA11/3 set 1 or PB00/4 set 1 or PB06/5 set 1 or PB11/6 set 1 or PC00/7 set 1 or PD06/8 set 1 or PE00/9 set 1 or PE06/10 set 1 or PB01/11 set 1 or PC09/12 set 1 or PD03/13 set 1 or PE04/14 set 1 or PA03/15 set 1 or PA07/16 set 1 or PB04/17 set 1 or PB08/18 set 1 or PB12/19 set 1 or PA02/20 set 1 or PA10/21 set 1 or PA14/22 set 1 or PB03/23 set 1 or PB07/24 set 1 or PA09/25 set 1 or PA02/1 set 3 or PA08/2 set 3 or PA13/3 set 3 or PB02/4 set 3 or PB08/5 set 3 or PB13/6 set 3 or PC08/7 set 3 or PD02/8 set 3 or PE02/9 set 3 or PA04/10 set 3 or PB03/11 set 3 or PC01/12 set 3 or PD06/13 set 3 or PE00/14 set 3 or PA05/15 set 3 or PA09/16 set 3 or PB06/17 set 3 or PB10/18 set 3 or PA00/19 set 3 or PB01/20 set 3 or PB05/21 set 3 or PB09/22 set 3 or PA01/23 set 3 or PA12/24 set 3; WO_IN1 PA01/1 set 2 or PA07/2 set 2 or PA12/3 set 2 or PB01/4 set 2 or PB07/5 set 2 or PC01/6 set 2 or PC07/7 set 2 or PD07/8 set 2 or PE01/9 set 2 or PA03/10 set 2 or PB02/11 set 2 or PC00/12 set 2 or PD04/13 set 2 or PE06/14 set 2 or PA04/15 set 2 or PA08/16 set 2 or PB12/17 set 2 or PB05/18 set 2 or PB09/19 set 2 or PB13/20 set 2 or PB00/21 set 2 or PB04/22 set 2 or PB08/23 set 2 or PA00/24 set 2 or PA11/25 set 2 or PA04/1 set 5 or PA10/2 set 5 or PB04/3 set 5 or PB10/4 set 5 or PD04/5 set 5 or PE04/6 set 5 or PA01/7 set 5 or PB00/8 set 5 or PC08/9 set 5 or PD02/10 set 5 or PE02/11 set 5 or PC10/12 set 5 or PC11/13 set 5 or PA15/14 set 5 or PB14/15 set 5 or PB15/16 set 5 or PD00/17 set 5 or PD01/18 set 5
  parameters: GCLK_ID=11, DMAC_ID_OVF=59, DMAC_ID_MC0=60, DMAC_ID_MC1=61, INSTANCE_ID=100 (Instance index for TC8), PAC_ID=100 (Index for TC8 registers write protection), MASTER_SLAVE_MODE=1
TC9 at 0x46001400 (TC)
  pins: WO_OUT0 PA00/33 set 2 or PA01/33 set 2 or PA03/33 set 2 or PA04/33 set 2 or PA07/33 set 2 or PA08/33 set 2 or PA11/33 set 2 or PA12/33 set 2 or PB00/33 set 2 or PB01/33 set 2 or PB02/33 set 2 or PB04/33 set 2 or PB05/33 set 2 or PB07/33 set 2 or PB08/33 set 2 or PB09/33 set 2 or PB12/33 set 2 or PB13/33 set 2 or PC00/33 set 2 or PC01/33 set 2 or PC07/33 set 2 or PD04/33 set 2 or PD07/33 set 2 or PE01/33 set 2 or PE06/33 set 2 or PA00/29 set 4 or PA01/29 set 4 or PA02/29 set 4 or PA03/29 set 4 or PA05/29 set 4 or PA06/29 set 4 or PA08/29 set 4 or PA09/29 set 4 or PA10/29 set 4 or PA13/29 set 4 or PA14/29 set 4 or PB02/29 set 4 or PB03/29 set 4 or PB04/29 set 4 or PB06/29 set 4 or PB07/29 set 4 or PB10/29 set 4 or PB11/29 set 4 or PC07/29 set 4 or PC09/29 set 4 or PD03/29 set 4 or PD07/29 set 4 or PE01/29 set 4 or PE03/29 set 4; WO_OUT1 PA00/33 set 3 or PA01/33 set 3 or PA02/33 set 3 or PA04/33 set 3 or PA05/33 set 3 or PA08/33 set 3 or PA09/33 set 3 or PA12/33 set 3 or PA13/33 set 3 or PB01/33 set 3 or PB02/33 set 3 or PB03/33 set 3 or PB05/33 set 3 or PB06/33 set 3 or PB08/33 set 3 or PB09/33 set 3 or PB10/33 set 3 or PB13/33 set 3 or PC01/33 set 3 or PC08/33 set 3 or PD02/33 set 3 or PD06/33 set 3 or PE00/33 set 3 or PE02/33 set 3 or PA01/11 set 5 or PA04/11 set 5 or PA10/11 set 5 or PA15/11 set 5 or PB00/11 set 5 or PB04/11 set 5 or PB10/11 set 5 or PB14/11 set 5 or PB15/11 set 5 or PC08/11 set 5 or PC10/11 set 5 or PC11/11 set 5 or PD00/11 set 5 or PD01/11 set 5 or PD02/11 set 5 or PD04/11 set 5 or PE02/11 set 5 or PE04/11 set 5; WO_IN0 PA01/1 set 2 or PA07/2 set 2 or PA12/3 set 2 or PB01/4 set 2 or PB07/5 set 2 or PC01/6 set 2 or PC07/7 set 2 or PD07/8 set 2 or PE01/9 set 2 or PA03/10 set 2 or PB02/11 set 2 or PC00/12 set 2 or PD04/13 set 2 or PE06/14 set 2 or PA04/15 set 2 or PA08/16 set 2 or PB12/17 set 2 or PB05/18 set 2 or PB09/19 set 2 or PB13/20 set 2 or PB00/21 set 2 or PB04/22 set 2 or PB08/23 set 2 or PA00/24 set 2 or PA11/25 set 2 or PA03/1 set 4 or PA09/2 set 4 or PA14/3 set 4 or PB03/4 set 4 or PC09/5 set 4 or PD03/6 set 4 or PE03/7 set 4 or PA00/8 set 4 or PB04/9 set 4 or PC07/10 set 4 or PD07/11 set 4 or PE01/12 set 4 or PA06/13 set 4 or PA10/14 set 4 or PB07/15 set 4 or PB11/16 set 4 or PA01/17 set 4 or PA05/18 set 4 or PA13/19 set 4 or PB02/20 set 4 or PB06/21 set 4 or PB10/22 set 4 or PA08/23 set 4 or PA02/24 set 4; WO_IN1 PA02/1 set 3 or PA08/2 set 3 or PA13/3 set 3 or PB02/4 set 3 or PB08/5 set 3 or PB13/6 set 3 or PC08/7 set 3 or PD02/8 set 3 or PE02/9 set 3 or PA04/10 set 3 or PB03/11 set 3 or PC01/12 set 3 or PD06/13 set 3 or PE00/14 set 3 or PA05/15 set 3 or PA09/16 set 3 or PB06/17 set 3 or PB10/18 set 3 or PA00/19 set 3 or PB01/20 set 3 or PB05/21 set 3 or PB09/22 set 3 or PA01/23 set 3 or PA12/24 set 3 or PA04/1 set 5 or PA10/2 set 5 or PB04/3 set 5 or PB10/4 set 5 or PD04/5 set 5 or PE04/6 set 5 or PA01/7 set 5 or PB00/8 set 5 or PC08/9 set 5 or PD02/10 set 5 or PE02/11 set 5 or PC10/12 set 5 or PC11/13 set 5 or PA15/14 set 5 or PB14/15 set 5 or PB15/16 set 5 or PD00/17 set 5 or PD01/18 set 5
  parameters: GCLK_ID=11, DMAC_ID_OVF=62, DMAC_ID_MC0=63, DMAC_ID_MC1=64, INSTANCE_ID=101 (Instance index for TC9), PAC_ID=101 (Index for TC9 registers write protection), MASTER_SLAVE_MODE=2
TCC0 at 0x40003400 (TCC)
  pins: WO0 PA00/13 set 1 or PA02/13 set 1 or PA03/13 set 1 or PA06/13 set 1 or PA07/13 set 1 or PA09/13 set 1 or PA10/13 set 1 or PA11/13 set 1 or PA14/13 set 1 or PB00/13 set 1 or PB01/13 set 1 or PB03/13 set 1 or PB04/13 set 1 or PB06/13 set 1 or PB07/13 set 1 or PB08/13 set 1 or PB11/13 set 1 or PB12/13 set 1 or PC00/13 set 1 or PC09/13 set 1 or PD03/13 set 1 or PD06/13 set 1 or PE00/13 set 1 or PE04/13 set 1 or PE06/13 set 1 or PA00/18 set 3 or PA01/18 set 3 or PA02/18 set 3 or PA04/18 set 3 or PA05/18 set 3 or PA08/18 set 3 or PA09/18 set 3 or PA12/18 set 3 or PA13/18 set 3 or PB01/18 set 3 or PB02/18 set 3 or PB03/18 set 3 or PB05/18 set 3 or PB06/18 set 3 or PB08/18 set 3 or PB09/18 set 3 or PB10/18 set 3 or PB13/18 set 3 or PC01/18 set 3 or PC08/18 set 3 or PD02/18 set 3 or PD06/18 set 3 or PE00/18 set 3 or PE02/18 set 3; WO4 PA00/14 set 1 or PA02/14 set 1 or PA03/14 set 1 or PA06/14 set 1 or PA07/14 set 1 or PA09/14 set 1 or PA10/14 set 1 or PA11/14 set 1 or PA14/14 set 1 or PB00/14 set 1 or PB01/14 set 1 or PB03/14 set 1 or PB04/14 set 1 or PB06/14 set 1 or PB07/14 set 1 or PB08/14 set 1 or PB11/14 set 1 or PB12/14 set 1 or PC00/14 set 1 or PC09/14 set 1 or PD03/14 set 1 or PD06/14 set 1 or PE00/14 set 1 or PE04/14 set 1 or PE06/14 set 1 or PA00/19 set 3 or PA01/19 set 3 or PA02/19 set 3 or PA04/19 set 3 or PA05/19 set 3 or PA08/19 set 3 or PA09/19 set 3 or PA12/19 set 3 or PA13/19 set 3 or PB01/19 set 3 or PB02/19 set 3 or PB03/19 set 3 or PB05/19 set 3 or PB06/19 set 3 or PB08/19 set 3 or PB09/19 set 3 or PB10/19 set 3 or PB13/19 set 3 or PC01/19 set 3 or PC08/19 set 3 or PD02/19 set 3 or PD06/19 set 3 or PE00/19 set 3 or PE02/19 set 3 or PA01/4 set 5 or PA04/4 set 5 or PA10/4 set 5 or PA15/4 set 5 or PB00/4 set 5 or PB04/4 set 5 or PB10/4 set 5 or PB14/4 set 5 or PB15/4 set 5 or PC08/4 set 5 or PC10/4 set 5 or PC11/4 set 5 or PD00/4 set 5 or PD01/4 set 5 or PD02/4 set 5 or PD04/4 set 5 or PE02/4 set 5 or PE04/4 set 5; WO1 PA00/17 set 2 or PA01/17 set 2 or PA03/17 set 2 or PA04/17 set 2 or PA07/17 set 2 or PA08/17 set 2 or PA11/17 set 2 or PA12/17 set 2 or PB00/17 set 2 or PB01/17 set 2 or PB02/17 set 2 or PB04/17 set 2 or PB05/17 set 2 or PB07/17 set 2 or PB08/17 set 2 or PB09/17 set 2 or PB12/17 set 2 or PB13/17 set 2 or PC00/17 set 2 or PC01/17 set 2 or PC07/17 set 2 or PD04/17 set 2 or PD07/17 set 2 or PE01/17 set 2 or PE06/17 set 2 or PA00/15 set 4 or PA01/15 set 4 or PA02/15 set 4 or PA03/15 set 4 or PA05/15 set 4 or PA06/15 set 4 or PA08/15 set 4 or PA09/15 set 4 or PA10/15 set 4 or PA13/15 set 4 or PA14/15 set 4 or PB02/15 set 4 or PB03/15 set 4 or PB04/15 set 4 or PB06/15 set 4 or PB07/15 set 4 or PB10/15 set 4 or PB11/15 set 4 or PC07/15 set 4 or PC09/15 set 4 or PD03/15 set 4 or PD07/15 set 4 or PE01/15 set 4 or PE03/15 set 4 or PA01/6 set 5 or PA04/6 set 5 or PA10/6 set 5 or PA15/6 set 5 or PB00/6 set 5 or PB04/6 set 5 or PB10/6 set 5 or PB14/6 set 5 or PB15/6 set 5 or PC08/6 set 5 or PC10/6 set 5 or PC11/6 set 5 or PD00/6 set 5 or PD01/6 set 5 or PD02/6 set 5 or PD04/6 set 5 or PE02/6 set 5 or PE04/6 set 5; WO3 PA00/19 set 2 or PA01/19 set 2 or PA03/19 set 2 or PA04/19 set 2 or PA07/19 set 2 or PA08/19 set 2 or PA11/19 set 2 or PA12/19 set 2 or PB00/19 set 2 or PB01/19 set 2 or PB02/19 set 2 or PB04/19 set 2 or PB05/19 set 2 or PB07/19 set 2 or PB08/19 set 2 or PB09/19 set 2 or PB12/19 set 2 or PB13/19 set 2 or PC00/19 set 2 or PC01/19 set 2 or PC07/19 set 2 or PD04/19 set 2 or PD07/19 set 2 or PE01/19 set 2 or PE06/19 set 2 or PA00/14 set 4 or PA01/14 set 4 or PA02/14 set 4 or PA03/14 set 4 or PA05/14 set 4 or PA06/14 set 4 or PA08/14 set 4 or PA09/14 set 4 or PA10/14 set 4 or PA13/14 set 4 or PA14/14 set 4 or PB02/14 set 4 or PB03/14 set 4 or PB04/14 set 4 or PB06/14 set 4 or PB07/14 set 4 or PB10/14 set 4 or PB11/14 set 4 or PC07/14 set 4 or PC09/14 set 4 or PD03/14 set 4 or PD07/14 set 4 or PE01/14 set 4 or PE03/14 set 4; WO5 PA00/18 set 2 or PA01/18 set 2 or PA03/18 set 2 or PA04/18 set 2 or PA07/18 set 2 or PA08/18 set 2 or PA11/18 set 2 or PA12/18 set 2 or PB00/18 set 2 or PB01/18 set 2 or PB02/18 set 2 or PB04/18 set 2 or PB05/18 set 2 or PB07/18 set 2 or PB08/18 set 2 or PB09/18 set 2 or PB12/18 set 2 or PB13/18 set 2 or PC00/18 set 2 or PC01/18 set 2 or PC07/18 set 2 or PD04/18 set 2 or PD07/18 set 2 or PE01/18 set 2 or PE06/18 set 2 or PA00/16 set 4 or PA01/16 set 4 or PA02/16 set 4 or PA03/16 set 4 or PA05/16 set 4 or PA06/16 set 4 or PA08/16 set 4 or PA09/16 set 4 or PA10/16 set 4 or PA13/16 set 4 or PA14/16 set 4 or PB02/16 set 4 or PB03/16 set 4 or PB04/16 set 4 or PB06/16 set 4 or PB07/16 set 4 or PB10/16 set 4 or PB11/16 set 4 or PC07/16 set 4 or PC09/16 set 4 or PD03/16 set 4 or PD07/16 set 4 or PE01/16 set 4 or PE03/16 set 4; WO2 PA00/17 set 3 or PA01/17 set 3 or PA02/17 set 3 or PA04/17 set 3 or PA05/17 set 3 or PA08/17 set 3 or PA09/17 set 3 or PA12/17 set 3 or PA13/17 set 3 or PB01/17 set 3 or PB02/17 set 3 or PB03/17 set 3 or PB05/17 set 3 or PB06/17 set 3 or PB08/17 set 3 or PB09/17 set 3 or PB10/17 set 3 or PB13/17 set 3 or PC01/17 set 3 or PC08/17 set 3 or PD02/17 set 3 or PD06/17 set 3 or PE00/17 set 3 or PE02/17 set 3 or PA01/5 set 5 or PA04/5 set 5 or PA10/5 set 5 or PA15/5 set 5 or PB00/5 set 5 or PB04/5 set 5 or PB10/5 set 5 or PB14/5 set 5 or PB15/5 set 5 or PC08/5 set 5 or PC10/5 set 5 or PC11/5 set 5 or PD00/5 set 5 or PD01/5 set 5 or PD02/5 set 5 or PD04/5 set 5 or PE02/5 set 5 or PE04/5 set 5
  parameters: GCLK_ID=24, DMAC_ID_OVF=18, DMAC_ID_MC{n}={n+19} (n=0..5), SIZE=24, MASTER_SLAVE_MODE=1, CC_NUM=6, OW_NUM=6, DITHERING=1, OTMX=1, DTI=2, SWAP=4, PG=8, INSTANCE_ID=13 (Instance index for TCC0), PAC_ID=13 (Index for TCC0 registers write protection)
TCC1 at 0x40003800 (TCC)
  pins: WO0 PA00/15 set 1 or PA02/15 set 1 or PA03/15 set 1 or PA06/15 set 1 or PA07/15 set 1 or PA09/15 set 1 or PA10/15 set 1 or PA11/15 set 1 or PA14/15 set 1 or PB00/15 set 1 or PB01/15 set 1 or PB03/15 set 1 or PB04/15 set 1 or PB06/15 set 1 or PB07/15 set 1 or PB08/15 set 1 or PB11/15 set 1 or PB12/15 set 1 or PC00/15 set 1 or PC09/15 set 1 or PD03/15 set 1 or PD06/15 set 1 or PE00/15 set 1 or PE04/15 set 1 or PE06/15 set 1 or PA00/21 set 3 or PA01/21 set 3 or PA02/21 set 3 or PA04/21 set 3 or PA05/21 set 3 or PA08/21 set 3 or PA09/21 set 3 or PA12/21 set 3 or PA13/21 set 3 or PB01/21 set 3 or PB02/21 set 3 or PB03/21 set 3 or PB05/21 set 3 or PB06/21 set 3 or PB08/21 set 3 or PB09/21 set 3 or PB10/21 set 3 or PB13/21 set 3 or PC01/21 set 3 or PC08/21 set 3 or PD02/21 set 3 or PD06/21 set 3 or PE00/21 set 3 or PE02/21 set 3; WO4 PA00/16 set 1 or PA02/16 set 1 or PA03/16 set 1 or PA06/16 set 1 or PA07/16 set 1 or PA09/16 set 1 or PA10/16 set 1 or PA11/16 set 1 or PA14/16 set 1 or PB00/16 set 1 or PB01/16 set 1 or PB03/16 set 1 or PB04/16 set 1 or PB06/16 set 1 or PB07/16 set 1 or PB08/16 set 1 or PB11/16 set 1 or PB12/16 set 1 or PC00/16 set 1 or PC09/16 set 1 or PD03/16 set 1 or PD06/16 set 1 or PE00/16 set 1 or PE04/16 set 1 or PE06/16 set 1 or PA00/22 set 3 or PA01/22 set 3 or PA02/22 set 3 or PA04/22 set 3 or PA05/22 set 3 or PA08/22 set 3 or PA09/22 set 3 or PA12/22 set 3 or PA13/22 set 3 or PB01/22 set 3 or PB02/22 set 3 or PB03/22 set 3 or PB05/22 set 3 or PB06/22 set 3 or PB08/22 set 3 or PB09/22 set 3 or PB10/22 set 3 or PB13/22 set 3 or PC01/22 set 3 or PC08/22 set 3 or PD02/22 set 3 or PD06/22 set 3 or PE00/22 set 3 or PE02/22 set 3 or PA01/7 set 5 or PA04/7 set 5 or PA10/7 set 5 or PA15/7 set 5 or PB00/7 set 5 or PB04/7 set 5 or PB10/7 set 5 or PB14/7 set 5 or PB15/7 set 5 or PC08/7 set 5 or PC10/7 set 5 or PC11/7 set 5 or PD00/7 set 5 or PD01/7 set 5 or PD02/7 set 5 or PD04/7 set 5 or PE02/7 set 5 or PE04/7 set 5; WO1 PA00/20 set 2 or PA01/20 set 2 or PA03/20 set 2 or PA04/20 set 2 or PA07/20 set 2 or PA08/20 set 2 or PA11/20 set 2 or PA12/20 set 2 or PB00/20 set 2 or PB01/20 set 2 or PB02/20 set 2 or PB04/20 set 2 or PB05/20 set 2 or PB07/20 set 2 or PB08/20 set 2 or PB09/20 set 2 or PB12/20 set 2 or PB13/20 set 2 or PC00/20 set 2 or PC01/20 set 2 or PC07/20 set 2 or PD04/20 set 2 or PD07/20 set 2 or PE01/20 set 2 or PE06/20 set 2 or PA00/18 set 4 or PA01/18 set 4 or PA02/18 set 4 or PA03/18 set 4 or PA05/18 set 4 or PA06/18 set 4 or PA08/18 set 4 or PA09/18 set 4 or PA10/18 set 4 or PA13/18 set 4 or PA14/18 set 4 or PB02/18 set 4 or PB03/18 set 4 or PB04/18 set 4 or PB06/18 set 4 or PB07/18 set 4 or PB10/18 set 4 or PB11/18 set 4 or PC07/18 set 4 or PC09/18 set 4 or PD03/18 set 4 or PD07/18 set 4 or PE01/18 set 4 or PE03/18 set 4 or PA01/9 set 5 or PA04/9 set 5 or PA10/9 set 5 or PA15/9 set 5 or PB00/9 set 5 or PB04/9 set 5 or PB10/9 set 5 or PB14/9 set 5 or PB15/9 set 5 or PC08/9 set 5 or PC10/9 set 5 or PC11/9 set 5 or PD00/9 set 5 or PD01/9 set 5 or PD02/9 set 5 or PD04/9 set 5 or PE02/9 set 5 or PE04/9 set 5; WO3 PA00/22 set 2 or PA01/22 set 2 or PA03/22 set 2 or PA04/22 set 2 or PA07/22 set 2 or PA08/22 set 2 or PA11/22 set 2 or PA12/22 set 2 or PB00/22 set 2 or PB01/22 set 2 or PB02/22 set 2 or PB04/22 set 2 or PB05/22 set 2 or PB07/22 set 2 or PB08/22 set 2 or PB09/22 set 2 or PB12/22 set 2 or PB13/22 set 2 or PC00/22 set 2 or PC01/22 set 2 or PC07/22 set 2 or PD04/22 set 2 or PD07/22 set 2 or PE01/22 set 2 or PE06/22 set 2 or PA00/17 set 4 or PA01/17 set 4 or PA02/17 set 4 or PA03/17 set 4 or PA05/17 set 4 or PA06/17 set 4 or PA08/17 set 4 or PA09/17 set 4 or PA10/17 set 4 or PA13/17 set 4 or PA14/17 set 4 or PB02/17 set 4 or PB03/17 set 4 or PB04/17 set 4 or PB06/17 set 4 or PB07/17 set 4 or PB10/17 set 4 or PB11/17 set 4 or PC07/17 set 4 or PC09/17 set 4 or PD03/17 set 4 or PD07/17 set 4 or PE01/17 set 4 or PE03/17 set 4; WO5 PA00/21 set 2 or PA01/21 set 2 or PA03/21 set 2 or PA04/21 set 2 or PA07/21 set 2 or PA08/21 set 2 or PA11/21 set 2 or PA12/21 set 2 or PB00/21 set 2 or PB01/21 set 2 or PB02/21 set 2 or PB04/21 set 2 or PB05/21 set 2 or PB07/21 set 2 or PB08/21 set 2 or PB09/21 set 2 or PB12/21 set 2 or PB13/21 set 2 or PC00/21 set 2 or PC01/21 set 2 or PC07/21 set 2 or PD04/21 set 2 or PD07/21 set 2 or PE01/21 set 2 or PE06/21 set 2 or PA00/19 set 4 or PA01/19 set 4 or PA02/19 set 4 or PA03/19 set 4 or PA05/19 set 4 or PA06/19 set 4 or PA08/19 set 4 or PA09/19 set 4 or PA10/19 set 4 or PA13/19 set 4 or PA14/19 set 4 or PB02/19 set 4 or PB03/19 set 4 or PB04/19 set 4 or PB06/19 set 4 or PB07/19 set 4 or PB10/19 set 4 or PB11/19 set 4 or PC07/19 set 4 or PC09/19 set 4 or PD03/19 set 4 or PD07/19 set 4 or PE01/19 set 4 or PE03/19 set 4; WO2 PA00/20 set 3 or PA01/20 set 3 or PA02/20 set 3 or PA04/20 set 3 or PA05/20 set 3 or PA08/20 set 3 or PA09/20 set 3 or PA12/20 set 3 or PA13/20 set 3 or PB01/20 set 3 or PB02/20 set 3 or PB03/20 set 3 or PB05/20 set 3 or PB06/20 set 3 or PB08/20 set 3 or PB09/20 set 3 or PB10/20 set 3 or PB13/20 set 3 or PC01/20 set 3 or PC08/20 set 3 or PD02/20 set 3 or PD06/20 set 3 or PE00/20 set 3 or PE02/20 set 3 or PA01/8 set 5 or PA04/8 set 5 or PA10/8 set 5 or PA15/8 set 5 or PB00/8 set 5 or PB04/8 set 5 or PB10/8 set 5 or PB14/8 set 5 or PB15/8 set 5 or PC08/8 set 5 or PC10/8 set 5 or PC11/8 set 5 or PD00/8 set 5 or PD01/8 set 5 or PD02/8 set 5 or PD04/8 set 5 or PE02/8 set 5 or PE04/8 set 5
  parameters: GCLK_ID=25, DMAC_ID_OVF=25, DMAC_ID_MC{n}={n+26} (n=0..5), SIZE=24, MASTER_SLAVE_MODE=2, CC_NUM=6, OW_NUM=6, DITHERING=1, OTMX=1, DTI=2, SWAP=4, PG=8, INSTANCE_ID=14 (Instance index for TCC1), PAC_ID=14 (Index for TCC1 registers write protection)
TCC2 at 0x40003C00 (TCC)
  pins: WO0 PA00/17 set 1 or PA02/17 set 1 or PA03/17 set 1 or PA06/17 set 1 or PA07/17 set 1 or PA09/17 set 1 or PA10/17 set 1 or PA11/17 set 1 or PA14/17 set 1 or PB00/17 set 1 or PB01/17 set 1 or PB03/17 set 1 or PB04/17 set 1 or PB06/17 set 1 or PB07/17 set 1 or PB08/17 set 1 or PB11/17 set 1 or PB12/17 set 1 or PC00/17 set 1 or PC09/17 set 1 or PD03/17 set 1 or PD06/17 set 1 or PE00/17 set 1 or PE04/17 set 1 or PE06/17 set 1 or PA00/23 set 3 or PA01/23 set 3 or PA02/23 set 3 or PA04/23 set 3 or PA05/23 set 3 or PA08/23 set 3 or PA09/23 set 3 or PA12/23 set 3 or PA13/23 set 3 or PB01/23 set 3 or PB02/23 set 3 or PB03/23 set 3 or PB05/23 set 3 or PB06/23 set 3 or PB08/23 set 3 or PB09/23 set 3 or PB10/23 set 3 or PB13/23 set 3 or PC01/23 set 3 or PC08/23 set 3 or PD02/23 set 3 or PD06/23 set 3 or PE00/23 set 3 or PE02/23 set 3; WO1 PA00/23 set 2 or PA01/23 set 2 or PA03/23 set 2 or PA04/23 set 2 or PA07/23 set 2 or PA08/23 set 2 or PA11/23 set 2 or PA12/23 set 2 or PB00/23 set 2 or PB01/23 set 2 or PB02/23 set 2 or PB04/23 set 2 or PB05/23 set 2 or PB07/23 set 2 or PB08/23 set 2 or PB09/23 set 2 or PB12/23 set 2 or PB13/23 set 2 or PC00/23 set 2 or PC01/23 set 2 or PC07/23 set 2 or PD04/23 set 2 or PD07/23 set 2 or PE01/23 set 2 or PE06/23 set 2 or PA00/20 set 4 or PA01/20 set 4 or PA02/20 set 4 or PA03/20 set 4 or PA05/20 set 4 or PA06/20 set 4 or PA08/20 set 4 or PA09/20 set 4 or PA10/20 set 4 or PA13/20 set 4 or PA14/20 set 4 or PB02/20 set 4 or PB03/20 set 4 or PB04/20 set 4 or PB06/20 set 4 or PB07/20 set 4 or PB10/20 set 4 or PB11/20 set 4 or PC07/20 set 4 or PC09/20 set 4 or PD03/20 set 4 or PD07/20 set 4 or PE01/20 set 4 or PE03/20 set 4
  parameters: GCLK_ID=25, DMAC_ID_OVF=32, DMAC_ID_MC0=33, DMAC_ID_MC1=34, SIZE=16, MASTER_SLAVE_MODE=0, CC_NUM=2, OW_NUM=2, DITHERING=1, OTMX=1, DTI=2, SWAP=4, PG=8, INSTANCE_ID=15 (Instance index for TCC2), PAC_ID=15 (Index for TCC2 registers write protection)
TPI at 0xE0040000
USB at 0x44010000
  pins: Dplus USB_DP; Dmins USB_DM; TSTRCV PE2/USB_TEST_MODES; TSTUOE PE3/USB_TEST_MODES; TSTVMI PE4/USB_TEST_MODES; TSTVMO PE5/USB_TEST_MODES; TSTVPI PE6/USB_TEST_MODES; TSTVPO PD5/USB_TEST_MODES; USBID PA4; USBOEN PB10; VBUS VBUS/USB_POWER_SUPPLY; VBUSON PA7/USB_CHARGE_PUMP; VUSB3V3 VDDUSB/USB_POWER_SUPPLY
  parameters: USB_FPB_ADDRL=0, USB_FPB_ADDRH=0xfff
WDT at 0x44000500
  parameters: UPB_ADDRL=0x500 (See Table 3-21), MAX_RUN_PS=20, MAX_SLEEP_PS=20, WINDOW_WDT=1 (enabled)
ZIGBEE at 0x41010000

## Interrupts
-15 Reset — Reset Vector, invoked on Power up and warm reset
-14 NonMaskableInt — Non maskable Interrupt, cannot be stopped or preempted
-13 HardFault — Hard Fault, all classes of Fault
-12 MemoryManagement — Memory Management, MPU mismatch, including Access Violation and No Match
-11 BusFault — Bus Fault, Pre-Fetch-, Memory Access Fault, other address/memory related Fault
-10 UsageFault — Usage Fault, i.e. Undef Instruction, Illegal State Transition
-5 SVCall — System Service Call via SVC instruction
-4 DebugMonitor
-2 PendSV — Pendable request for system service
-1 SysTick — System Tick Timer
0 RTC — Real Time Counter
1 EIC — External Interrupt Controller
2 FREQM — Frequency Meter
3 NVM — Non-Volatile Memory
4 CHANGE_NOTICE_A (GPIOA) — PORT_A_INPUT_CHANGE_INTERRUPT
5 CHANGE_NOTICE_B (GPIOB) — PORT_B_INPUT_CHANGE_INTERRUPT
6 CHANGE_NOTICE_C (GPIOC) — PORT_C_INPUT_CHANGE_INTERRUPT
7 CHANGE_NOTICE_D (GPIOD) — PORT_D_INPUT_CHANGE_INTERRUPT
8 CHANGE_NOTICE_E (GPIOE) — PORT_E_INPUT_CHANGE_INTERRUPT
9 DMAC_0_3 (DMAC) — DMA Channel 0..3
10 DMAC_4_15 (DMAC) — DMA Channel 4..15
11 EVSYS_0_3 (EVSYS) — Event System Channel 0..3
12 EVSYS_4_11 (EVSYS) — Event System Channel 4..11
13 PAC — Peripheral Access Controller
14 RAMECC — RAM Error Correction Code
15 SERCOM0 — Serial Communication Interface 0
16 SERCOM1 — Serial Communication Interface 1
17 SERCOM2 — Serial Communication Interface 2
18 SERCOM3 — Serial Communication Interface 3
19 SERCOM4 — Serial Communication Interface 4
20 SERCOM5 — Serial Communication Interface 5
21 SERCOM6 — Serial Communication Interface 6
22 TCC0 — Timer/Counter for Control Applications 0
23 TCC1 — Timer/Counter for Control Applications 1
24 TCC2 — Timer/Counter for Control Applications 2
{n+25} TC{n} (n=0..9) — Timer/Counter {n}
35 ADCHS_IRQ (ADCHS) — Analog-to-Digital Converter
36 ADCHS_FAULT (ADCHS) — ADC Fault Interrupt
37 ADCHS_FCC (ADCHS) — ADC FCC Interrupt
38 ADCHS_BGVR_RDY (ADCHS) — ADC BGVR Ready
39 AC — Analog Comparators
40 CRYPTO_0 (CRYPTO)
41 CRYPTO_1 (CRYPTO)
42 QSPI — Quad SPI interface
43 ZB_INT0 (ZIGBEE) — ZIGBEE
44 BT_INT0 (BLE) — Bluetooth 0
45 BT_INT1 (BLE) — Bluetooth 1
46 ARBITER (ARB) — Radio Arbiter
47 CLKI_WAKEUP_NMI (BLE) — WSS WAKEUP
48 CVD — CVD Interrpt
49 CRYPTO_2 (CRYPTO)
50 QEI
51 CAN0
52 CAN1
53 ETH — Ethernet
54 USB
55 PLL_LOCK_BOOT (BTZBSYS) — Boot PLL Lock
56 PLL_LOCK_USER (BTZBSYS) — User PLL Lock
57 BT_LC (BLE) — Bluetooth LC

## Event generators
{n+1} RTC_PER_{n} (n=0..7), {n+9} RTC_CMP_{n} (n=0..3), 13 RTC_TAMPER, 14 RTC_OVF, {n+15} EIC_EXTINT_{n} (n=0..3), {n+19} DMAC_CH_{n} (n=0..3), 23 PAC_ACCERR, {9n+24} TCC{n}_OVF (n=0..2), {9n+25} TCC{n}_TRG (n=0..2), {9n+26} TCC{n}_CNT (n=0..2), {n+27} TCC0_MCX_{n} (n=0..5), {n+36} TCC1_MCX_{n} (n=0..5), 45 TCC2_MCX_0, 46 TCC2_MCX_1, {3n+47} TC{n}_OVF (n=0..9), {3n+48} TC{n}_MCX_0 (n=0..9), {3n+49} TC{n}_MCX_1 (n=0..9), 77 ADCHS_EVENT_0, 80 AC_COMP_0, 81 AC_COMP_1, 82 AC_WIN, 84 CCL_LUTOUT_0, 85 CCL_LUTOUT_1, 86 ZIGBEE_TX_TS_ACTIVE, 87 ZIGBEE_RX_TS_ACTIVE, 88 GMAC_TSU_CMP, 89 QEI0

## Event users
0 RTC_TAMPER, {n+1} DMAC_CH_{n} (n=0..7), 9 CM4_TRACE_START, 10 CM4_TRACE_STOP, 11 CM4_TRACE_TRIG, {8n+12} TCC{n}_EV0 (n=0..2), {8n+13} TCC{n}_EV1 (n=0..2), {n+14} TCC0_MC{n} (n=0..5), {n+22} TCC1_MC{n} (n=0..5), 30 TCC2_MC0, 31 TCC2_MC1, {n+32} TC{n}_EVU (n=0..9), {n+37} ADCHS_TRIG_{n} (n=5..16), 54 AC_SOC_0, 55 AC_SOC_1, 56 CCL_LUTIN_0, 57 CCL_LUTIN_1, 58 CVD_TRIGGER

## Properties
SIGNATURES: DSU_DID=0x0001A800

## Pinouts (pin number, pad)
DQFN132: 1 NC, 2 NC, 3 NC, 4 PA0, 5 VPMU_VDD, 6 NC, 7 PA1, 8 PA2, 9 PA5, 10 PD0, 11 PD1, 12 VDD, 13 NC, 14 PA6, 15 NC, 16 PA7, 17 NC, 18 PA8, 19 NC, 20 PA9, 21 NC, 22 VDD, 23 NC, 24 PA10, 25 PB12, 26 PE2, 27 PC9, 28 PC8, 29 PC10, 30 PE3, 31 NC, 32 NC, 33 NC, 34 NC, 35 NC, 36 NC, 37 PB9, 38 PB13, 39 PA4, 40 PB8, 41 PA14, 42 PA13, 43 VDD, 44 VDD, 45 PC1, 46 PC0, 47 PE1, 48 PE0, 49 PB11, 50 NC, 51 PB10, 52 NC, 53 NC, 54 NC, 55 NC, 56 NC, 57 CLDO_IN, 58 NC, 59 XO_N, 60 NC, 61 XO_P, 62 NC, 63 VDD_RF, 64 NC, 65 NC, 66 NC, 67 NC, 68 NC, 69 NC, 70 CLDO_OUT, 71 NC, 72 RFLDO_OUT, 73 NC, 74 CLDO_BUCK, 75 NC, 76 BUCK_PA, 77 NC, 78 RFIO, 79 NC, 80 NC, 81 PD2, 82 PE6, 83 PE5, 84 PE4, 85 PC11, 86 VDD, 87 PB6, 88 PA3, 89 PB2, 90 PB4, 91 PD3, 92 PD5, 93 PB3, 94 VBUS, 95 NC, 96 AVDD, 97 PA15, 98 NC, 99 NC, 100 NC, 101 NC, 102 PB7, 103 PD4, 104 NC, 105 VDD, 106 PB15, 107 PB14, 108 PB0, 109 NC, 110 USB_DP, 111 PB1, 112 USB_DM, 113 NC, 114 PLL_VDD, 115 SOC_LDO_VDD_IN, 116 NC, 117 SOC_LDO_VDD_IN, 118 NC, 119 PD6, 120 PD7, 121 PC7, 122 PB5, 123 MCLR, 124 PA11, 125 PA12, 126 PMU_MLDO, 127 NC, 128 VPMU_VDD, 129 NC, 130 NC, 131 PMU_BK, 132 NC
