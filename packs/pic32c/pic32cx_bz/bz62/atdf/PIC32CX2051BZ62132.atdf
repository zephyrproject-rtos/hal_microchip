# PIC32CX2051BZ62132 device description
Architecture: CORTEX-M4; Family: PIC32CX; Series: PIC32CXBZ62

## Peripheral instances (address, pins/pin function, parameters) (continued)
SERCOM3 at 0x46000400 (SERCOM)
  pins: PAD_IN0 PA02/1 set 3 or PA08/2 set 3 or PA13/3 set 3 or PB02/4 set 3 or PB08/5 set 3 or PB13/6 set 3 or PC08/7 set 3 or PD02/8 set 3 or PE02/9 set 3 or PA04/10 set 3 or PB03/11 set 3 or PC01/12 set 3 or PD06/13 set 3 or PE00/14 set 3 or PA05/15 set 3 or PA09/16 set 3 or PB06/17 set 3 or PB10/18 set 3 or PA00/19 set 3 or PB01/20 set 3 or PB05/21 set 3 or PB09/22 set 3 or PA01/23 set 3 or PA12/24 set 3; PAD_IN1 PA05/0 set 6 or PB05/1 set 6 or PB09/2 set 6 or PD05/3 set 6 or PE05/4 set 6 or PA03/5 set 6 or PA06/6 set 6 or PA07/7 set 6 or PB06/8 set 6 or PB08/9 set 6; PAD_IN2 PA00/1 set 1 or PA06/2 set 1 or PA11/3 set 1 or PB00/4 set 1 or PB06/5 set 1 or PB11/6 set 1 or PC00/7 set 1 or PD06/8 set 1 or PE00/9 set 1 or PE06/10 set 1 or PB01/11 set 1 or PC09/12 set 1 or PD03/13 set 1 or PE04/14 set 1 or PA03/15 set 1 or PA07/16 set 1 or PB04/17 set 1 or PB08/18 set 1 or PB12/19 set 1 or PA02/20 set 1 or PA10/21 set 1 or PA14/22 set 1 or PB03/23 set 1 or PB07/24 set 1 or PA09/25 set 1; PAD_IN3 PA01/1 set 2 or PA07/2 set 2 or PA12/3 set 2 or PB01/4 set 2 or PB07/5 set 2 or PC01/6 set 2 or PC07/7 set 2 or PD07/8 set 2 or PE01/9 set 2 or PA03/10 set 2 or PB02/11 set 2 or PC00/12 set 2 or PD04/13 set 2 or PE06/14 set 2 or PA04/15 set 2 or PA08/16 set 2 or PB12/17 set 2 or PB05/18 set 2 or PB09/19 set 2 or PB13/20 set 2 or PB00/21 set 2 or PB04/22 set 2 or PB08/23 set 2 or PA00/24 set 2 or PA11/25 set 2; PAD_OUT0 PA00/7 set 1 or PA02/7 set 1 or PA03/7 set 1 or PA06/7 set 1 or PA07/7 set 1 or PA09/7 set 1 or PA10/7 set 1 or PA11/7 set 1 or PA14/7 set 1 or PB00/7 set 1 or PB01/7 set 1 or PB03/7 set 1 or PB04/7 set 1 or PB06/7 set 1 or PB07/7 set 1 or PB08/7 set 1 or PB11/7 set 1 or PB12/7 set 1 or PC00/7 set 1 or PC09/7 set 1 or PD03/7 set 1 or PD06/7 set 1 or PE00/7 set 1 or PE04/7 set 1 or PE06/7 set 1 or PA00/10 set 3 or PA01/10 set 3 or PA02/10 set 3 or PA04/10 set 3 or PA05/10 set 3 or PA08/10 set 3 or PA09/10 set 3 or PA12/10 set 3 or PA13/10 set 3 or PB01/10 set 3 or PB02/10 set 3 or PB03/10 set 3 or PB05/10 set 3 or PB06/10 set 3 or PB08/10 set 3 or PB09/10 set 3 or PB10/10 set 3 or PB13/10 set 3 or PC01/10 set 3 or PC08/10 set 3 or PD02/10 set 3 or PD06/10 set 3 or PE00/10 set 3 or PE02/10 set 3 or PA00/9 set 4 or PA01/9 set 4 or PA02/9 set 4 or PA03/9 set 4 or PA05/9 set 4 or PA06/9 set 4 or PA08/9 set 4 or PA09/9 set 4 or PA10/9 set 4 or PA13/9 set 4 or PA14/9 set 4 or PB02/9 set 4 or PB03/9 set 4 or PB04/9 set 4 or PB06/9 set 4 or PB07/9 set 4 or PB10/9 set 4 or PB11/9 set 4 or PC07/9 set 4 or PC09/9 set 4 or PD03/9 set 4 or PD07/9 set 4 or PE01/9 set 4 or PE03/9 set 4; PAD_OUT1 PA03/4 set 6 or PA05/4 set 6 or PA06/4 set 6 or PA07/4 set 6 or PB05/4 set 6 or PB06/4 set 6 or PB08/4 set 6 or PB09/4 set 6 or PD05/4 set 6 or PE05/4 set 6; PAD_OUT2 PA00/8 set 1 or PA02/8 set 1 or PA03/8 set 1 or PA06/8 set 1 or PA07/8 set 1 or PA09/8 set 1 or PA10/8 set 1 or PA11/8 set 1 or PA14/8 set 1 or PB00/8 set 1 or PB01/8 set 1 or PB03/8 set 1 or PB04/8 set 1 or PB06/8 set 1 or PB07/8 set 1 or PB08/8 set 1 or PB11/8 set 1 or PB12/8 set 1 or PC00/8 set 1 or PC09/8 set 1 or PD03/8 set 1 or PD06/8 set 1 or PE00/8 set 1 or PE04/8 set 1 or PE06/8 set 1 or PA00/11 set 2 or PA01/11 set 2 or PA03/11 set 2 or PA04/11 set 2 or PA07/11 set 2 or PA08/11 set 2 or PA11/11 set 2 or PA12/11 set 2 or PB00/11 set 2 or PB01/11 set 2 or PB02/11 set 2 or PB04/11 set 2 or PB05/11 set 2 or PB07/11 set 2 or PB08/11 set 2 or PB09/11 set 2 or PB12/11 set 2 or PB13/11 set 2 or PC00/11 set 2 or PC01/11 set 2 or PC07/11 set 2 or PD04/11 set 2 or PD07/11 set 2 or PE01/11 set 2 or PE06/11 set 2 or PA00/9 set 3 or PA01/9 set 3 or PA02/9 set 3 or PA04/9 set 3 or PA05/9 set 3 or PA08/9 set 3 or PA09/9 set 3 or PA12/9 set 3 or PA13/9 set 3 or PB01/9 set 3 or PB02/9 set 3 or PB03/9 set 3 or PB05/9 set 3 or PB06/9 set 3 or PB08/9 set 3 or PB09/9 set 3 or PB10/9 set 3 or PB13/9 set 3 or PC01/9 set 3 or PC08/9 set 3 or PD02/9 set 3 or PD06/9 set 3 or PE00/9 set 3 or PE02/9 set 3; PAD_OUT3 PA00/10 set 2 or PA01/10 set 2 or PA03/10 set 2 or PA04/10 set 2 or PA07/10 set 2 or PA08/10 set 2 or PA11/10 set 2 or PA12/10 set 2 or PB00/10 set 2 or PB01/10 set 2 or PB02/10 set 2 or PB04/10 set 2 or PB05/10 set 2 or PB07/10 set 2 or PB08/10 set 2 or PB09/10 set 2 or PB12/10 set 2 or PB13/10 set 2 or PC00/10 set 2 or PC01/10 set 2 or PC07/10 set 2 or PD04/10 set 2 or PD07/10 set 2 or PE01/10 set 2 or PE06/10 set 2 or PA00/11 set 3 or PA01/11 set 3 or PA02/11 set 3 or PA04/11 set 3 or PA05/11 set 3 or PA08/11 set 3 or PA09/11 set 3 or PA12/11 set 3 or PA13/11 set 3 or PB01/11 set 3 or PB02/11 set 3 or PB03/11 set 3 or PB05/11 set 3 or PB06/11 set 3 or PB08/11 set 3 or PB09/11 set 3 or PB10/11 set 3 or PB13/11 set 3 or PC01/11 set 3 or PC08/11 set 3 or PD02/11 set 3 or PD06/11 set 3 or PE00/11 set 3 or PE02/11 set 3 or PA00/8 set 4 or PA01/8 set 4 or PA02/8 set 4 or PA03/8 set 4 or PA05/8 set 4 or PA06/8 set 4 or PA08/8 set 4 or PA09/8 set 4 or PA10/8 set 4 or PA13/8 set 4 or PA14/8 set 4 or PB02/8 set 4 or PB03/8 set 4 or PB04/8 set 4 or PB06/8 set 4 or PB07/8 set 4 or PB10/8 set 4 or PB11/8 set 4 or PC07/8 set 4 or PC09/8 set 4 or PD03/8 set 4 or PD07/8 set 4 or PE01/8 set 4 or PE03/8 set 4
  parameters: GCLK_ID_SLOW=5, GCLK_ID_CORE=5, DMAC_ID_RX=10, DMAC_ID_TX=11, CHIP_SERCOM_PADDR_MSB=9, CHIP_SERCOM_CLK_REDUCTION=1, CHIP_SERCOM_DMA=1, CHIP_SERCOM_FIFO_DEPTH_POWER=1, CHIP_SERCOM_RETENTION_SUPPORT=0, CHIP_SERCOM_SPI=1, CHIP_SERCOM_SPI_HW_SS_CTRL=1, CHIP_SERCOM_SPI_ICSPACE_EXT=1, CHIP_SERCOM_SPI_OZMO=0, CHIP_SERCOM_SPI_WAKE_ON_SSL=1, CHIP_SERCOM_TTBIT_EXTENSION=1, CHIP_SERCOM_TWIM=0, CHIP_SERCOM_TWIS=0, CHIP_SERCOM_USART=1, CHIP_SERCOM_USART_AUTOBAUD=1, CHIP_SERCOM_USART_COLDET=1, CHIP_SERCOM_USART_FLOW_CTRL=1, CHIP_SERCOM_USART_FRAC_BAUD=1, CHIP_SERCOM_USART_IRDA=1, CHIP_SERCOM_USART_ISO7816=1, CHIP_SERCOM_USART_LIN_MASTER=1, CHIP_SERCOM_USART_RS485=1, CHIP_SERCOM_USART_SAMPA_EXT=1, CHIP_SERCOM_USART_SAMPR_EXT=1, CHIP_SERCOM_DLY_COMPENSATION=1, CHIP_SERCOM_SE_CNT=1, INSTANCE_ID=97 (Instance index for SERCOM3), PAC_ID=97 (Index for SERCOM3 registers write protection)
SERCOM4 at 0x46000800 (SERCOM)
  pins: PAD_IN0 PA01/1 set 2 or PA07/2 set 2 or PA12/3 set 2 or PB01/4 set 2 or PB07/5 set 2 or PC01/6 set 2 or PC07/7 set 2 or PD07/8 set 2 or PE01/9 set 2 or PA03/10 set 2 or PB02/11 set 2 or PC00/12 set 2 or PD04/13 set 2 or PE06/14 set 2 or PA04/15 set 2 or PA08/16 set 2 or PB12/17 set 2 or PB05/18 set 2 or PB09/19 set 2 or PB13/20 set 2 or PB00/21 set 2 or PB04/22 set 2 or PB08/23 set 2 or PA00/24 set 2 or PA11/25 set 2; PAD_IN1 PA05/1 set 6 or PB05/2 set 6 or PB09/3 set 6 or PD05/4 set 6 or PE05/5 set 6 or PA03/6 set 6 or PA06/7 set 6 or PA07/8 set 6 or PB06/9 set 6 or PB08/10 set 6; PAD_IN2 PA03/1 set 4 or PA09/2 set 4 or PA14/3 set 4 or PB03/4 set 4 or PC09/5 set 4 or PD03/6 set 4 or PE03/7 set 4 or PA00/8 set 4 or PB04/9 set 4 or PC07/10 set 4 or PD07/11 set 4 or PE01/12 set 4 or PA06/13 set 4 or PA10/14 set 4 or PB07/15 set 4 or PB11/16 set 4 or PA01/17 set 4 or PA05/18 set 4 or PA13/19 set 4 or PB02/20 set 4 or PB06/21 set 4 or PB10/22 set 4 or PA08/23 set 4 or PA02/24 set 4; PAD_IN3 PA00/1 set 1 or PA06/2 set 1 or PA11/3 set 1 or PB00/4 set 1 or PB06/5 set 1 or PB11/6 set 1 or PC00/7 set 1 or PD06/8 set 1 or PE00/9 set 1 or PE06/10 set 1 or PB01/11 set 1 or PC09/12 set 1 or PD03/13 set 1 or PE04/14 set 1 or PA03/15 set 1 or PA07/16 set 1 or PB04/17 set 1 or PB08/18 set 1 or PB12/19 set 1 or PA02/20 set 1 or PA10/21 set 1 or PA14/22 set 1 or PB03/23 set 1 or PB07/24 set 1 or PA09/25 set 1; PAD_OUT0 PA01/12 set 2 or PA07/12 set 2 or PA12/12 set 2 or PB01/12 set 2 or PB07/12 set 2 or PC01/12 set 2 or PC07/12 set 2 or PD07/12 set 2 or PE01/12 set 2 or PA03/12 set 2 or PB02/12 set 2 or PC00/12 set 2 or PD04/12 set 2 or PE06/12 set 2 or PA04/12 set 2 or PA08/12 set 2 or PB12/12 set 2 or PB05/12 set 2 or PB09/12 set 2 or PB13/12 set 2 or PB00/12 set 2 or PB04/12 set 2 or PB08/12 set 2 or PA00/12 set 2 or PA11/12 set 2 or PA02/12 set 3 or PA08/12 set 3 or PA13/12 set 3 or PB02/12 set 3 or PB08/12 set 3 or PB13/12 set 3 or PC08/12 set 3 or PD02/12 set 3 or PE02/12 set 3 or PA04/12 set 3 or PB03/12 set 3 or PC01/12 set 3 or PD06/12 set 3 or PE00/12 set 3 or PA05/12 set 3 or PA09/12 set 3 or PB06/12 set 3 or PB10/12 set 3 or PA00/12 set 3 or PB01/12 set 3 or PB05/12 set 3 or PB09/12 set 3 or PA01/12 set 3 or PA12/12 set 3 or PA03/11 set 4 or PA09/11 set 4 or PA14/11 set 4 or PB03/11 set 4 or PC09/11 set 4 or PD03/11 set 4 or PE03/11 set 4 or PA00/11 set 4 or PB04/11 set 4 or PC07/11 set 4 or PD07/11 set 4 or PE01/11 set 4 or PA06/11 set 4 or PA10/11 set 4 or PB07/11 set 4 or PB11/11 set 4 or PA01/11 set 4 or PA05/11 set 4 or PA13/11 set 4 or PB02/11 set 4 or PB06/11 set 4 or PB10/11 set 4 or PA08/11 set 4 or PA02/11 set 4; PAD_OUT1 PA05/5 set 6 or PB05/5 set 6 or PB09/5 set 6 or PD05/5 set 6 or PE05/5 set 6 or PA03/5 set 6 or PA06/5 set 6 or PA07/5 set 6 or PB06/5 set 6 or PB08/5 set 6; PAD_OUT2 PA00/10 set 1 or PA06/10 set 1 or PA11/10 set 1 or PB00/10 set 1 or PB06/10 set 1 or PB11/10 set 1 or PC00/10 set 1 or PD06/10 set 1 or PE00/10 set 1 or PE06/10 set 1 or PB01/10 set 1 or PC09/10 set 1 or PD03/10 set 1 or PE04/10 set 1 or PA03/10 set 1 or PA07/10 set 1 or PB04/10 set 1 or PB08/10 set 1 or PB12/10 set 1 or PA02/10 set 1 or PA10/10 set 1 or PA14/10 set 1 or PB03/10 set 1 or PB07/10 set 1 or PA09/10 set 1 or PA01/14 set 2 or PA07/14 set 2 or PA12/14 set 2 or PB01/14 set 2 or PB07/14 set 2 or PC01/14 set 2 or PC07/14 set 2 or PD07/14 set 2 or PE01/14 set 2 or PA03/14 set 2 or PB02/14 set 2 or PC00/14 set 2 or PD04/14 set 2 or PE06/14 set 2 or PA04/14 set 2 or PA08/14 set 2 or PB12/14 set 2 or PB05/14 set 2 or PB09/14 set 2 or PB13/14 set 2 or PB00/14 set 2 or PB04/14 set 2 or PB08/14 set 2 or PA00/14 set 2 or PA11/14 set 2 or PA03/10 set 4 or PA09/10 set 4 or PA14/10 set 4 or PB03/10 set 4 or PC09/10 set 4 or PD03/10 set 4 or PE03/10 set 4 or PA00/10 set 4 or PB04/10 set 4 or PC07/10 set 4 or PD07/10 set 4 or PE01/10 set 4 or PA06/10 set 4 or PA10/10 set 4 or PB07/10 set 4 or PB11/10 set 4 or PA01/10 set 4 or PA05/10 set 4 or PA13/10 set 4 or PB02/10 set 4 or PB06/10 set 4 or PB10/10 set 4 or PA08/10 set 4 or PA02/10 set 4; PAD_OUT3 PA00/9 set 1 or PA06/9 set 1 or PA11/9 set 1 or PB00/9 set 1 or PB06/9 set 1 or PB11/9 set 1 or PC00/9 set 1 or PD06/9 set 1 or PE00/9 set 1 or PE06/9 set 1 or PB01/9 set 1 or PC09/9 set 1 or PD03/9 set 1 or PE04/9 set 1 or PA03/9 set 1 or PA07/9 set 1 or PB04/9 set 1 or PB08/9 set 1 or PB12/9 set 1 or PA02/9 set 1 or PA10/9 set 1 or PA14/9 set 1 or PB03/9 set 1 or PB07/9 set 1 or PA09/9 set 1 or PA01/13 set 2 or PA07/13 set 2 or PA12/13 set 2 or PB01/13 set 2 or PB07/13 set 2 or PC01/13 set 2 or PC07/13 set 2 or PD07/13 set 2 or PE01/13 set 2 or PA03/13 set 2 or PB02/13 set 2 or PC00/13 set 2 or PD04/13 set 2 or PE06/13 set 2 or PA04/13 set 2 or PA08/13 set 2 or PB12/13 set 2 or PB05/13 set 2 or PB09/13 set 2 or PB13/13 set 2 or PB00/13 set 2 or PB04/13 set 2 or PB08/13 set 2 or PA00/13 set 2 or PA11/13 set 2 or PA02/13 set 3 or PA08/13 set 3 or PA13/13 set 3 or PB02/13 set 3 or PB08/13 set 3 or PB13/13 set 3 or PC08/13 set 3 or PD02/13 set 3 or PE02/13 set 3 or PA04/13 set 3 or PB03/13 set 3 or PC01/13 set 3 or PD06/13 set 3 or PE00/13 set 3 or PA05/13 set 3 or PA09/13 set 3 or PB06/13 set 3 or PB10/13 set 3 or PA00/13 set 3 or PB01/13 set 3 or PB05/13 set 3 or PB09/13 set 3 or PA01/13 set 3 or PA12/13 set 3
  parameters: GCLK_ID_SLOW=5, GCLK_ID_CORE=5, DMAC_ID_RX=12, DMAC_ID_TX=13, CHIP_SERCOM_PADDR_MSB=9, CHIP_SERCOM_CLK_REDUCTION=1, CHIP_SERCOM_DMA=1, CHIP_SERCOM_FIFO_DEPTH_POWER=1, CHIP_SERCOM_RETENTION_SUPPORT=0, CHIP_SERCOM_SPI=1, CHIP_SERCOM_SPI_HW_SS_CTRL=1, CHIP_SERCOM_SPI_ICSPACE_EXT=1, CHIP_SERCOM_SPI_OZMO=0, CHIP_SERCOM_SPI_WAKE_ON_SSL=1, CHIP_SERCOM_TTBIT_EXTENSION=1, CHIP_SERCOM_TWIM=0, CHIP_SERCOM_TWIS=0, CHIP_SERCOM_USART=1, CHIP_SERCOM_USART_AUTOBAUD=1, CHIP_SERCOM_USART_COLDET=1, CHIP_SERCOM_USART_FLOW_CTRL=1, CHIP_SERCOM_USART_FRAC_BAUD=1, CHIP_SERCOM_USART_IRDA=1, CHIP_SERCOM_USART_ISO7816=1, CHIP_SERCOM_USART_LIN_MASTER=1, CHIP_SERCOM_USART_RS485=1, CHIP_SERCOM_USART_SAMPA_EXT=1, CHIP_SERCOM_USART_SAMPR_EXT=1, CHIP_SERCOM_DLY_COMPENSATION=1, CHIP_SERCOM_SE_CNT=1, INSTANCE_ID=98 (Instance index for SERCOM4), PAC_ID=98 (Index for SERCOM4 registers write protection)
SERCOM5 at 0x46000C00 (SERCOM)
  pins: PAD_IN2 PA00/1 set 1 or PA06/2 set 1 or PA11/3 set 1 or PB00/4 set 1 or PB06/5 set 1 or PB11/6 set 1 or PC00/7 set 1 or PD06/8 set 1 or PE00/9 set 1 or PE06/10 set 1 or PB01/11 set 1 or PC09/12 set 1 or PD03/13 set 1 or PE04/14 set 1 or PA03/15 set 1 or PA07/16 set 1 or PB04/17 set 1 or PB08/18 set 1 or PB12/19 set 1 or PA02/20 set 1 or PA10/21 set 1 or PA14/22 set 1 or PB03/23 set 1 or PB07/24 set 1 or PA09/25 set 1; PAD_IN3 PA01/1 set 2 or PA07/2 set 2 or PA12/3 set 2 or PB01/4 set 2 or PB07/5 set 2 or PC01/6 set 2 or PC07/7 set 2 or PD07/8 set 2 or PE01/9 set 2 or PA03/10 set 2 or PB02/11 set 2 or PC00/12 set 2 or PD04/13 set 2 or PE06/14 set 2 or PA04/15 set 2 or PA08/16 set 2 or PB12/17 set 2 or PB05/18 set 2 or PB09/19 set 2 or PB13/20 set 2 or PB00/21 set 2 or PB04/22 set 2 or PB08/23 set 2 or PA00/24 set 2 or PA11/25 set 2; PAD_IN0 PA02/1 set 3 or PA08/2 set 3 or PA13/3 set 3 or PB02/4 set 3 or PB08/5 set 3 or PB13/6 set 3 or PC08/7 set 3 or PD02/8 set 3 or PE02/9 set 3 or PA04/10 set 3 or PB03/11 set 3 or PC01/12 set 3 or PD06/13 set 3 or PE00/14 set 3 or PA05/15 set 3 or PA09/16 set 3 or PB06/17 set 3 or PB10/18 set 3 or PA00/19 set 3 or PB01/20 set 3 or PB05/21 set 3 or PB09/22 set 3 or PA01/23 set 3 or PA12/24 set 3; PAD_IN1 PA05/1 set 6 or PB05/2 set 6 or PB09/3 set 6 or PD05/4 set 6 or PE05/5 set 6 or PA03/6 set 6 or PA06/7 set 6 or PA07/8 set 6 or PB06/9 set 6 or PB08/10 set 6; PAD_OUT0 PA00/11 set 1 or PA06/11 set 1 or PA11/11 set 1 or PB00/11 set 1 or PB06/11 set 1 or PB11/11 set 1 or PC00/11 set 1 or PD06/11 set 1 or PE00/11 set 1 or PE06/11 set 1 or PB01/11 set 1 or PC09/11 set 1 or PD03/11 set 1 or PE04/11 set 1 or PA03/11 set 1 or PA07/11 set 1 or PB04/11 set 1 or PB08/11 set 1 or PB12/11 set 1 or PA02/11 set 1 or PA10/11 set 1 or PA14/11 set 1 or PB03/11 set 1 or PB07/11 set 1 or PA09/11 set 1 or PA02/15 set 3 or PA08/15 set 3 or PA13/15 set 3 or PB02/15 set 3 or PB08/15 set 3 or PB13/15 set 3 or PC08/15 set 3 or PD02/15 set 3 or PE02/15 set 3 or PA04/15 set 3 or PB03/15 set 3 or PC01/15 set 3 or PD06/15 set 3 or PE00/15 set 3 or PA05/15 set 3 or PA09/15 set 3 or PB06/15 set 3 or PB10/15 set 3 or PA00/15 set 3 or PB01/15 set 3 or PB05/15 set 3 or PB09/15 set 3 or PA01/15 set 3 or PA12/15 set 3 or PA03/13 set 4 or PA09/13 set 4 or PA14/13 set 4 or PB03/13 set 4 or PC09/13 set 4 or PD03/13 set 4 or PE03/13 set 4 or PA00/13 set 4 or PB04/13 set 4 or PC07/13 set 4 or PD07/13 set 4 or PE01/13 set 4 or PA06/13 set 4 or PA10/13 set 4 or PB07/13 set 4 or PB11/13 set 4 or PA01/13 set 4 or PA05/13 set 4 or PA13/13 set 4 or PB02/13 set 4 or PB06/13 set 4 or PB10/13 set 4 or PA08/13 set 4 or PA02/13 set 4; PAD_OUT1 PA05/6 set 6 or PB05/6 set 6 or PB09/6 set 6 or PD05/6 set 6 or PE05/6 set 6 or PA03/6 set 6 or PA06/6 set 6 or PA07/6 set 6 or PB06/6 set 6 or PB08/6 set 6; PAD_OUT2 PA00/12 set 1 or PA06/12 set 1 or PA11/12 set 1 or PB00/12 set 1 or PB06/12 set 1 or PB11/12 set 1 or PC00/12 set 1 or PD06/12 set 1 or PE00/12 set 1 or PE06/12 set 1 or PB01/12 set 1 or PC09/12 set 1 or PD03/12 set 1 or PE04/12 set 1 or PA03/12 set 1 or PA07/12 set 1 or PB04/12 set 1 or PB08/12 set 1 or PB12/12 set 1 or PA02/12 set 1 or PA10/12 set 1 or PA14/12 set 1 or PB03/12 set 1 or PB07/12 set 1 or PA09/12 set 1 or PA01/16 set 2 or PA07/16 set 2 or PA12/16 set 2 or PB01/16 set 2 or PB07/16 set 2 or PC01/16 set 2 or PC07/16 set 2 or PD07/16 set 2 or PE01/16 set 2 or PA03/16 set 2 or PB02/16 set 2 or PC00/16 set 2 or PD04/16 set 2 or PE06/16 set 2 or PA04/16 set 2 or PA08/16 set 2 or PB12/16 set 2 or PB05/16 set 2 or PB09/16 set 2 or PB13/16 set 2 or PB00/16 set 2 or PB04/16 set 2 or PB08/16 set 2 or PA00/16 set 2 or PA11/16 set 2 or PA02/14 set 3 or PA08/14 set 3 or PA13/14 set 3 or PB02/14 set 3 or PB08/14 set 3 or PB13/14 set 3 or PC08/14 set 3 or PD02/14 set 3 or PE02/14 set 3 or PA04/14 set 3 or PB03/14 set 3 or PC01/14 set 3 or PD06/14 set 3 or PE00/14 set 3 or PA05/14 set 3 or PA09/14 set 3 or PB06/14 set 3 or PB10/14 set 3 or PA00/14 set 3 or PB01/14 set 3 or PB05/14 set 3 or PB09/14 set 3 or PA01/14 set 3 or PA12/14 set 3; PAD_OUT3 PA01/15 set 2 or PA07/15 set 2 or PA12/15 set 2 or PB01/15 set 2 or PB07/15 set 2 or PC01/15 set 2 or PC07/15 set 2 or PD07/15 set 2 or PE01/15 set 2 or PA03/15 set 2 or PB02/15 set 2 or PC00/15 set 2 or PD04/15 set 2 or PE06/15 set 2 or PA04/15 set 2 or PA08/15 set 2 or PB12/15 set 2 or PB05/15 set 2 or PB09/15 set 2 or PB13/15 set 2 or PB00/15 set 2 or PB04/15 set 2 or PB08/15 set 2 or PA00/15 set 2 or PA11/15 set 2 or PA02/16 set 3 or PA08/16 set 3 or PA13/16 set 3 or PB02/16 set 3 or PB08/16 set 3 or PB13/16 set 3 or PC08/16 set 3 or PD02/16 set 3 or PE02/16 set 3 or PA04/16 set 3 or PB03/16 set 3 or PC01/16 set 3 or PD06/16 set 3 or PE00/16 set 3 or PA05/16 set 3 or PA09/16 set 3 or PB06/16 set 3 or PB10/16 set 3 or PA00/16 set 3 or PB01/16 set 3 or PB05/16 set 3 or PB09/16 set 3 or PA01/16 set 3 or PA12/16 set 3 or PA03/12 set 4 or PA09/12 set 4 or PA14/12 set 4 or PB03/12 set 4 or PC09/12 set 4 or PD03/12 set 4 or PE03/12 set 4 or PA00/12 set 4 or PB04/12 set 4 or PC07/12 set 4 or PD07/12 set 4 or PE01/12 set 4 or PA06/12 set 4 or PA10/12 set 4 or PB07/12 set 4 or PB11/12 set 4 or PA01/12 set 4 or PA05/12 set 4 or PA13/12 set 4 or PB02/12 set 4 or PB06/12 set 4 or PB10/12 set 4 or PA08/12 set 4 or PA02/12 set 4
  parameters: GCLK_ID_SLOW=5, GCLK_ID_CORE=5, DMAC_ID_RX=14, DMAC_ID_TX=15, CHIP_SERCOM_PADDR_MSB=9, CHIP_SERCOM_CLK_REDUCTION=1, CHIP_SERCOM_DMA=1, CHIP_SERCOM_FIFO_DEPTH_POWER=1, CHIP_SERCOM_RETENTION_SUPPORT=0, CHIP_SERCOM_SPI=1, CHIP_SERCOM_SPI_HW_SS_CTRL=1, CHIP_SERCOM_SPI_ICSPACE_EXT=1, CHIP_SERCOM_SPI_OZMO=0, CHIP_SERCOM_SPI_WAKE_ON_SSL=1, CHIP_SERCOM_TTBIT_EXTENSION=1, CHIP_SERCOM_TWIM=0, CHIP_SERCOM_TWIS=0, CHIP_SERCOM_USART=1, CHIP_SERCOM_USART_AUTOBAUD=1, CHIP_SERCOM_USART_COLDET=1, CHIP_SERCOM_USART_FLOW_CTRL=1, CHIP_SERCOM_USART_FRAC_BAUD=1, CHIP_SERCOM_USART_IRDA=1, CHIP_SERCOM_USART_ISO7816=1, CHIP_SERCOM_USART_LIN_MASTER=1, CHIP_SERCOM_USART_RS485=1, CHIP_SERCOM_USART_SAMPA_EXT=1, CHIP_SERCOM_USART_SAMPR_EXT=1, CHIP_SERCOM_DLY_COMPENSATION=1, CHIP_SERCOM_SE_CNT=1, INSTANCE_ID=99 (Instance index for SERCOM5), PAC_ID=99 (Index for SERCOM5 registers write protection)
SERCOM6 at 0x42000400 (SERCOM)
  pins: I2C_SERCOM_PAD0 PA13/I2C; I2C_SERCOM_PAD1 PA14/I2C
  parameters: GCLK_ID_SLOW=3, GCLK_ID_CORE=3, DMAC_ID_RX=16, DMAC_ID_TX=17, CHIP_SERCOM_PADDR_MSB=9, CHIP_SERCOM_CLK_REDUCTION=1, CHIP_SERCOM_DMA=1, CHIP_SERCOM_FIFO_DEPTH_POWER=1, CHIP_SERCOM_RETENTION_SUPPORT=0, CHIP_SERCOM_SPI=0, CHIP_SERCOM_SPI_HW_SS_CTRL=0, CHIP_SERCOM_SPI_ICSPACE_EXT=0, CHIP_SERCOM_SPI_OZMO=0, CHIP_SERCOM_SPI_WAKE_ON_SSL=0, CHIP_SERCOM_TTBIT_EXTENSION=1, CHIP_SERCOM_TWIM=1, CHIP_SERCOM_TWIS=1, CHIP_SERCOM_TWIS_AUTO_ACK=1, CHIP_SERCOM_TWIS_GROUP_CMD=1, CHIP_SERCOM_TWIS_SDASETUP_CNT_SIZE=8, CHIP_SERCOM_TWIS_SDASETUP_SIZE=4, CHIP_SERCOM_TWIS_SUDAT=1, CHIP_SERCOM_TWI_FASTMP=1, CHIP_SERCOM_TWI_HSMODE=1, CHIP_SERCOM_TWI_SCLSM_MODE=1, CHIP_SERCOM_TWI_SMB_TIMEOUTS=1, CHIP_SERCOM_TWI_TENBIT_ADR=1, CHIP_SERCOM_USART=0, CHIP_SERCOM_USART_AUTOBAUD=0, CHIP_SERCOM_USART_COLDET=0, CHIP_SERCOM_USART_FLOW_CTRL=0, CHIP_SERCOM_USART_FRAC_BAUD=0, CHIP_SERCOM_USART_IRDA=0, CHIP_SERCOM_USART_ISO7816=0, CHIP_SERCOM_USART_LIN_MASTER=0, CHIP_SERCOM_USART_RS485=0, CHIP_SERCOM_USART_SAMPA_EXT=0, CHIP_SERCOM_USART_SAMPR_EXT=0, CHIP_SERCOM_DLY_COMPENSATION=1, CHIP_SERCOM_SE_CNT=1, INSTANCE_ID=65 (Instance index for SERCOM6), PAC_ID=65 (Index for SERCOM6 registers write protection)
CRYPTO at 0x43000000
SysTick at 0xE000E010
SystemControl at 0xE000E000
TC0 at 0x40001400 (TC)
  pins: WO_OUT0 PA00/18 set 3 or PA01/18 set 3 or PA02/18 set 3 or PA04/18 set 3 or PA05/18 set 3 or PA08/18 set 3 or PA09/18 set 3 or PA12/18 set 3 or PA13/18 set 3 or PB01/18 set 3 or PB02/18 set 3 or PB03/18 set 3 or PB05/18 set 3 or PB06/18 set 3 or PB08/18 set 3 or PB09/18 set 3 or PB10/18 set 3 or PB13/18 set 3 or PC01/18 set 3 or PC08/18 set 3 or PD02/18 set 3 or PD06/18 set 3 or PE00/18 set 3 or PE02/18 set 3 or PA00/21 set 4 or PA01/21 set 4 or PA02/21 set 4 or PA03/21 set 4 or PA05/21 set 4 or PA06/21 set 4 or PA08/21 set 4 or PA09/21 set 4 or PA10/21 set 4 or PA13/21 set 4 or PA14/21 set 4 or PB02/21 set 4 or PB03/21 set 4 or PB04/21 set 4 or PB06/21 set 4 or PB07/21 set 4 or PB10/21 set 4 or PB11/21 set 4 or PC07/21 set 4 or PC09/21 set 4 or PD03/21 set 4 or PD07/21 set 4 or PE01/21 set 4 or PE03/21 set 4; WO_OUT1 PA00/18 set 1 or PA02/18 set 1 or PA03/18 set 1 or PA06/18 set 1 or PA07/18 set 1 or PA09/18 set 1 or PA10/18 set 1 or PA11/18 set 1 or PA14/18 set 1 or PB00/18 set 1 or PB01/18 set 1 or PB03/18 set 1 or PB04/18 set 1 or PB06/18 set 1 or PB07/18 set 1 or PB08/18 set 1 or PB11/18 set 1 or PB12/18 set 1 or PC00/18 set 1 or PC09/18 set 1 or PD03/18 set 1 or PD06/18 set 1 or PE00/18 set 1 or PE04/18 set 1 or PE06/18 set 1 or PA00/24 set 2 or PA01/24 set 2 or PA03/24 set 2 or PA04/24 set 2 or PA07/24 set 2 or PA08/24 set 2 or PA11/24 set 2 or PA12/24 set 2 or PB00/24 set 2 or PB01/24 set 2 or PB02/24 set 2 or PB04/24 set 2 or PB05/24 set 2 or PB07/24 set 2 or PB08/24 set 2 or PB09/24 set 2 or PB12/24 set 2 or PB13/24 set 2 or PC00/24 set 2 or PC01/24 set 2 or PC07/24 set 2 or PD04/24 set 2 or PD07/24 set 2 or PE01/24 set 2 or PE06/24 set 2; WO_IN0 PA00/1 set 1 or PA06/2 set 1 or PA11/3 set 1 or PB00/4 set 1 or PB06/5 set 1 or PB11/6 set 1 or PC00/7 set 1 or PD06/8 set 1 or PE00/9 set 1 or PE06/10 set 1 or PB01/11 set 1 or PC09/12 set 1 or PD03/13 set 1 or PE04/14 set 1 or PA03/15 set 1 or PA07/16 set 1 or PB04/17 set 1 or PB08/18 set 1 or PB12/19 set 1 or PA02/20 set 1 or PA10/21 set 1 or PA14/22 set 1 or PB03/23 set 1 or PB07/24 set 1 or PA09/25 set 1 or PA01/1 set 2 or PA07/2 set 2 or PA12/3 set 2 or PB01/4 set 2 or PB07/5 set 2 or PC01/6 set 2 or PC07/7 set 2 or PD07/8 set 2 or PE01/9 set 2 or PA03/10 set 2 or PB02/11 set 2 or PC00/12 set 2 or PD04/13 set 2 or PE06/14 set 2 or PA04/15 set 2 or PA08/16 set 2 or PB12/17 set 2 or PB05/18 set 2 or PB09/19 set 2 or PB13/20 set 2 or PB00/21 set 2 or PB04/22 set 2 or PB08/23 set 2 or PA00/24 set 2 or PA11/25 set 2; WO_IN1 PA02/1 set 3 or PA08/2 set 3 or PA13/3 set 3 or PB02/4 set 3 or PB08/5 set 3 or PB13/6 set 3 or PC08/7 set 3 or PD02/8 set 3 or PE02/9 set 3 or PA04/10 set 3 or PB03/11 set 3 or PC01/12 set 3 or PD06/13 set 3 or PE00/14 set 3 or PA05/15 set 3 or PA09/16 set 3 or PB06/17 set 3 or PB10/18 set 3 or PA00/19 set 3 or PB01/20 set 3 or PB05/21 set 3 or PB09/22 set 3 or PA01/23 set 3 or PA12/24 set 3 or PA03/1 set 4 or PA09/2 set 4 or PA14/3 set 4 or PB03/4 set 4 or PC09/5 set 4 or PD03/6 set 4 or PE03/7 set 4 or PA00/8 set 4 or PB04/9 set 4 or PC07/10 set 4 or PD07/11 set 4 or PE01/12 set 4 or PA06/13 set 4 or PA10/14 set 4 or PB07/15 set 4 or PB11/16 set 4 or PA01/17 set 4 or PA05/18 set 4 or PA13/19 set 4 or PB02/20 set 4 or PB06/21 set 4 or PB10/22 set 4 or PA08/23 set 4 or PA02/24 set 4
  parameters: GCLK_ID=6, DMAC_ID_OVF=35, DMAC_ID_MC0=36, DMAC_ID_MC1=37, INSTANCE_ID=5 (Instance index for TC0), PAC_ID=5 (Index for TC0 registers write protection), MASTER_SLAVE_MODE=1
TC1 at 0x40001800 (TC)
  pins: WO_OUT0 PA00/19 set 1 or PA02/19 set 1 or PA03/19 set 1 or PA06/19 set 1 or PA07/19 set 1 or PA09/19 set 1 or PA10/19 set 1 or PA11/19 set 1 or PA14/19 set 1 or PB00/19 set 1 or PB01/19 set 1 or PB03/19 set 1 or PB04/19 set 1 or PB06/19 set 1 or PB07/19 set 1 or PB08/19 set 1 or PB11/19 set 1 or PB12/19 set 1 or PC00/19 set 1 or PC09/19 set 1 or PD03/19 set 1 or PD06/19 set 1 or PE00/19 set 1 or PE04/19 set 1 or PE06/19 set 1 or PA00/25 set 3 or PA01/25 set 3 or PA02/25 set 3 or PA04/25 set 3 or PA05/25 set 3 or PA08/25 set 3 or PA09/25 set 3 or PA12/25 set 3 or PA13/25 set 3 or PB01/25 set 3 or PB02/25 set 3 or PB03/25 set 3 or PB05/25 set 3 or PB06/25 set 3 or PB08/25 set 3 or PB09/25 set 3 or PB10/25 set 3 or PB13/25 set 3 or PC01/25 set 3 or PC08/25 set 3 or PD02/25 set 3 or PD06/25 set 3 or PE00/25 set 3 or PE02/25 set 3; WO_OUT1 PA00/25 set 2 or PA01/25 set 2 or PA03/25 set 2 or PA04/25 set 2 or PA07/25 set 2 or PA08/25 set 2 or PA11/25 set 2 or PA12/25 set 2 or PB00/25 set 2 or PB01/25 set 2 or PB02/25 set 2 or PB04/25 set 2 or PB05/25 set 2 or PB07/25 set 2 or PB08/25 set 2 or PB09/25 set 2 or PB12/25 set 2 or PB13/25 set 2 or PC00/25 set 2 or PC01/25 set 2 or PC07/25 set 2 or PD04/25 set 2 or PD07/25 set 2 or PE01/25 set 2 or PE06/25 set 2 or PA00/22 set 4 or PA01/22 set 4 or PA02/22 set 4 or PA03/22 set 4 or PA05/22 set 4 or PA06/22 set 4 or PA08/22 set 4 or PA09/22 set 4 or PA10/22 set 4 or PA13/22 set 4 or PA14/22 set 4 or PB02/22 set 4 or PB03/22 set 4 or PB04/22 set 4 or PB06/22 set 4 or PB07/22 set 4 or PB10/22 set 4 or PB11/22 set 4 or PC07/22 set 4 or PC09/22 set 4 or PD03/22 set 4 or PD07/22 set 4 or PE01/22 set 4 or PE03/22 set 4; WO_IN0 PA00/1 set 1 or PA06/2 set 1 or PA11/3 set 1 or PB00/4 set 1 or PB06/5 set 1 or PB11/6 set 1 or PC00/7 set 1 or PD06/8 set 1 or PE00/9 set 1 or PE06/10 set 1 or PB01/11 set 1 or PC09/12 set 1 or PD03/13 set 1 or PE04/14 set 1 or PA03/15 set 1 or PA07/16 set 1 or PB04/17 set 1 or PB08/18 set 1 or PB12/19 set 1 or PA02/20 set 1 or PA10/21 set 1 or PA14/22 set 1 or PB03/23 set 1 or PB07/24 set 1 or PA09/25 set 1; WO_IN1 PA01/1 set 2 or PA07/2 set 2 or PA12/3 set 2 or PB01/4 set 2 or PB07/5 set 2 or PC01/6 set 2 or PC07/7 set 2 or PD07/8 set 2 or PE01/9 set 2 or PA03/10 set 2 or PB02/11 set 2 or PC00/12 set 2 or PD04/13 set 2 or PE06/14 set 2 or PA04/15 set 2 or PA08/16 set 2 or PB12/17 set 2 or PB05/18 set 2 or PB09/19 set 2 or PB13/20 set 2 or PB00/21 set 2 or PB04/22 set 2 or PB08/23 set 2 or PA00/24 set 2 or PA11/25 set 2
  parameters: GCLK_ID=7, DMAC_ID_OVF=38, DMAC_ID_MC0=39, DMAC_ID_MC1=40, INSTANCE_ID=6 (Instance index for TC1), MASTER_SLAVE_MODE=2, PAC_ID=6 (Index for TC1 registers write protection)
TC2 at 0x40001C00 (TC)
  pins: WO_OUT0 PA00/20 set 1 or PA02/20 set 1 or PA03/20 set 1 or PA06/20 set 1 or PA07/20 set 1 or PA09/20 set 1 or PA10/20 set 1 or PA11/20 set 1 or PA14/20 set 1 or PB00/20 set 1 or PB01/20 set 1 or PB03/20 set 1 or PB04/20 set 1 or PB06/20 set 1 or PB07/20 set 1 or PB08/20 set 1 or PB11/20 set 1 or PB12/20 set 1 or PC00/20 set 1 or PC09/20 set 1 or PD03/20 set 1 or PD06/20 set 1 or PE00/20 set 1 or PE04/20 set 1 or PE06/20 set 1 or PA00/26 set 3 or PA01/26 set 3 or PA02/26 set 3 or PA04/26 set 3 or PA05/26 set 3 or PA08/26 set 3 or PA09/26 set 3 or PA12/26 set 3 or PA13/26 set 3 or PB01/26 set 3 or PB02/26 set 3 or PB03/26 set 3 or PB05/26 set 3 or PB06/26 set 3 or PB08/26 set 3 or PB09/26 set 3 or PB10/26 set 3 or PB13/26 set 3 or PC01/26 set 3 or PC08/26 set 3 or PD02/26 set 3 or PD06/26 set 3 or PE00/26 set 3 or PE02/26 set 3; WO_OUT1 PA00/26 set 2 or PA01/26 set 2 or PA03/26 set 2 or PA04/26 set 2 or PA07/26 set 2 or PA08/26 set 2 or PA11/26 set 2 or PA12/26 set 2 or PB00/26 set 2 or PB01/26 set 2 or PB02/26 set 2 or PB04/26 set 2 or PB05/26 set 2 or PB07/26 set 2 or PB08/26 set 2 or PB09/26 set 2 or PB12/26 set 2 or PB13/26 set 2 or PC00/26 set 2 or PC01/26 set 2 or PC07/26 set 2 or PD04/26 set 2 or PD07/26 set 2 or PE01/26 set 2 or PE06/26 set 2 or PA00/23 set 4 or PA01/23 set 4 or PA02/23 set 4 or PA03/23 set 4 or PA05/23 set 4 or PA06/23 set 4 or PA08/23 set 4 or PA09/23 set 4 or PA10/23 set 4 or PA13/23 set 4 or PA14/23 set 4 or PB02/23 set 4 or PB03/23 set 4 or PB04/23 set 4 or PB06/23 set 4 or PB07/23 set 4 or PB10/23 set 4 or PB11/23 set 4 or PC07/23 set 4 or PC09/23 set 4 or PD03/23 set 4 or PD07/23 set 4 or PE01/23 set 4 or PE03/23 set 4; WO_IN0 PA00/1 set 1 or PA06/2 set 1 or PA11/3 set 1 or PB00/4 set 1 or PB06/5 set 1 or PB11/6 set 1 or PC00/7 set 1 or PD06/8 set 1 or PE00/9 set 1 or PE06/10 set 1 or PB01/11 set 1 or PC09/12 set 1 or PD03/13 set 1 or PE04/14 set 1 or PA03/15 set 1 or PA07/16 set 1 or PB04/17 set 1 or PB08/18 set 1 or PB12/19 set 1 or PA02/20 set 1 or PA10/21 set 1 or PA14/22 set 1 or PB03/23 set 1 or PB07/24 set 1 or PA09/25 set 1 or PA02/1 set 3 or PA08/2 set 3 or PA13/3 set 3 or PB02/4 set 3 or PB08/5 set 3 or PB13/6 set 3 or PC08/7 set 3 or PD02/8 set 3 or PE02/9 set 3 or PA04/10 set 3 or PB03/11 set 3 or PC01/12 set 3 or PD06/13 set 3 or PE00/14 set 3 or PA05/15 set 3 or PA09/16 set 3 or PB06/17 set 3 or PB10/18 set 3 or PA00/19 set 3 or PB01/20 set 3 or PB05/21 set 3 or PB09/22 set 3 or PA01/23 set 3 or PA12/24 set 3; WO_IN1 PA01/1 set 2 or PA07/2 set 2 or PA12/3 set 2 or PB01/4 set 2 or PB07/5 set 2 or PC01/6 set 2 or PC07/7 set 2 or PD07/8 set 2 or PE01/9 set 2 or PA03/10 set 2 or PB02/11 set 2 or PC00/12 set 2 or PD04/13 set 2 or PE06/14 set 2 or PA04/15 set 2 or PA08/16 set 2 or PB12/17 set 2 or PB05/18 set 2 or PB09/19 set 2 or PB13/20 set 2 or PB00/21 set 2 or PB04/22 set 2 or PB08/23 set 2 or PA00/24 set 2 or PA11/25 set 2 or PA03/1 set 4 or PA09/2 set 4 or PA14/3 set 4 or PB03/4 set 4 or PC09/5 set 4 or PD03/6 set 4 or PE03/7 set 4 or PA00/8 set 4 or PB04/9 set 4 or PC07/10 set 4 or PD07/11 set 4 or PE01/12 set 4 or PA06/13 set 4 or PA10/14 set 4 or PB07/15 set 4 or PB11/16 set 4 or PA01/17 set 4 or PA05/18 set 4 or PA13/19 set 4 or PB02/20 set 4 or PB06/21 set 4 or PB10/22 set 4 or PA08/23 set 4 or PA02/24 set 4
  parameters: GCLK_ID=8, DMAC_ID_OVF=41, DMAC_ID_MC0=42, DMAC_ID_MC1=43, INSTANCE_ID=7 (Instance index for TC2), MASTER_SLAVE_MODE=1, PAC_ID=7 (Index for TC2 registers write protection)
TC3 at 0x40002000 (TC)
  pins: WO_OUT0 PA00/21 set 1 or PA02/21 set 1 or PA03/21 set 1 or PA06/21 set 1 or PA07/21 set 1 or PA09/21 set 1 or PA10/21 set 1 or PA11/21 set 1 or PA14/21 set 1 or PB00/21 set 1 or PB01/21 set 1 or PB03/21 set 1 or PB04/21 set 1 or PB06/21 set 1 or PB07/21 set 1 or PB08/21 set 1 or PB11/21 set 1 or PB12/21 set 1 or PC00/21 set 1 or PC09/21 set 1 or PD03/21 set 1 or PD06/21 set 1 or PE00/21 set 1 or PE04/21 set 1 or PE06/21 set 1 or PA00/27 set 3 or PA01/27 set 3 or PA02/27 set 3 or PA04/27 set 3 or PA05/27 set 3 or PA08/27 set 3 or PA09/27 set 3 or PA12/27 set 3 or PA13/27 set 3 or PB01/27 set 3 or PB02/27 set 3 or PB03/27 set 3 or PB05/27 set 3 or PB06/27 set 3 or PB08/27 set 3 or PB09/27 set 3 or PB10/27 set 3 or PB13/27 set 3 or PC01/27 set 3 or PC08/27 set 3 or PD02/27 set 3 or PD06/27 set 3 or PE00/27 set 3 or PE02/27 set 3; WO_OUT1 PA00/27 set 2 or PA01/27 set 2 or PA03/27 set 2 or PA04/27 set 2 or PA07/27 set 2 or PA08/27 set 2 or PA11/27 set 2 or PA12/27 set 2 or PB00/27 set 2 or PB01/27 set 2 or PB02/27 set 2 or PB04/27 set 2 or PB05/27 set 2 or PB07/27 set 2 or PB08/27 set 2 or PB09/27 set 2 or PB12/27 set 2 or PB13/27 set 2 or PC00/27 set 2 or PC01/27 set 2 or PC07/27 set 2 or PD04/27 set 2 or PD07/27 set 2 or PE01/27 set 2 or PE06/27 set 2 or PA00/24 set 4 or PA01/24 set 4 or PA02/24 set 4 or PA03/24 set 4 or PA05/24 set 4 or PA06/24 set 4 or PA08/24 set 4 or PA09/24 set 4 or PA10/24 set 4 or PA13/24 set 4 or PA14/24 set 4 or PB02/24 set 4 or PB03/24 set 4 or PB04/24 set 4 or PB06/24 set 4 or PB07/24 set 4 or PB10/24 set 4 or PB11/24 set 4 or PC07/24 set 4 or PC09/24 set 4 or PD03/24 set 4 or PD07/24 set 4 or PE01/24 set 4 or PE03/24 set 4; WO_IN0 PA00/1 set 1 or PA06/2 set 1 or PA11/3 set 1 or PB00/4 set 1 or PB06/5 set 1 or PB11/6 set 1 or PC00/7 set 1 or PD06/8 set 1 or PE00/9 set 1 or PE06/10 set 1 or PB01/11 set 1 or PC09/12 set 1 or PD03/13 set 1 or PE04/14 set 1 or PA03/15 set 1 or PA07/16 set 1 or PB04/17 set 1 or PB08/18 set 1 or PB12/19 set 1 or PA02/20 set 1 or PA10/21 set 1 or PA14/22 set 1 or PB03/23 set 1 or PB07/24 set 1 or PA09/25 set 1 or PA02/1 set 3 or PA08/2 set 3 or PA13/3 set 3 or PB02/4 set 3 or PB08/5 set 3 or PB13/6 set 3 or PC08/7 set 3 or PD02/8 set 3 or PE02/9 set 3 or PA04/10 set 3 or PB03/11 set 3 or PC01/12 set 3 or PD06/13 set 3 or PE00/14 set 3 or PA05/15 set 3 or PA09/16 set 3 or PB06/17 set 3 or PB10/18 set 3 or PA00/19 set 3 or PB01/20 set 3 or PB05/21 set 3 or PB09/22 set 3 or PA01/23 set 3 or PA12/24 set 3; WO_IN1 PA01/1 set 2 or PA07/2 set 2 or PA12/3 set 2 or PB01/4 set 2 or PB07/5 set 2 or PC01/6 set 2 or PC07/7 set 2 or PD07/8 set 2 or PE01/9 set 2 or PA03/10 set 2 or PB02/11 set 2 or PC00/12 set 2 or PD04/13 set 2 or PE06/14 set 2 or PA04/15 set 2 or PA08/16 set 2 or PB12/17 set 2 or PB05/18 set 2 or PB09/19 set 2 or PB13/20 set 2 or PB00/21 set 2 or PB04/22 set 2 or PB08/23 set 2 or PA00/24 set 2 or PA11/25 set 2 or PA03/1 set 4 or PA09/2 set 4 or PA14/3 set 4 or PB03/4 set 4 or PC09/5 set 4 or PD03/6 set 4 or PE03/7 set 4 or PA00/8 set 4 or PB04/9 set 4 or PC07/10 set 4 or PD07/11 set 4 or PE01/12 set 4 or PA06/13 set 4 or PA10/14 set 4 or PB07/15 set 4 or PB11/16 set 4 or PA01/17 set 4 or PA05/18 set 4 or PA13/19 set 4 or PB02/20 set 4 or PB06/21 set 4 or PB10/22 set 4 or PA08/23 set 4 or PA02/24 set 4
  parameters: GCLK_ID=8, DMAC_ID_OVF=44, DMAC_ID_MC0=45, DMAC_ID_MC1=46, INSTANCE_ID=8 (Instance index for TC3), PAC_ID=8 (Index for TC3 registers write protection), MASTER_SLAVE_MODE=2
