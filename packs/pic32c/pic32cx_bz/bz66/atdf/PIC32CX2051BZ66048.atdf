# PIC32CX2051BZ66048 device description
Architecture: CORTEX-M4; Family: PIC32CX; Series: PIC32CXBZ66
Parameters: LITTLE_ENDIAN=1, NUM_IRQ=58, __ARCH_ARM=1, __CM4_REV=0x0001, __DEBUG_LVL=3, __FPU_PRESENT=1, __FRC_DEF_FREQ=8000000 (FRC Default Frequency), __MPU_PRESENT=1, __NUM_DMA_CHANNELS=16 (Number of DMA Channels), __NVIC_PRIO_BITS=3, __PB1_DEF_FREQ=128000000 (Peripheral Bus 1 Default Clock Frequency), __PB2_DEF_FREQ=128000000 (Peripheral Bus 2 Default Clock Frequency), __PB3_DEF_FREQ=128000000 (Peripheral Bus 3 Default Clock Frequency), __POSC_DEF_FREQ=16000000 (Primary Oscillator Input Default Frequency), __REFCLK1_DEF_FREQ=128000000 (Reference Clock 1 Default Frequency), __REFCLK2_DEF_FREQ=128000000 (Reference Clock 2 Default Frequency), __REFCLK3_DEF_FREQ=128000000 (Reference Clock 3 Default Frequency), __REFCLK4_DEF_FREQ=128000000 (Reference Clock 4 Default Frequency), __REFCLK5_DEF_FREQ=128000000 (Reference Clock 5 Default Frequency), __REFCLK6_DEF_FREQ=128000000 (Reference Clock 6 Default Frequency), __REFCLKI_DEF_FREQ=8000000 (REFCLKI Pin Input Default Frequency), __RFPLL_DEF_FREQ=128000000 (RFPLL Default Frequency), __EPLL_DEF_FREQ=50000000 (EPLL Default Frequency), __UPLL_DEF_FREQ=96000000 (UPLL Default Frequency), __SOSC_DEF_FREQ=32768 (Secondary Oscillator Input Default Frequency), __SYS_DEF_FREQ=128000000 (System Clock Default Frequency), __TRACE_LVL=2, __VENDOR_SYSTICKCONFIG=0, __VTOR_PRESENT=1, POWER_DOMAIN=PD_CORE, __ARCH_ARM_CORTEX_M=1, __BOOT_ROM_HDR_SIZE=512 (Secure Boot Header)
Programming and debug interfaces: SWD
Registers are 32-bit, read-write, reset 0x0 unless marked. A register's access mark holds for its fields unless they carry their own. Offsets are from the block's base; lines under a group give offsets from that group; [hi:lo] are bit positions; {n}, {i} and the like mark numbered series; 'fields as' and 'values as' point back to an identical list; <NAME> marks a mode.

## Ordering variants
PIC32CX2051BZ66048-I/3WW, PIC32CX2051BZ66048T-I/3WW: QFN48, up to 128 MHz, -40 to 85 C, 1.62 to 3.63 V
PIC32CX2051BZ66048-E/3WW, PIC32CX2051BZ66048T-E/3WW: QFN48, up to 128 MHz, -40 to 125 C, 1.62 to 3.63 V

## Memory
base space: start 0 size 0x100000000, little endian
  0x0 ROM_SECURE_BOOT_ROM size 0x10000 rom, rw, executable
  0x18000 ROM_SECURE_BOOT_PATCH size 0x00000800 rom, rw, executable
  0x800000 FCR_BFM size 0x10000 flash, rw, executable, page 4096
  0x810000 FCR_CFM size 0x1000 fuses, rw, page 4096
  0x811000 FCR_OTP_PAGE size 0x00001000 flash, ro, executable, page 4096
  0x1000000 FCR_PFM size 0x00200000 flash, rw, executable, page 4096
  0x2000000 CMCC_TCM size 0x1000 other, rw
  0x4000000 QSPI size 0x1000000 other, rw, executable, external
  0x20000000 RAM_SYSTEM_RAM size 0x80000 ram, rw, executable
  0x40000000 PBA_BRIDGE size 0x00004000 io, rw
  0x41000000 PBB_BRIDGE size 0x00020000 io, rw
  0x42000000 PBC_BRIDGE size 0x00012000 io, rw
  0x43000000 CRYPTO_SFR size 0x20000 io, rw
  0x44000000 PBPIC_BRIDGE size 0x00014000 io, rw
  0x45000000 MCROM_ROM size 0x2000 rom, ro, executable
  0x46000000 PBD_BRIDGE size 0x00002800 io, rw
  0xE0000000 SYSTEM_CM4F_SYSTEM_REGISTERS size 0x1fff4000 io, rw
fuses space: start 0x0 size 0x200, little endian
  0 EFUSE size 0x200 fuses, rw

## Peripheral instances (address, pins/pin function, parameters)
AC at 0x42001C00
  pins: AIN0 PB2/COMPARATOR__ANALOG; AIN1 PB3/COMPARATOR__ANALOG; AIN2 PB0/COMPARATOR__ANALOG; AIN3 PB1/COMPARATOR__ANALOG; CMPTEN PA00/1 set 1 or PA06/2 set 1 or PA11/3 set 1 or PB00/4 set 1 or PB06/5 set 1 or PB11/6 set 1 or PD06/8 set 1 or PE06/10 set 1 or PB01/11 set 1 or PD03/13 set 1 or PA03/15 set 1 or PA07/16 set 1 or PB04/17 set 1 or PB08/18 set 1 or PB12/19 set 1 or PA02/20 set 1 or PA10/21 set 1 or PA14/22 set 1 or PB03/23 set 1 or PB07/24 set 1 or PA09/25 set 1; CMP0 PA00/40 set 3 or PA01/40 set 3 or PA02/40 set 3 or PA04/40 set 3 or PA05/40 set 3 or PA08/40 set 3 or PA09/40 set 3 or PA13/40 set 3 or PB01/40 set 3 or PB02/40 set 3 or PB03/40 set 3 or PB05/40 set 3 or PB06/40 set 3 or PB08/40 set 3 or PB09/40 set 3 or PB10/40 set 3 or PB13/40 set 3 or PC08/40 set 3 or PD06/40 set 3 or PE02/40 set 3; CMP1 PA00/36 set 4 or PA01/36 set 4 or PA02/36 set 4 or PA03/36 set 4 or PA05/36 set 4 or PA06/36 set 4 or PA08/36 set 4 or PA09/36 set 4 or PA10/36 set 4 or PA13/36 set 4 or PA14/36 set 4 or PB02/36 set 4 or PB03/36 set 4 or PB04/36 set 4 or PB06/36 set 4 or PB07/36 set 4 or PB10/36 set 4 or PB11/36 set 4 or PC09/36 set 4 or PD07/36 set 4 or PE03/36 set 4; CMPTRDY PA00/41 set 3 or PA01/41 set 3 or PA02/41 set 3 or PA04/41 set 3 or PA05/41 set 3 or PA08/41 set 3 or PA09/41 set 3 or PA13/41 set 3 or PB01/41 set 3 or PB02/41 set 3 or PB03/41 set 3 or PB05/41 set 3 or PB06/41 set 3 or PB08/41 set 3 or PB09/41 set 3 or PB10/41 set 3 or PB13/41 set 3 or PC08/41 set 3 or PD06/41 set 3 or PE02/41 set 3; CMPTOUT PA00/37 set 4 or PA01/37 set 4 or PA02/37 set 4 or PA03/37 set 4 or PA05/37 set 4 or PA06/37 set 4 or PA08/37 set 4 or PA09/37 set 4 or PA10/37 set 4 or PA13/37 set 4 or PA14/37 set 4 or PB02/37 set 4 or PB03/37 set 4 or PB04/37 set 4 or PB06/37 set 4 or PB07/37 set 4 or PB10/37 set 4 or PB11/37 set 4 or PC09/37 set 4 or PD07/37 set 4 or PE03/37 set 4
  parameters: GCLK_ID=26, CHIP_AC_PADDR_MSB=9, CHIP_AC_IMPLEMENTS_VDBLR=0, CHIP_AC_PAIRS=1, CHIP_AC_NUM_CMP=2, CHIP_AC_FUSES_DATA_MSB=127, CHIP_AC_FUSES_RDY_MSB=3, CHIP_AC_FUSES_BIAS0_ROWID=4, CHIP_AC_FUSES_BIAS0_START=0, CHIP_AC_FUSES_BIAS0_SIZE=2, INSTANCE_ID=71 (Instance index for AC), PAC_ID=71 (Index for AC registers write protection), LOAD_CALIB=0
ADCHS at 0x44001500
  pins: ADCSVCLKI PA7/SILICON_VALIDATION__DFT_; ADCSVFRM PA9/SILICON_VALIDATION__DFT_; ADCSVSARCLK PA10/SILICON_VALIDATION__DFT_; ADCSVSOUT PB9/SILICON_VALIDATION__DFT_; ADCSVTRG PA8/SILICON_VALIDATION__DFT_; AIN0 PB10/ADC; AIN1 PB5/ADC; AIN2 PB6/ADC; AIN3 PB7/ADC; AIN4 PB0/ADC; AIN5 PB1/ADC; AIN6 PB2/ADC; AIN7 PB3/ADC; AIN8 PB4/ADC; AIN9 PD3/ADC; AIN10 PD4/ADC; AIN11 PD5/ADC; AIN12 PD6/ADC; AIN13 PD7/ADC; AIN14 PE6/ADC; AIN15 PC7/ADC; AIN16 PD2/ADC; AIN18 PB14/ADC; ANA0 PB11/ADC__ALTERNATE_; ANB0 PE5/ADC__ALTERNATE_; ANN0 PA14/ADC__DIFFERENTIAL_; ANN1 PA3/ADC__DIFFERENTIAL_; CVD1 PB5/ADC; CVD2 PB6/ADC; CVD3 PB7/ADC; CVD4 PB0/ADC; CVD5 PB1/ADC; CVD6 PB2/ADC; CVD7 PB3/ADC; CVD8 PB4/ADC; CVD9 PD3/ADC; CVD10 PD4/ADC; CVD11 PD5/ADC; CVD12 PD6/ADC; CVD13 PD7/ADC; CVD14 PE6/ADC; CVD15 PC7/ADC; CVD16 PD2/ADC; CVD18 PB14/ADC
  parameters: NUM_INTS=2, SET_CLR_INV_PRESENT=1 (Present), ADC_EXTERN_ANALOG_IP=0 (ADC SAR Core is Microchip), ADC_USE_SYNP_MUX=0 (ADC SAR Core is Microchip), ADC_VREF_STARTUP_TIME=50 (Time in ADC clock cycles to stabilize), ADC_CORE_CALIBRATE_TIME=81 (Time in ADC clock cycles to perform a calibrate), ADC_CORES_NMBR=2 (Total Number of SAR ADC Analog Cores), ADC_FCC_NMBR=1 (Number of First Class Analog Input Channels), ADC_ITRIG_NMBR=8 (Number of analog inputs), ADC_INPUTS_NMBR=13 (Number of analog inputs), ADC_UPB_FIFO_PRESENT=0 (UPB FIFO is not present), ADC_UPB_FIFO_DEPTH=0 (Number of words in UPB FIFO), ADC_BVCI_PORT_PRESENT=1 (BVCI port is implemented.), ADC_BVCI_FIFO_DEPTH=16 (Number of words in DMA BVCI FIFO), ADC_BVCI_ADDR_WIDTH=15 (Width in bits for the BVCI address offset.), ADC_DCMP_NMBR=2 (Number of digital comparators to be implemented.), ADC_FLTR_NMBR=2 (Number of digital oversampling filters to implement.), ADC_INTR_NMBR=114 (Number of Interrupt Source Signals), ADC_EARLY_INTR_PRESENT=0 (No early interrupts), ADC_32BIT_REG_ADDR=1 (Specifies 32-bit data register addressing.), ADC_32BIT_OUTPUT_DATA=1 (If set to 1, the output data is 32-bit wide), ADC_CVD_PRESENT=1 (CVD is present), AIN_19=19 (BandGap Reference), AIN_20=20 (ADC Charge Pump), AIN_21=21 (VDD Core), AIN_22=22 (VDD)
ARB at 0x41011000
BLE at 0x41012000
BTZBSYS at 0x41014000
  pins: TA4D_ALT PA6/TEST_MODES; RTC_IN0_ALT PA9/RTCC; MBISTCLK PA10/TEST_MODES; RTC_OUT_ALT PA10/RTCC; CLDO_IN CLDO_IN2/RF__ANALOG or CLDO_IN_CLKGEN/RF__ANALOG; CLDO_OUT CLDO_OUT_2/RF__ANALOG or CLDO_OUT_1/RF__ANALOG; EXTRA_30K EXTR_30K/RF__ANALOG; RF_IO RFINOUT_2/RF__ANALOG or RFINOUT_1/RF__ANALOG; VDD_RF RFLDO_IN/RF__ANALOG or VDD_PLL_LF/RF__ANALOG or VDD_PLL_HF/RF__ANALOG; RFLDO_OUT RFLDO_OUT/POWER_SUPPLY; xo_n XO_N/RF__ANALOG; xo_p XO_P/RF__ANALOG; TP2 PB8/RF__ANALOG; TP3 PB9/RF__ANALOG; TP4 PB4/RF__ANALOG; TP5 PB5/RF__ANALOG; TP6 PB8/RF__ANALOG; FEM_PD_EXT_PA PB9/RF__ANALOG; FECTRL0 PA00/40 set 2 or PA01/40 set 2 or PA03/40 set 2 or PA04/40 set 2 or PA07/40 set 2 or PA08/40 set 2 or PA11/40 set 2 or PA12/40 set 2 or PB00/40 set 2 or PB01/40 set 2 or PB02/40 set 2 or PB04/40 set 2 or PB05/40 set 2 or PB07/40 set 2 or PB08/40 set 2 or PB09/40 set 2 or PB12/40 set 2 or PB13/40 set 2 or PC01/40 set 2 or PD04/40 set 2 or PE01/40 set 2; FECTRL1 PA00/35 set 1 or PA02/35 set 1 or PA03/35 set 1 or PA06/35 set 1 or PA07/35 set 1 or PA09/35 set 1 or PA10/35 set 1 or PA11/35 set 1 or PA14/35 set 1 or PB00/35 set 1 or PB01/35 set 1 or PB03/35 set 1 or PB04/35 set 1 or PB06/35 set 1 or PB07/35 set 1 or PB08/35 set 1 or PB11/35 set 1 or PB12/35 set 1 or PC09/35 set 1 or PD06/35 set 1 or PE04/35 set 1; FECTRL2 PA00/36 set 1 or PA02/36 set 1 or PA03/36 set 1 or PA06/36 set 1 or PA07/36 set 1 or PA09/36 set 1 or PA10/36 set 1 or PA11/36 set 1 or PA14/36 set 1 or PB00/36 set 1 or PB01/36 set 1 or PB03/36 set 1 or PB04/36 set 1 or PB06/36 set 1 or PB07/36 set 1 or PB08/36 set 1 or PB11/36 set 1 or PB12/36 set 1 or PC09/36 set 1 or PD06/36 set 1 or PE04/36 set 1; FECTRL3 PA00/39 set 4 or PA01/39 set 4 or PA02/39 set 4 or PA03/39 set 4 or PA05/39 set 4 or PA06/39 set 4 or PA08/39 set 4 or PA09/39 set 4 or PA10/39 set 4 or PA13/39 set 4 or PA14/39 set 4 or PB02/39 set 4 or PB03/39 set 4 or PB04/39 set 4 or PB06/39 set 4 or PB07/39 set 4 or PB10/39 set 4 or PB11/39 set 4 or PC09/39 set 4 or PD07/39 set 4 or PE03/39 set 4; FECTRL4 PA00/42 set 3 or PA01/42 set 3 or PA02/42 set 3 or PA04/42 set 3 or PA05/42 set 3 or PA08/42 set 3 or PA09/42 set 3 or PA12/42 set 3 or PA13/42 set 3 or PB01/42 set 3 or PB02/42 set 3 or PB03/42 set 3 or PB05/42 set 3 or PB06/42 set 3 or PB08/42 set 3 or PB09/42 set 3 or PB10/42 set 3 or PB13/42 set 3 or PC08/42 set 3 or PD06/42 set 3 or PE02/42 set 3; FECTRL5 PA00/40 set 4 or PA01/40 set 4 or PA02/40 set 4 or PA03/40 set 4 or PA05/40 set 4 or PA06/40 set 4 or PA08/40 set 4 or PA09/40 set 4 or PA10/40 set 4 or PA13/40 set 4 or PA14/40 set 4 or PB02/40 set 4 or PB03/40 set 4 or PB04/40 set 4 or PB06/40 set 4 or PB07/40 set 4 or PB10/40 set 4 or PB11/40 set 4 or PC09/40 set 4 or PD07/40 set 4 or PE03/40 set 4; COEX_RF_ACT PA00/41 set 2 or PA01/41 set 2 or PA03/41 set 2 or PA04/41 set 2 or PA07/41 set 2 or PA08/41 set 2 or PA11/41 set 2 or PA12/41 set 2 or PB00/41 set 2 or PB01/41 set 2 or PB02/41 set 2 or PB04/41 set 2 or PB05/41 set 2 or PB07/41 set 2 or PB08/41 set 2 or PB09/41 set 2 or PB12/41 set 2 or PB13/41 set 2 or PC01/41 set 2 or PD04/41 set 2 or PE01/41 set 2; COEX_BT_STATE PA00/37 set 1 or PA02/37 set 1 or PA03/37 set 1 or PA06/37 set 1 or PA07/37 set 1 or PA09/37 set 1 or PA10/37 set 1 or PA11/37 set 1 or PA14/37 set 1 or PB00/37 set 1 or PB01/37 set 1 or PB03/37 set 1 or PB04/37 set 1 or PB06/37 set 1 or PB07/37 set 1 or PB08/37 set 1 or PB11/37 set 1 or PB12/37 set 1 or PC09/37 set 1 or PD06/37 set 1 or PE04/37 set 1; COEX_WLAN_ACT PA03/1 set 4 or PA09/2 set 4 or PA14/3 set 4 or PB03/4 set 4 or PD03/6 set 4 or PA00/8 set 4 or PB04/9 set 4 or PD07/11 set 4 or PA06/13 set 4 or PA10/14 set 4 or PB07/15 set 4 or PB11/16 set 4 or PA01/17 set 4 or PA05/18 set 4 or PA13/19 set 4 or PB02/20 set 4 or PB06/21 set 4 or PB10/22 set 4 or PA08/23 set 4 or PA02/24 set 4
CAN0 at 0x46002000 (CAN)
  pins: RX PA9/ENHANCED_CAN; TX PA8/ENHANCED_CAN
  parameters: INSTANCE_ID=104 (Instance index for CAN0), GCLK_ID=28, CAN_PADDR_MSB=12, CAN_MSG_RAM_ADDR=0x20, CAN_EXT_TSTAMP_IMPLEMENTED=0, CAN_ECC_BERR_IMPLEMENTED=0, CAN_RXD_SYNC_METHOD=0, CAN_VERSION=0x30203, DMAC_ID_DBGMSG=67, PAC_ID=104 (Index for CAN0 registers write protection)
CAN1 at 0x46002400 (CAN)
  pins: RX PA02/1 set 3 or PA08/2 set 3 or PA13/3 set 3 or PB02/4 set 3 or PB08/5 set 3 or PB13/6 set 3 or PD02/8 set 3 or PA04/10 set 3 or PB03/11 set 3 or PD06/13 set 3 or PA05/15 set 3 or PA09/16 set 3 or PB06/17 set 3 or PB10/18 set 3 or PA00/19 set 3 or PB01/20 set 3 or PB05/21 set 3 or PB09/22 set 3 or PA01/23 set 3 or PA12/24 set 3; TX PA00/38 set 4 or PA01/38 set 4 or PA02/38 set 4 or PA03/38 set 4 or PA05/38 set 4 or PA06/38 set 4 or PA08/38 set 4 or PA09/38 set 4 or PA10/38 set 4 or PA13/38 set 4 or PA14/38 set 4 or PB02/38 set 4 or PB03/38 set 4 or PB04/38 set 4 or PB06/38 set 4 or PB07/38 set 4 or PB10/38 set 4 or PB11/38 set 4 or PC09/38 set 4 or PD07/38 set 4 or PE03/38 set 4
  parameters: INSTANCE_ID=105 (Instance index for CAN1), GCLK_ID=29, CAN_PADDR_MSB=12, CAN_MSG_RAM_ADDR=0x20, CAN_EXT_TSTAMP_IMPLEMENTED=0, CAN_ECC_BERR_IMPLEMENTED=0, CAN_RXD_SYNC_METHOD=0, CAN_VERSION=0x30203, DMAC_ID_DBGMSG=68, PAC_ID=105 (Index for CAN1 registers write protection)
CCL at 0x42001800
  pins: IN0 PA00/1 set 1 or PA06/2 set 1 or PA11/3 set 1 or PB00/4 set 1 or PB06/5 set 1 or PB11/6 set 1 or PD06/8 set 1 or PE06/10 set 1 or PB01/11 set 1 or PD03/13 set 1 or PA03/15 set 1 or PA07/16 set 1 or PB04/17 set 1 or PB08/18 set 1 or PB12/19 set 1 or PA02/20 set 1 or PA10/21 set 1 or PA14/22 set 1 or PB03/23 set 1 or PB07/24 set 1 or PA09/25 set 1; IN1 PA01/1 set 2 or PA07/2 set 2 or PA12/3 set 2 or PB01/4 set 2 or PB07/5 set 2 or PC07/7 set 2 or PE01/9 set 2 or PA03/10 set 2 or PB02/11 set 2 or PD04/13 set 2 or PA04/15 set 2 or PA08/16 set 2 or PB12/17 set 2 or PB05/18 set 2 or PB09/19 set 2 or PB13/20 set 2 or PB00/21 set 2 or PB04/22 set 2 or PB08/23 set 2 or PA00/24 set 2 or PA11/25 set 2; IN2 PA02/1 set 3 or PA08/2 set 3 or PA13/3 set 3 or PB02/4 set 3 or PB08/5 set 3 or PB13/6 set 3 or PD02/8 set 3 or PA04/10 set 3 or PB03/11 set 3 or PD06/13 set 3 or PA05/15 set 3 or PA09/16 set 3 or PB06/17 set 3 or PB10/18 set 3 or PA00/19 set 3 or PB01/20 set 3 or PB05/21 set 3 or PB09/22 set 3 or PA01/23 set 3 or PA12/24 set 3; IN3 PA00/1 set 1 or PA06/2 set 1 or PA11/3 set 1 or PB00/4 set 1 or PB06/5 set 1 or PB11/6 set 1 or PD06/8 set 1 or PE06/10 set 1 or PB01/11 set 1 or PD03/13 set 1 or PA03/15 set 1 or PA07/16 set 1 or PB04/17 set 1 or PB08/18 set 1 or PB12/19 set 1 or PA02/20 set 1 or PA10/21 set 1 or PA14/22 set 1 or PB03/23 set 1 or PB07/24 set 1 or PA09/25 set 1; IN4 PA01/1 set 2 or PA07/2 set 2 or PA12/3 set 2 or PB01/4 set 2 or PB07/5 set 2 or PC07/7 set 2 or PE01/9 set 2 or PA03/10 set 2 or PB02/11 set 2 or PD04/13 set 2 or PA04/15 set 2 or PA08/16 set 2 or PB12/17 set 2 or PB05/18 set 2 or PB09/19 set 2 or PB13/20 set 2 or PB00/21 set 2 or PB04/22 set 2 or PB08/23 set 2 or PA00/24 set 2 or PA11/25 set 2; IN5 PA02/1 set 3 or PA08/2 set 3 or PA13/3 set 3 or PB02/4 set 3 or PB08/5 set 3 or PB13/6 set 3 or PD02/8 set 3 or PA04/10 set 3 or PB03/11 set 3 or PD06/13 set 3 or PA05/15 set 3 or PA09/16 set 3 or PB06/17 set 3 or PB10/18 set 3 or PA00/19 set 3 or PB01/20 set 3 or PB05/21 set 3 or PB09/22 set 3 or PA01/23 set 3 or PA12/24 set 3; OUT0 PA00/1 set 3 or PA01/1 set 3 or PA02/1 set 3 or PA04/1 set 3 or PA05/1 set 3 or PA08/1 set 3 or PA09/1 set 3 or PA12/1 set 3 or PA13/1 set 3 or PB01/1 set 3 or PB02/1 set 3 or PB03/1 set 3 or PB05/1 set 3 or PB06/1 set 3 or PB08/1 set 3 or PB09/1 set 3 or PB10/1 set 3 or PB13/1 set 3 or PC08/1 set 3 or PD06/1 set 3 or PE02/1 set 3 or PA01/1 set 5 or PA04/1 set 5 or PA10/1 set 5 or PB00/1 set 5 or PB04/1 set 5 or PB10/1 set 5 or PB15/1 set 5 or PC10/1 set 5 or PD00/1 set 5 or PD02/1 set 5 or PE02/1 set 5; OUT1 PA00/1 set 2 or PA01/1 set 2 or PA03/1 set 2 or PA04/1 set 2 or PA07/1 set 2 or PA08/1 set 2 or PA11/1 set 2 or PA12/1 set 2 or PB00/1 set 2 or PB01/1 set 2 or PB02/1 set 2 or PB04/1 set 2 or PB05/1 set 2 or PB07/1 set 2 or PB08/1 set 2 or PB09/1 set 2 or PB12/1 set 2 or PB13/1 set 2 or PC01/1 set 2 or PD04/1 set 2 or PE01/1 set 2 or PA00/1 set 4 or PA01/1 set 4 or PA02/1 set 4 or PA03/1 set 4 or PA05/1 set 4 or PA06/1 set 4 or PA08/1 set 4 or PA09/1 set 4 or PA10/1 set 4 or PA13/1 set 4 or PA14/1 set 4 or PB02/1 set 4 or PB03/1 set 4 or PB04/1 set 4 or PB06/1 set 4 or PB07/1 set 4 or PB10/1 set 4 or PB11/1 set 4 or PC09/1 set 4 or PD07/1 set 4 or PE03/1 set 4
  parameters: GCLK_ID=0, CHIP_CCL_PADDR_MSB=9, CHIP_CCL_LUT_NUM=2, INSTANCE_ID=70 (Instance index for CCL), PAC_ID=70 (Index for CCL registers write protection)
CFG at 0x44000000
CMCC at 0x41002000
CRU at 0x44000A00
  pins: REFI PA05/1 set 6 or PB05/2 set 6 or PB09/3 set 6 or PE05/5 set 6 or PA03/6 set 6 or PA06/7 set 6 or PA07/8 set 6 or PB06/9 set 6 or PB08/10 set 6; REFO1 PA03/8 set 6 or PA05/8 set 6 or PA06/8 set 6 or PA07/8 set 6 or PB05/8 set 6 or PB06/8 set 6 or PB08/8 set 6 or PB09/8 set 6 or PE05/8 set 6; REFO2 PA03/9 set 6 or PA05/9 set 6 or PA06/9 set 6 or PA07/9 set 6 or PB05/9 set 6 or PB06/9 set 6 or PB08/9 set 6 or PB09/9 set 6 or PE05/9 set 6; REFO3 PA03/10 set 6 or PA05/10 set 6 or PA06/10 set 6 or PA07/10 set 6 or PB05/10 set 6 or PB06/10 set 6 or PB08/10 set 6 or PB09/10 set 6 or PE05/10 set 6; REFO4 PA03/11 set 6 or PA05/11 set 6 or PA06/11 set 6 or PA07/11 set 6 or PB05/11 set 6 or PB06/11 set 6 or PB08/11 set 6 or PB09/11 set 6 or PE05/11 set 6
CVD at 0x44002400
  pins: CVDR1 PB5/ADC; CVDR2 PB6/ADC; CVDR3 PB7/ADC; CVDR4 PB0/ADC; CVDR5 PB1/ADC; CVDR6 PB2/ADC; CVDR7 PB3/ADC; CVDR8 PB4/ADC; CVDR9 PD3/ADC; CVDR10 PD4/ADC; CVDR11 PD5/ADC; CVDR12 PD6/ADC; CVDR13 PD7/ADC; CVDR14 PE6/ADC; CVDR15 PC7/ADC; CVDR16 PD2/ADC; CVDR18 PB14/ADC; CVDT0 PD2/ADC; CVDT1 PB5/ADC; CVDT2 PB6/ADC; CVDT3 PB7/ADC; CVDT4 PB0/ADC; CVDT5 PB1/ADC; CVDT6 PB2/ADC; CVDT7 PB3/ADC; CVDT8 PB4/ADC; CVDT9 PD3/ADC; CVDT10 PD4/ADC; CVDT11 PD5/ADC; CVDT12 PD6/ADC; CVDT13 PD7/ADC; CVDT14 PE6/ADC; CVDT15 PC7/ADC; CVDT17 PB14/ADC
  parameters: CVD_AN_MAX=8 (Max number of AN input index), CVD_AN_MIN=0 (Min number of AN input index), CVD_TX_NUM=18 (Number of TX outputs on the device. Max of 64), CVD_FIFO_DEPTH=32 (Number of words in the UPB FIFO. Max is 1KThe depth of the UPB FIFO is limited to "powers of 2".Allowable values are: 8, 16, 32, 64, 128, 256, 512, 1K), ADCBITS=12 (Number of bits in the ADC data. Max is 16-bit.), NUM_RX=20 (Number of RX Indexes.), NUM_TX=20 (Number of TX Indexes.), UPB_ADDRL=0x2400 (Start address of UPB registers), NUM_ADC=1, GCLK_ID=31
CoreDebug at 0xE000EDF0
DAC_CTRL at 0x44002E00
  pins: DACOUT PA3/DAC
DMAC at 0x41004000
  parameters: TRIG_NUM=67, DMA_EVIN_NUM=8, DMA_CH_NUM=16, DMA_EVOUT_NUM=4, DMA_FIFO_SIZE=16, INSTANCE_ID=34 (Instance index for DMAC), PAC_ID=34 (Index for DMAC registers write protection)
DMT at 0x44000E00
  parameters: DMT_HOLDREG_PRESENT=1 (Used for 16 bit devices only), UPB_ADDRL=0xE00 (Base address for the macro)
DSCON at 0x42011000
  parameters: DS_NUM_XSEMA_REGS=1, SYS_DATA_WIDTH=32, KEYRAMEN_BIT_PRESENT=0
DSU at 0x41000000
  pins: MSA PB10/TEST_MODES
  parameters: DMAC_ID_DCC0=2, DMAC_ID_DCC1=3, PERM_ADDR_START1=0x44000600 (Permissible address range start), PERM_ADDR_END1=0x440007FF (Permissible address range end), PERM_ADDR_START2=0x44003000 (Second permissible address range start), PERM_ADDR_END2=0x44003FFF (Second permissible address range end), FLASH_ADDR_START=0x00800000 (Flash address start), FLASH_ADDR_END=0x011FFFFF (Flash address end), MBIST_IMPLEMENTED=1 (MBIST Controller Enabled), INSTANCE_ID=32 (Instance index for DSU), DSU_DMAC_ID_DCC0=2, DSU_DMAC_ID_DCC1=3, PAC_ID=32 (Index for DSU registers write protection)
DWT at 0xE0001000
EIC at 0x40000800
  pins: EXTINT0 PA00/1 set 1 or PA06/2 set 1 or PA11/3 set 1 or PB00/4 set 1 or PB06/5 set 1 or PB11/6 set 1 or PD06/8 set 1 or PE06/10 set 1 or PB01/11 set 1 or PD03/13 set 1 or PA03/15 set 1 or PA07/16 set 1 or PB04/17 set 1 or PB08/18 set 1 or PB12/19 set 1 or PA02/20 set 1 or PA10/21 set 1 or PA14/22 set 1 or PB03/23 set 1 or PB07/24 set 1 or PA09/25 set 1; EXTINT1 PA01/1 set 2 or PA07/2 set 2 or PA12/3 set 2 or PB01/4 set 2 or PB07/5 set 2 or PC07/7 set 2 or PE01/9 set 2 or PA03/10 set 2 or PB02/11 set 2 or PD04/13 set 2 or PA04/15 set 2 or PA08/16 set 2 or PB12/17 set 2 or PB05/18 set 2 or PB09/19 set 2 or PB13/20 set 2 or PB00/21 set 2 or PB04/22 set 2 or PB08/23 set 2 or PA00/24 set 2 or PA11/25 set 2; EXTINT2 PA02/1 set 3 or PA08/2 set 3 or PA13/3 set 3 or PB02/4 set 3 or PB08/5 set 3 or PB13/6 set 3 or PD02/8 set 3 or PA04/10 set 3 or PB03/11 set 3 or PD06/13 set 3 or PA05/15 set 3 or PA09/16 set 3 or PB06/17 set 3 or PB10/18 set 3 or PA00/19 set 3 or PB01/20 set 3 or PB05/21 set 3 or PB09/22 set 3 or PA01/23 set 3 or PA12/24 set 3; EXTINT3 PA03/1 set 4 or PA09/2 set 4 or PA14/3 set 4 or PB03/4 set 4 or PD03/6 set 4 or PA00/8 set 4 or PB04/9 set 4 or PD07/11 set 4 or PA06/13 set 4 or PA10/14 set 4 or PB07/15 set 4 or PB11/16 set 4 or PA01/17 set 4 or PA05/18 set 4 or PA13/19 set 4 or PB02/20 set 4 or PB06/21 set 4 or PB10/22 set 4 or PA08/23 set 4 or PA02/24 set 4; NMI PA03/1 set 4 or PA09/2 set 4 or PA14/3 set 4 or PB03/4 set 4 or PD03/6 set 4 or PA00/8 set 4 or PB04/9 set 4 or PD07/11 set 4 or PA06/13 set 4 or PA10/14 set 4 or PB07/15 set 4 or PB11/16 set 4 or PA01/17 set 4 or PA05/18 set 4 or PA13/19 set 4 or PB02/20 set 4 or PB06/21 set 4 or PB10/22 set 4 or PA08/23 set 4 or PA02/24 set 4
  parameters: GCLK_ID=0, CHIP_EIC_PADDR_MSB=9, CHIP_EIC_EXTINT_NUM=4, CHIP_EIC_NMISENSE_DEFAULT_VALUE=3, CHIP_EIC_NMI_FORCE_DETECTION=0, CHIP_EIC_NUMBER_OF_CONFIG_REGS=1 ((CHIP_EIC_EXTINT_NUM+7)/8), CHIP_EIC_NUMBER_OF_DPRESCALER_REGS=1 ((CHIP_EIC_EXTINT_NUM+7)/8), CHIP_EIC_NUMBER_OF_INTERRUPTS=4 (CHIP_EIC_EXTINT_NUM), INSTANCE_ID=2 (Instance index for EIC), PAC_ID=2 (Index for EIC registers write protection)
EFUSE at 0x0 in fuses
ETH at 0x4100A000
  parameters: GCLK_ID=30, PAC_ID=37 (Index for ETH registers write protection)
ETM at 0xE0041000
EVSYS at 0x41006000
  parameters: INSTANCE_ID=35 (Instance index for EVSYS), GCLK_ID_{n}={n+12} (n=0..11), CHIP_EVSYS_PADDR_MSB=12, CHIP_EVSYS_EXTEVT_NUM=0, CHIP_EVSYS_ASYNCHRONOUS_CHANNELS=32, CHIP_EVSYS_CHANNELS=32, CHIP_EVSYS_GENERATORS=89, CHIP_EVSYS_SYNCH_NUM=12, CHIP_EVSYS_USERS=59, CHIP_EVSYS_CHANNELS_BITS=5, CHIP_EVSYS_GENERATORS_BITS=7, CHIP_EVSYS_SYNCH_NUM_BITS=4, CHIP_EVSYS_USERS_BITS=6, PAC_ID=35 (Index for EVSYS registers write protection)
FPU at 0xE000EF30
FREQM at 0x40000400
  parameters: INSTANCE_ID=1 (Instance index for FREQM), GCLK_ID_MSR=1, GCLK_ID_REF=2, PAC_ID=1 (Index for FREQM registers write protection)
FUSES at FUSES_DEVICECFG 0x00810E80
GPIOE at 0x44002D00 (GPIO)
  pins: IOCE0 PE0/CHANGE_NOTIFICATION; IOCE1 PE1/CHANGE_NOTIFICATION; IOCE2 PE2/CHANGE_NOTIFICATION; IOCE3 PE3/CHANGE_NOTIFICATION; IOCE4 PE4/CHANGE_NOTIFICATION; IOCE5 PE5/CHANGE_NOTIFICATION; IOCE6 PE6/CHANGE_NOTIFICATION; RE0 PE0/PORT_I_O; RE1 PE1/PORT_I_O; RE2 PE2/PORT_I_O; RE3 PE3/PORT_I_O; RE4 PE4/PORT_I_O; RE5 PE5/PORT_I_O; RE6 PE6/PORT_I_O
GPIOD at 0x44002C00 (GPIO)
  pins: IOCD2 PD2/CHANGE_NOTIFICATION; IOCD3 PD3/CHANGE_NOTIFICATION; IOCD4 PD4/CHANGE_NOTIFICATION; IOCD5 PD5/CHANGE_NOTIFICATION; IOCD6 PD6/CHANGE_NOTIFICATION; IOCD7 PD7/CHANGE_NOTIFICATION; RD{n} PD{n}/PORT_I_O (n=0..7)
GPIOC at 0x44002B00 (GPIO)
  pins: IOCC0 PC0/CHANGE_NOTIFICATION; IOCC1 PC1/CHANGE_NOTIFICATION; IOCC7 PC7/CHANGE_NOTIFICATION; IOCC8 PC8/CHANGE_NOTIFICATION; IOCC9 PC9/CHANGE_NOTIFICATION; RC0 PC0/PORT_I_O; RC1 PC1/PORT_I_O; RC7 PC7/PORT_I_O; RC8 PC8/PORT_I_O; RC9 PC9/PORT_I_O; RC11 PC11/PORT_I_O
GPIOB at 0x44002A00 (GPIO)
  pins: IOCB{n} PB{n}/CHANGE_NOTIFICATION (n=0..13); IOCB15 PB15/CHANGE_NOTIFICATION; RB{n} PB{n}/PORT_I_O (n=0..13); RB15 PB15/PORT_I_O
GPIOA at 0x44002900 (GPIO)
  pins: IOCA{n} PA{n}/CHANGE_NOTIFICATION (n=0..14); RA{n} PA{n}/PORT_I_O (n=0..14)
HMATRIX2TOP at 0x42002400
  parameters: INSTANCE_ID=73 (Instance index for HMATRIX2TOP), PAC_ID=73 (Index for HMATRIX2TOP registers write protection)
ITM at 0xE0000000
MPU at 0xE000ED90
NVIC at 0xE000E100
  parameters: NUM_IRQ=58 (Number of interrupt requests), __NVIC_PRIO_BITS=3 (Number of NVIC interrupt priority bits)
NVM at 0x44000600
  parameters: PFM_ADDR_BASE=0x0100_0000 (Physical Start address of Program Flash Memory in KSEG0/KSEG1 (system address). Address must be aligned to the PFM size. Refer Table 3-24), BOOT_ADDR_BASE=0x0080_0000 (Physical Start address of boot flash memory (system address). Address must be aligned to the NVR size.), BOOT_ADDR_END=0x0081_0FFF (Physical End address of boot flash memory (system address)), OTP_ADDR_BASE=0x0081_1000 (Physical Start address of OTP page flash memory (system address)), NVR_ADDR_END=0x0081_2FFF (Physical End address of secure boot flash memory (system address)), TEST_ADDR_BASE=0x0085_2000 (Physical Base address of Test page flash memory (system address)), TEST_ADDR_END=0x0085_2FFF (Physical End address of test flash memory (system address)), PFM_SYS_ADDR_MSB=20 (The MS bit of the system address needed to address all flash memory. Used by Flash BIST. MSB of 19 = 2^20 = 1MB), FIXED_BOOT_SEL_BIT=18 (The highest bit position that allows address decode to differentiate between fixed and aliased NVR address space. When set, this bit will select fixed NVR space.), NVR_PANEL_SEL_BIT=17 (The highest bit position that allows address decode to differentiate between NVR address space in Panel 1 and Panel 2 (if supported).Note: The value for NVR_PANEL_SEL_BIT will typically be FIXED_BOOT_SEL_BIT-1), F1RR_ADDR=0x0085_2FFF (System physical address of Panel 1's first Redundancy Record.Typically TEST_ADDR_END), F2RR_ADDR=0x0085_2FDF (System physical address of Panel 2's first RedundancyRecord.Typically F1RR_ADDR-(32*RR_NUM_WORDS)), TCFG_ADDR=0x0085_2FBF (System physical address of first TCFG data.Typically F2RR_ADDR-(32*RR_NUM_WORDS)), SEQNUM_ADDR=0x0085_0FFF (System physical address of Panel 1's Sequence Number.Typically BOOT_ADDR_END.), SIGN_ADDR=0x0085_0FDF (System physical address of SIGNTypically SEQNUM_ADDR-32.), CP_ADDR=0x0085_0FBF (System physical address CPTypically SIGN_ADDR-32.), BCFG_ADDR=0x0085_0F9F (System physical address of first BCFG data.Typically CP_ADDR-32.), BCFG_PAGE=16 (NVR page contain BCFG data. The page must be consistent with the BCFG_ADDR[] parameter.), NVMOTP_PAGE=17 (NVR page contain OTP data. The page must be consistentwith the OTP_ADDR_BASE[] parameter.), TCFG_PAGE=18 (NVR page contain TCFG data. The page must be consistent with the TCFG_ADDR[] parameter.), ALT_CFG_SEL_BIT=8 (Bit number to toggle in Main BCFG or TCFG address to generate the equivalent address within the Alternate BCFG or TCFG space.Used in the event of an (unrecoverable) ECC DED error while reading the Main BCFG or TCFG data set.), BCFG_NUM_WORDS=1 (Number of Boot configuration words to be read from Flash), TCFG_NUM_WORDS=2 (Number of Test configuration words to be read from Flash), RR_NUM_WORDS=1 (Number of Flash reads to load Redundancy Record wordsfrom Flash. Does not include Flash IP CFG.Note: This value must always be greater than or equal 1), SIGN_BIT_LOCATION=255 (The signature value is stored in it own flash word at SIGN_ADDR[] location. This is to support flash panels with ECC or restrictions on multi-programming per word/bit. The sign bit position must be set to PFM_DATA_MSB.), CP_BIT_LOCATION=252 (The Code Protect value is stored in it own flash word at CP_ADDR[] location. This is to support flash panels with ECC or restrictions on multi-programming per word/bit.The sign bit position must be set to PFM_DATA_MSB-3.), JTAGEN_BIT_LOCATION=226 (Location of the sign bit in the boot config word. This bit must never be programmed to 0 during a checkerboard program. PFM_DATA_MSB-29Config words are 128-bit regardless of the flash word size.), PFM_NUM_PANELS=1 (Number of Flash panels supported in deviceValid entries are 1 or 2.), PFM_ECC_PRESENT=1 (0: ECC not supported,1: ECC supported), PFM_DATA_MSB=255 (Flash wrapper read data bus width-1), PFM_PNL_DATA_MSB=271 (Flash panel read data bus width-1), PFM_PNL_ADDR_MSB=20 (Flash panel read address bus width-1), ROW_ADDR_MSB=9 (Flash row word counter MSB (9=256 words per row)), PAGE_ADDR_MSB=11 (Flash Page Size MSB (using byte addressing) (11=4KB page)), NVR_NUM_PAGES=24 (Number of Pages in the NVR regionThe following values must be supported: 8, 24), NVR_TEST_PAGES=1 (Number of Pages in the Panel 1 NVR for Test.), PFM_JTAG_MSB=67 (JTAG checkerboard pattern data width-1), VALIDS_PER_WORD=2 (Number of 128-bit writes to CFG per configuration reads fromflash. If the CFG block does not implement all CFG registersas defined then those VALIDS should not be connected.Note: This value must always be either 1 or 2.), RR_NUM_RECORDS=8 (Number of Redundancy Records per Panel. Redundancy Records are 16-bit values. Panels usually have 1 Redundant Page per 512KB.Note: Valid values are 1,2,4,8,16,32.), PFM_ERASE_RETRY_PRESENT=1 (0: Erase/Retry Feature not Present1: Erase/Retry Feature Present), PFM_SRHT_PRESENT=0 (Slow Read High Temp0: SRHT Feature not Present1: SRHT Feature Present), FLASH_SIZE=2097152, PAGES=512, PAGES_PR_REGION=32
PAC at 0x40000000
  parameters: CHIP_PAC_PADDR_MSB=9, CHIP_PAC_HMATRIX1_IMPLEMENTED=0, CHIP_PAC_HPB_NUM=4, CHIP_PAC_HMATRIX0_SLAVE_SIZE=14, CHIP_PAC_HMATRIX1_SLAVE_SIZE=0, INSTANCE_ID=0 (Instance index for PAC), PAC_ID=0 (Index for PAC registers write protection)
PCHE at 0x44012400
  parameters: UPB_ADDRL=0x2400, NUM_INTS=1 (ECC present), PFM_ECC_PRESENT=1 (ECC present), DCHE_PRIORITY=0 (dCache has equal priority with iCache and aCache), CHE_TAG_MASK=0xFD00000F, PFM_RDATA_MSB=255 (bit flash data and 16-byte cache lines), NUM_CL_I=4, NUM_CL_D=2, NUM_CL_A=2, FLOP_BASED_CACHE_ARRAY_I=1 (Subject to Change / Design Legwork is needed), FLOP_BASED_CACHE_ARRAY_D=1 (Subject to Change / Design Legwork is needed), FLOP_BASED_CACHE_ARRAY_A=1 (Subject to Change / Design Legwork is needed)
PFW at 0x44000800
  parameters: BOOT_ADDR_BASE=0x00000000 (Physical Start address of boot flash memory (system address). Address must be aligned to the NVR size.), FIXED_BOOT_SEL_BIT=18 (The highest bit position that allows address decode to differentiate between fixed and aliased NVR address space. When set, this bit will select fixed NVR space.), NVR_PANEL_SEL_BIT=17 (The highest bit position that allows address decode to differentiate between NVR address space in Panel 1 and Panel 2 (if supported). Note: the value for NVR_PANEL_SEL_BIT will typically be FIXED_BOOT_SEL_BIT-1This parameter is not applicable as there is only a single panel), PFM_PNL_ADDR_MSB=20 (The MSb of the PFM Panel Byte Address.For example, an 18 indicates that each PFM panel is 512KBbecause 2(18+1)=512K.), PAGE_ADDR_MSB=11 (The MSb of the Address bit that defines the page size), FLASH_SIZE_ON_DEVICE=8 (Flash size implemented on the device:In a dual panel system, half this value is the size of each panel.0000 = 8KB0001 = 16KB0010 = 32KB0011 = 64KB0100 = 128KB0101 = 256KB0110 = 512KB0111 = 1MB1000 = 2MB1001 = 4MB1010 = 8MB1011 = 16MB1100 - 1111 = RSVD - use 16MBNote: This values does not include the size of the NVR region.), PFM_NUM_PANELS=1 (Number of Flash panels supported in device), RR_NUM_RECORDS=8 (Number of Redundancy Records per Panel. Redundancy Records are 16-bit values. Panels usually have 1 Redundant Page per 512KB.Note: Valid values are 1,2,4,8,16,32.), NVR_NUM_PAGES=24 (Number of Pages in the NVR regionThe following values must be supported: 8, 24), PFM_PNL_DATA_MSB=271 (The MSb of the data including ECCThe following values are supported.139,271 if PFM_ECC_PRESENT==1127,255 if PFM_ECC_PRESENT==0), PFM_DATA_MSB=255 (The MSb of the PFM Data (post ECC if implement).The following values are supported.127,255), PFM_ECC_PRESENT=1 (0: ECC not supported1: ECC supported), PFM_CRC_PRESENT=1 (0: CRC not supported1: CRC supported), FRC_PERIOD_MIN=95 (Minimum FRC period (ns) - pre-calibration Power up timing must be met using an uncalibrated FRCNote: This number must be adjusted for the accuracy of the FRC.), FRC_PERIOD_NOM=119 (Nominal FRC period (ns) - post-calibration DPD, Read Mode, etc timing uses a calibrated FRC.Note: This number must be adjusted for the accuracy of the FRC.), PFM_TDPDH_NS=8000 (DPD Recovery (Tdpdh) delay spec (ns)), PFM_TDPDS_NS=100 (DPD Setup (Tdpds) delay spec (ns)), PFM_TMS_NS=5000 (Read Mode Setup (Tcrs or Tms) delay spec (ns)), PFM_TMH_NS=100 (Read Mode Hold (Tcrh or Tmh) delay spec (ns)), PFM_TRT_NS=500 (PORb Release Time (Trt) delay spec (ns):defined from rst_reset_por_n=1 to PORb=1), PFM_TRHR_NS=8000 (POR recovery (Trhr) delay spec (ns)), PFM_TONWAIT_NS=6000 (Power-up to any operation (ns): aka tONWAITUsed with tCFG as follows:Actual Delay Required = tONWAIT - tCFG), PFM_TCFG_NS=5000 (LKCFG hold (Tcfg) spec (ns): aka tCFGPORb High to LKCFG high), NUM_INTS=1 (Number of interrupts generated by this macro.), UPB_ADDRL=0x800 (This parameter is the lowest peripheral bus address the peripheral module owns (i.e., the base address)), UPB_DEFAULT_SPACING=0x0004
PMU at 0x44013E00
  pins: INT0 PB9/EDGE_INTERRUPT; RDY_OVERRIDE PMU_RDY_OVERRIDE/RF__DIGITAL; TEST_CS PA9/RF__DIGITAL; TEST_SCK PA7/RF__DIGITAL; TEST_SCKO PB8/RF__DIGITAL; TEST_SDI PA8/RF__DIGITAL; TEST_SDO PA10/RF__DIGITAL; bk_lx PMU_BK_LX1/RF__ANALOG or PMU_BK_LX2/RF__ANALOG; mldo_buck_vsense PMU_MLDO_BUCK_VSENSE/RF__ANALOG; mldo_out PMU_MLDO_OUT2/RF__ANALOG or PMU_MLDO_OUT1/RF__ANALOG; sub PMU_SUB/RF__ANALOG; rdy_override PMU_RDY_OVERRIDE/RF__ANALOG
  parameters: SPI_ADDR_WIDTH=8, SPI_DATA_WIDTH=16, SPI_DRIVING=0 (Falling Edge (Rising Edge / Falling Edge)), SPI_SAMPLING=0 (Falling Edge (Rising Edge / Falling Edge)), NO_OF_BUCK_SQEQ_REGS=3 (Register values to be taken from Analog Design team), RST_CYCLES=8 (Duration of SPI Soft Reset in terms of number of SPI Clock Cycles), SPI_CTRL_STARTUP_VAL=4 (spi_cs_n_mv, spi_clk_mv, spi_dout_mv), LDO1_STARTUP_VAL=1 (Definition and usage refer to Section 3.63), LDO2_STARTUP_VAL=1 (Definition and usage refer to Section 3.63), LDO3_STARTUP_VAL=10 (Definition and usage refer to Section 3.63), LDO4_STARTUP_VAL=0 (Definition and usage refer to Section 3.63), MLDO_OPER_VAL=3 (buck_en_mv, mldo_en_mv, buck_mode_mv), BUCK_OPER_VAL=5 ({buck_en_mv, mldo_en_mv, buck_mode_mv}), SW_VAL=7 ({buck_en_mv, mldo_en_mv, buck_mode_mv}), WCM_SIZE=8, WCM_TRANSITION_TIME=4 (ns based on feedback from ARM and Design team), WCM_RET1N_TIME=4 (ns based on feedback from ARM and Design team), BUCK_SEQ_RETRY_NUM=10, NUM_LDO=3 (Number of LDOs(CLDO, SoC LDO, VREGPLL)), WLDO_NUM=3 (N/A if > NUM_LDOS), SHARED_LDO_MODE=1 (WCM memory Core does not use separate LDO in run and in retention mode), VBC_INDIRECT_MODE=1 (New)
PPS at 0x44001000
  pins: RPA{n} PA{n} (n=0..14); RPB{n} PB{n} (n=0..13); RPB15 PB15; RPC0 PC0; RPC1 PC1; RPC7 PC7; RPC8 PC8; RPC9 PC9; RPC11 PC11; RPD{n} PD{n} (n=0..7); RPE0 PE0; RPE1 PE1; RPE2 PE2; RPE3 PE3; RPE4 PE4; RPE5 PE5; RPE6 PE6
  parameters: PB_ADDRL=0x1000, PB_ADDRH=0x14FF
QEI at 0x44005000
  pins: HOME0 PA00/1 set 1 or PA06/2 set 1 or PA11/3 set 1 or PB00/4 set 1 or PB06/5 set 1 or PB11/6 set 1 or PD06/8 set 1 or PE06/10 set 1 or PB01/11 set 1 or PD03/13 set 1 or PA03/15 set 1 or PA07/16 set 1 or PB04/17 set 1 or PB08/18 set 1 or PB12/19 set 1 or PA02/20 set 1 or PA10/21 set 1 or PA14/22 set 1 or PB03/23 set 1 or PB07/24 set 1 or PA09/25 set 1 or PA01/1 set 2 or PA07/2 set 2 or PA12/3 set 2 or PB01/4 set 2 or PB07/5 set 2 or PC07/7 set 2 or PE01/9 set 2 or PA03/10 set 2 or PB02/11 set 2 or PD04/13 set 2 or PA04/15 set 2 or PA08/16 set 2 or PB12/17 set 2 or PB05/18 set 2 or PB09/19 set 2 or PB13/20 set 2 or PB00/21 set 2 or PB04/22 set 2 or PB08/23 set 2 or PA00/24 set 2 or PA11/25 set 2; INDX0 PA01/1 set 2 or PA07/2 set 2 or PA12/3 set 2 or PB01/4 set 2 or PB07/5 set 2 or PC07/7 set 2 or PE01/9 set 2 or PA03/10 set 2 or PB02/11 set 2 or PD04/13 set 2 or PA04/15 set 2 or PA08/16 set 2 or PB12/17 set 2 or PB05/18 set 2 or PB09/19 set 2 or PB13/20 set 2 or PB00/21 set 2 or PB04/22 set 2 or PB08/23 set 2 or PA00/24 set 2 or PA11/25 set 2 or PA02/1 set 3 or PA08/2 set 3 or PA13/3 set 3 or PB02/4 set 3 or PB08/5 set 3 or PB13/6 set 3 or PD02/8 set 3 or PA04/10 set 3 or PB03/11 set 3 or PD06/13 set 3 or PA05/15 set 3 or PA09/16 set 3 or PB06/17 set 3 or PB10/18 set 3 or PA00/19 set 3 or PB01/20 set 3 or PB05/21 set 3 or PB09/22 set 3 or PA01/23 set 3 or PA12/24 set 3; QEA0 PA02/1 set 3 or PA08/2 set 3 or PA13/3 set 3 or PB02/4 set 3 or PB08/5 set 3 or PB13/6 set 3 or PD02/8 set 3 or PA04/10 set 3 or PB03/11 set 3 or PD06/13 set 3 or PA05/15 set 3 or PA09/16 set 3 or PB06/17 set 3 or PB10/18 set 3 or PA00/19 set 3 or PB01/20 set 3 or PB05/21 set 3 or PB09/22 set 3 or PA01/23 set 3 or PA12/24 set 3 or PA03/1 set 4 or PA09/2 set 4 or PA14/3 set 4 or PB03/4 set 4 or PD03/6 set 4 or PA00/8 set 4 or PB04/9 set 4 or PD07/11 set 4 or PA06/13 set 4 or PA10/14 set 4 or PB07/15 set 4 or PB11/16 set 4 or PA01/17 set 4 or PA05/18 set 4 or PA13/19 set 4 or PB02/20 set 4 or PB06/21 set 4 or PB10/22 set 4 or PA08/23 set 4 or PA02/24 set 4; QEB0 PA03/1 set 4 or PA09/2 set 4 or PA14/3 set 4 or PB03/4 set 4 or PD03/6 set 4 or PA00/8 set 4 or PB04/9 set 4 or PD07/11 set 4 or PA06/13 set 4 or PA10/14 set 4 or PB07/15 set 4 or PB11/16 set 4 or PA01/17 set 4 or PA05/18 set 4 or PA13/19 set 4 or PB02/20 set 4 or PB06/21 set 4 or PB10/22 set 4 or PA08/23 set 4 or PA02/24 set 4 or PA04/1 set 5 or PA10/2 set 5 or PB04/3 set 5 or PB10/4 set 5 or PE04/6 set 5 or PA01/7 set 5 or PB00/8 set 5 or PD02/10 set 5 or PC10/12 set 5 or PA15/14 set 5 or PB15/16 set 5 or PD01/18 set 5; CCMP0 PA00/31 set 1 or PA02/31 set 1 or PA03/31 set 1 or PA06/31 set 1 or PA07/31 set 1 or PA09/31 set 1 or PA10/31 set 1 or PA11/31 set 1 or PA14/31 set 1 or PB00/31 set 1 or PB01/31 set 1 or PB03/31 set 1 or PB04/31 set 1 or PB06/31 set 1 or PB07/31 set 1 or PB08/31 set 1 or PB11/31 set 1 or PB12/31 set 1 or PC09/31 set 1 or PD06/31 set 1 or PE04/31 set 1 or PA01/13 set 5 or PA04/13 set 5 or PA10/13 set 5 or PB00/13 set 5 or PB04/13 set 5 or PB10/13 set 5 or PB15/13 set 5 or PC10/13 set 5 or PD00/13 set 5 or PD02/13 set 5 or PE02/13 set 5
  parameters: UPB_ADDRL=0x500, SET_CLR_INV_PRESENT=1 (Present)

## Notices in the file
Copyright (c) 2023 Microchip Technology Inc.
SPDX-License-Identifier: Apache-2.0
Licensed under the Apache License, Version 2.0 (the "License");
you may not use this file except in compliance with the License.
You may obtain a copy of the License at
http://www.apache.org/licenses/LICENSE-2.0
Unless required by applicable law or agreed to in writing, software
distributed under the License is distributed on an "AS IS" BASIS,
WITHOUT WARRANTIES OR CONDITIONS OF ANY KIND, either express or implied.
See the License for the specific language governing permissions and
limitations under the License.
