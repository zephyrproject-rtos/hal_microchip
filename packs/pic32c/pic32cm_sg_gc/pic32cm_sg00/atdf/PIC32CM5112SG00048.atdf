# PIC32CM5112SG00048 device description
Architecture: CORTEX-M23; Family: PIC32CM; Series: PIC32CMSG00
Parameters: NUM_IRQ=141 (Number of interrupt request lines), __BKPT_NUM=4 (Number of breakpoints comparators), __CM23_REV=0x0000 (Cortex-M23 Core Revision), __ETM_PRESENT=0 (No Embedded Trace Macro implemented), __FPU_PRESENT=0 (No FPU), __MPU_NS_REGIONS=8 (Number of Non-Secure Memory Protection Regions), __MPU_PRESENT=1 (MPU implemented), __MPU_REGIONS=8 (same as __MPU_S_REGIONS), __MPU_S_REGIONS=8 (Number of Secure Memory Protection Regions), __MTB_PRESENT=0 (No Macro Trace Buffer implemented), __NVIC_PRIO_BITS=2 (Number of NVIC Priority Bits), __SAUREGION_PRESENT=0 (Number of Security Attribute Unit Regions (No SAU)), __SEC_ENABLED=1 (ARMv8-M security extensions (Trust Zone) enabled), __SYST_NUM=2 (Number of SYSTICK, include secure and non-secure SYSTICK timers), __VTOR_PRESENT=1 (Include Vector Table Offset Register), __Vendor_SysTickConfig=0 (Standard SYSTICK used), __WPT_NUM=2 (Number of watch point comparators), POWER_DOMAIN=PD_CORE, __ARCH_ARM=1, __ARCH_ARM_CORTEX_M=1
Programming and debug interfaces: JTAG, SWD
Registers are 32-bit, read-write, reset 0x0 unless marked. A register's access mark holds for its fields unless they carry their own. Offsets are from the block's base; lines under a group give offsets from that group; [hi:lo] are bit positions; {n}, {i} and the like mark numbered series; 'fields as' and 'values as' point back to an identical list; <NAME> marks a mode.

## Ordering variants
PIC32CM5112SG00048-I/NA: TQFP48, pinout P48, up to 72 MHz, -40 to 85 C, 1.62 to 3.63 V
PIC32CM5112SG00048-V/NA: TQFP48, pinout P48, up to 72 MHz, -40 to 105 C, 1.62 to 3.63 V
PIC32CM5112SG00048-E/NA: TQFP48, pinout P48, up to 72 MHz, -40 to 125 C, 1.62 to 3.63 V
PIC32CM5112SG00048-I/NA: VQFN48, pinout P48_1, up to 72 MHz, -40 to 85 C, 1.62 to 3.63 V
PIC32CM5112SG00048-V/NA: VQFN48, pinout P48_1, up to 72 MHz, -40 to 105 C, 1.62 to 3.63 V
PIC32CM5112SG00048-E/NA: VQFN48, pinout P48_1, up to 72 MHz, -40 to 125 C, 1.62 to 3.63 V

## Memory
base space: start 0 size 0x100000000, little endian
  0x4000000 BROMC_ROM size 0x10000 rom, ro, executable
  0x8000000 FCR_BFM size 0x4000 flash, rw, executable
  0xA000000 FCR_CFM_BOOTCFG1A size 0x1000 flash, rw
  0xA001000 FCR_CFM_USEROTP size 0x1000 user_signatures, rw
  0xA002000 FCR_CFM_BOOTCFG1 size 0x1000 flash, rw
  0xA003000 FCR_CFM_ROMCFG size 0x1000 flash, rw
  0xA004000 FCR_CFM_VSS0 size 0x1000 flash, rw
  0xA005000 FCR_CFM_VSS1 size 0x1000 flash, rw
  0xA006000 FCR_CFM_TEST size 0x1000 flash, rw
  0xA007000 FCR_CFM_CALOTP size 0x1000 other, ro
  0xC000000 FCR_PFM size 0x80000 flash, rw, executable
  0x20000000 MCRAMC_RET size 0x00020000 ram, rw, executable
  0x44000000 APB0_BRIDGE size 0x00034000 io, rw
  0x44800000 APB1_BRIDGE size 0x0003a000 io, rw
  0x45000000 APB2_BRIDGE size 0x00010000 io, rw
  0x4F000000 HSM_SFR size 0x18000 io, rw
  0xe0000000 PPB size 0x00100000 io, rw
