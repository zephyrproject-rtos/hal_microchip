# PIC32CM5112SG00048 device description
Architecture: CORTEX-M23; Family: PIC32CM; Series: PIC32CMSG00

## Interrupts
-15 Reset — Reset Vector, invoked on Power up and warm reset
-14 NonMaskableInt — Non maskable Interrupt, cannot be stopped or preempted
-13 HardFault — Hard Fault, all classes of Fault
-5 SVCall — System Service Call via SVC instruction
-2 PendSV — Pendable request for system service
-1 SysTick — System Tick Timer
0 FCR
1 FCW
2 PM
3 SUPC
4 OSCCTRL_XOSCRDY (OSCCTRL)
5 OSCCTRL_DFLLRDY (OSCCTRL)
6 OSCCTRL_PLLLOCKR_0 (OSCCTRL)
7 OSC32KCTRL_XOSC32KRDY (OSC32KCTRL)
8 OSC32KCTRL_XOSC32KFAIL (OSC32KCTRL)
9 MCLK
10 FREQM
11 WDT
12 RTC_TAMPER (RTC)
13 RTC_OVF (RTC)
14 RTC_PER0 (RTC)
15 RTC_CMP0 (RTC)
{n+16} EIC_EXTINT{n} (EIC) (n=0..15)
32 EIC_NSCHK (EIC)
33 TRAM
34 MCRAMC
35 CAN0_INT0 (CAN0)
36 CAN0_INT1 (CAN0)
37 CAN0_BERR (CAN0)
38 CAN1_INT0 (CAN1)
39 CAN1_INT1 (CAN1)
40 CAN1_BERR (CAN1)
41 PORT
42 DMAC_TCMPL0 (DMAC)
43 DMAC_TCMPL1 (DMAC)
44 DMAC_TCMPL2 (DMAC)
45 DMAC_TCMPL3 (DMAC)
46 DMAC_TCMPL4 (DMAC)
47 HMATRIX2
{n+48} EVSYS_EVD{n} (EVSYS) (n=0..11)
60 SERCOM0_6 (SERCOM0)
61 SERCOM0_5 (SERCOM0)
62 SERCOM0_0 (SERCOM0)
63 SERCOM0_1 (SERCOM0)
64 SERCOM0_2 (SERCOM0)
65 SERCOM0_3 (SERCOM0)
66 SERCOM0_4 (SERCOM0)
67 SERCOM1_6 (SERCOM1)
68 SERCOM1_5 (SERCOM1)
69 SERCOM1_0 (SERCOM1)
70 SERCOM1_1 (SERCOM1)
71 SERCOM1_2 (SERCOM1)
72 SERCOM1_3 (SERCOM1)
73 SERCOM1_4 (SERCOM1)
74 SERCOM2_6 (SERCOM2)
75 SERCOM2_5 (SERCOM2)
76 SERCOM2_0 (SERCOM2)
77 SERCOM2_1 (SERCOM2)
78 SERCOM2_2 (SERCOM2)
79 SERCOM2_3 (SERCOM2)
80 SERCOM2_4 (SERCOM2)
81 SERCOM3_6 (SERCOM3)
82 SERCOM3_5 (SERCOM3)
83 SERCOM3_0 (SERCOM3)
84 SERCOM3_1 (SERCOM3)
85 SERCOM3_2 (SERCOM3)
86 SERCOM3_3 (SERCOM3)
87 SERCOM3_4 (SERCOM3)
88 TCC0_DFS (TCC0)
89 TCC0_CNT (TCC0)
90 TCC0_MC0 (TCC0)
91 TCC0_MC1 (TCC0)
92 TCC1_DFS (TCC1)
93 TCC1_CNT (TCC1)
94 TCC1_MC0 (TCC1)
95 TCC1_MC1 (TCC1)
96 TCC2_DFS (TCC2)
97 TCC2_CNT (TCC2)
98 TCC2_MC0 (TCC2)
99 TCC2_MC1 (TCC2)
100 TCC3_DFS (TCC3)
101 TCC3_CNT (TCC3)
102 TCC3_MC0 (TCC3)
103 TCC3_MC1 (TCC3)
104 SERCOM4_6 (SERCOM4)
105 SERCOM4_5 (SERCOM4)
106 SERCOM4_0 (SERCOM4)
107 SERCOM4_1 (SERCOM4)
108 SERCOM4_2 (SERCOM4)
109 SERCOM4_3 (SERCOM4)
110 SERCOM4_4 (SERCOM4)
111 SERCOM5_6 (SERCOM5)
112 SERCOM5_5 (SERCOM5)
113 SERCOM5_0 (SERCOM5)
114 SERCOM5_1 (SERCOM5)
115 SERCOM5_2 (SERCOM5)
116 SERCOM5_3 (SERCOM5)
117 SERCOM5_4 (SERCOM5)
118 TCC4_DFS (TCC4)
119 TCC4_CNT (TCC4)
120 TCC4_MC0 (TCC4)
121 TCC4_MC1 (TCC4)
122 TCC5_DFS (TCC5)
123 TCC5_CNT (TCC5)
124 TCC5_MC0 (TCC5)
125 TCC5_MC1 (TCC5)
126 TCC6_DFS (TCC6)
127 TCC6_CNT (TCC6)
128 TCC6_MC0 (TCC6)
129 TCC6_MC1 (TCC6)
130 ADC_REQ0 (ADC)
131 ADC_REQ1 (ADC)
132 AC
133 PTC
134 USB_EORSMDNRSM (USB)
135 USB_SOFHSOF (USB)
136 USB_TRCPT00 (USB)
137 USB_TRCPT10 (USB)
138 AT
139 HSM
140 PUF

## Event generators
1 SUPC_LVDET, 2 OSCCTRL_XOSCFAIL, 3 OSC32KCTRL_XOSC32KFAIL, 4 FREQM_DONE, 5 FREQM_WINMON, {n+6} RTC_PER{n} (n=0..7), {n+14} RTC_CMP{n} (n=0..3), 18 RTC_TAMPER, 19 RTC_OVF, 20 RTC_PERD, {n+21} EIC_EXTINT{n} (n=0..15), {n+37} DMAC_CH{n} (n=0..3), {5n+41} TCC{n}_OVF (n=0..6), {5n+42} TCC{n}_TRG (n=0..6), {5n+43} TCC{n}_CNT (n=0..6), {5n+44} TCC{n}_MC0 (n=0..6), {5n+45} TCC{n}_MC1 (n=0..6), 76 ADC_CHRDY, 77 ADC_CMP, 78 AC_COMP0, 79 AC_COMP1, 80 AC_WIN0, 81 PTC_EOC, 82 PTC_WCOMP, {n+83} CCL0_LUTOUT{n} (n=0..3), {n+87} CCL1_LUTOUT{n} (n=0..3)

## Event users
0 FREQM_START, 1 RTC_TAMPER, {n+2} PORT_EV{n} (n=0..3), {n+6} DMAC_CH{n} (n=0..3), {4n+10} TCC{n}_EV0 (n=0..6), {4n+11} TCC{n}_EV1 (n=0..6), {4n+12} TCC{n}_MC0 (n=0..6), {4n+13} TCC{n}_MC1 (n=0..6), {n+38} ADC_TRIG{n} (n=0..10), 49 AC_SOC0, 50 AC_SOC1, 51 PTC_DSEQR, 52 PTC_STCONV, {n+53} CCL0_LUTIN{n} (n=0..3), {n+57} CCL1_LUTIN{n} (n=0..3), 61 AT_TAMPSRC5

## Properties
SIGNATURES: DSU_DID=0x0AC0A053

## Pinouts (pin number, pad)
P48, P48_1: 1 PA00, 2 PA01, 3 PA02, 4 PA03, 5 PA04, 6 VDDIO, 7 VSSIO2, 8 PA05, 9 PA06, 10 PA07, 11 PA08, 12 PA09, 13 PB00, 14 AVDD, 15 AVSS, 16 PB01, 17 PB02, 18 VDDIO, 19 VSSIO4, 20 VDDREG, 21 PB03, 22 PB04, 23 PB05, 24 PB06, 25 PC00, 26 PC01, 27 PC02, 28 PC03, 29 PC04, 30 RESET_N, 31 VDDIO, 32 VSSIO7, 33 PC05, 34 PC06, 35 PC07, 36 PC08, 37 PD00, 38 PD01, 39 PD02, 40 PD03, 41 VSSIO, 42 VDDF, 43 PD06, 44 PD07, 45 PD04, 46 PD05, 47 PD08, 48 PD09
