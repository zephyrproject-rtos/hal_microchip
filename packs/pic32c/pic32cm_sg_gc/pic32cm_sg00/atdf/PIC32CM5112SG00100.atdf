# PIC32CM5112SG00100 device description
Architecture: CORTEX-M23; Family: PIC32CM; Series: PIC32CMSG00
Parameters: NUM_IRQ=141 (Number of interrupt request lines), __BKPT_NUM=4 (Number of breakpoints comparators), __CM23_REV=0x0000 (Cortex-M23 Core Revision), __ETM_PRESENT=0 (No Embedded Trace Macro implemented), __FPU_PRESENT=0 (No FPU), __MPU_NS_REGIONS=8 (Number of Non-Secure Memory Protection Regions), __MPU_PRESENT=1 (MPU implemented), __MPU_REGIONS=8 (same as __MPU_S_REGIONS), __MPU_S_REGIONS=8 (Number of Secure Memory Protection Regions), __MTB_PRESENT=0 (No Macro Trace Buffer implemented), __NVIC_PRIO_BITS=2 (Number of NVIC Priority Bits), __SAUREGION_PRESENT=0 (Number of Security Attribute Unit Regions (No SAU)), __SEC_ENABLED=1 (ARMv8-M security extensions (Trust Zone) enabled), __SYST_NUM=2 (Number of SYSTICK, include secure and non-secure SYSTICK timers), __VTOR_PRESENT=1 (Include Vector Table Offset Register), __Vendor_SysTickConfig=0 (Standard SYSTICK used), __WPT_NUM=2 (Number of watch point comparators), POWER_DOMAIN=PD_CORE, __ARCH_ARM=1, __ARCH_ARM_CORTEX_M=1
Programming and debug interfaces: JTAG, SWD
Registers are 32-bit, read-write, reset 0x0 unless marked. A register's access mark holds for its fields unless they carry their own. Offsets are from the block's base; lines under a group give offsets from that group; [hi:lo] are bit positions; {n}, {i} and the like mark numbered series; 'fields as' and 'values as' point back to an identical list; <NAME> marks a mode.

## Ordering variants
PIC32CM5112SG00100-I/NA: TQFP100, pinout P100, up to 72 MHz, -40 to 85 C, 1.62 to 3.63 V
PIC32CM5112SG00100-V/NA: TQFP100, pinout P100, up to 72 MHz, -40 to 105 C, 1.62 to 3.63 V
PIC32CM5112SG00100-E/NA: TQFP100, pinout P100, up to 72 MHz, -40 to 125 C, 1.62 to 3.63 V

## Memory
base space: start 0 size 0x100000000, little endian
  0x4000000 BROMC_ROM size 0x10000 rom, ro, executable
  0x8000000 FCR_BFM size 0x4000 flash, rw, executable
  0xA000000 FCR_CFM_BOOTCFG1A size 0x1000 flash, rw
  0xA001000 FCR_CFM_USEROTP size 0x1000 user_signatures, rw
  0xA002000 FCR_CFM_BOOTCFG1 size 0x1000 flash, rw
  0xA003000 FCR_CFM_ROMCFG size 0x1000 flash, rw
  0xA004000 FCR_CFM_VSS0 size 0x1000 flash, rw
  0xA005000 FCR_CFM_VSS1 size 0x1000 flash, rw
  0xA006000 FCR_CFM_TEST size 0x1000 flash, rw
  0xA007000 FCR_CFM_CALOTP size 0x1000 other, ro
  0xC000000 FCR_PFM size 0x80000 flash, rw, executable
  0x20000000 MCRAMC_RET size 0x00020000 ram, rw, executable
  0x44000000 APB0_BRIDGE size 0x00034000 io, rw
  0x44800000 APB1_BRIDGE size 0x0003a000 io, rw
  0x45000000 APB2_BRIDGE size 0x00010000 io, rw
  0x4F000000 HSM_SFR size 0x18000 io, rw
  0xe0000000 PPB size 0x00100000 io, rw

## Peripheral instances (address, pins/pin function, parameters)
AC at 0x4482A000
  pins: AIN0 PA07/B; AIN1 PA08/B; AIN2 PB00/B; AIN3 PB03/B; CMP0 PA01/B set 1 or PA13/B set 2; CMP1 PA02/B set 1 or PB07/B set 2
  parameters: ATEST_IMPLEMENTED=1 (Defines if the ATEST register is implemented), ATEST_SIZE=2 (Defines the number of effective bits in ATEST register), DACVALUE_BIT=7 (Defines the number of bits in DACCTRLn.VALUE), IO_INPUTS=4 (Defines the number of AC pair inputs connected to IO pins), PAIRS=1 (Defines the number of AC pairs), NUM_CMP=2 (Number of comparators), LOAD_CALIB=0 (Defines if calibration is required), GCLK_ID=34, BRIDGE_ID=1 (H2PB Bridge ID), PERIPH_ID=21 (H2PB Peripheral ID), INSTANCE_ID=40 (Instance index for AC), MCLK_ID_APB=50 (Index for AC APB clock), PAC_ID=40 (Index for AC registers write protection)
ADC at 0x44818000
  pins: ADC0_AIN0 PA03/B; ADC0_AIN1 PA04/B; ADC0_AIN2 PA05/B; ADC0_AIN3 PA06/B; ADC0_AIN4 PA07/B; ADC0_AIN5 PA08/B; ADC0_AIN6 PA09/B; ADC0_AIN7 PB00/B; ADC0_AIN8 PB03/B; ADC0_AIN9 PB04/B; ADC0_AIN10 PB05/B; ADC0_AIN11 PB06/B; ADC0_ANN0 PA04/B; ADC0_ANN2 PA06/B; ADC0_ANN4 PA08/B; RES_TEST0 PD08/ADC_TEST_PAD; RES_TEST1 PD09/ADC_TEST_PAD; RES_TEST2 PD07/ADC_TEST_PAD; RES_TEST3 PA00/ADC_TEST_PAD; RES_TEST4 PA01/ADC_TEST_PAD; RES_TEST5 PA02/ADC_TEST_PAD; RES_TEST6 PA03/ADC_TEST_PAD; RES_TEST7 PA04/ADC_TEST_PAD; RES_TEST8 PB03/ADC_TEST_PAD; RES_TEST9 PB04/ADC_TEST_PAD; RES_TEST10 PB05/ADC_TEST_PAD; RES_TEST11 PB06/ADC_TEST_PAD; VREFH PA09/VOLT_REF
  parameters: APB_FIFO_DEPTH=16, CHNSAR_NMBR1=16, CHNSAR_NMBR2=0, CHNSAR_NMBR3=0, CHNSAR_NMBR4=0, DCMP_NMBR=1, EARLY_INTR_PRESENT=1, FLTR_NMBR=1, OCP_ADDR_WIDTH=0, OCP_FIFO_DEPTH=0, OCP_PORT_PRESENT=0, SARCORE_NMBR=1, TRGS_NMBR=16, VREF_STARTUP_TIME=50, GCLK_ID=33, DMAC_ID_PFFRDY=37, BRIDGE_ID=1 (H2PB Bridge ID), PERIPH_ID=12 (H2PB Peripheral ID), INSTANCE_ID=39 (Instance index for ADC), MCLK_ID_APB=49 (Index for ADC APB clock), PAC_ID=39 (Index for ADC registers write protection)
AT at 0x4500C000
  parameters: AT_TMPR_OSC_NUM_INV=881 (Number of inverters in tamper oscillator), AT_CTRLAPRIV_IMPLEMENTED=1 (Implement the CTRLA.PRIV bit and privilege access filtering to registers.0 = CTRLA.PRIV not implemented1 = CTRLA.PRIV implemented), AT_WPCTRL_IMPLEMENTED=0 (Implement the WPCTRL register for write protection. 1 = Use WPCTRL register is preset . Used to control write protection enable/disable. 0 = No WPCTRL sfr, only used in legacy device with a PACUse at_wrprot to control write protection enable/disable), AT_WPCTRL_KEY=0x412054 (WPCTRL 24-bit key value. See register description for usage.Set to a unique value for each macro. ASCII of "A T"), BRIDGE_ID=2 (H2PB Bridge ID), PERIPH_ID=6 (H2PB Peripheral ID), INSTANCE_ID=45 (Instance index for AT), MCLK_ID_APB=56 (Index for AT APB clock), PAC_ID=45 (Index for AT registers write protection)
BROMC at 0x44804000
  parameters: BROMC_PADDR_MSB=12, BROMC_PDATA_MSB=31, BROMC_PSTRB_MSB=3, BROMC_PPROT_MSB=5, BROMC_ROM_ADDR_MSB=13, BROMC_ROM_DATA_MSB=31, BROMC_ROM_DATA_SIZE=16384, BROMC_ROM_PRMWS_DEFAULT=0, BROMC_ROM_KEN=0, BROMC_ROM_CRC_EN=1, BROMC_ROM_SPLIT=0x3400 ((8K for PK code) (Note: This parameter may change once boot and PK code sizes are known)), BROMC_BOOTCRC_MODE=2, BROMC_FUSES_DATA_MSB=127 (See Flash Control Chapter for Values), BROMC_FUSES_RDY_MSB=14 (See Flash Control Chapter for Values), BROMC_FUSES_UCFG_ROWID=14 (See Chapter 5 CCFG Fuse map for Values), BROMC_FUSES_UCFG_START=0 (See Chapter 5 CCFG Fuse map for Values), BROMC_CTRLAPRIV_IMPLEMENTED=1, BROMC_WPCTRL_IMPLEMENTED=0, BROMC_WPCTRL_KEY=0x42524F, BROMC_NUM_COOLDN_CYCLES=2, BROMC_NUM_WARMUP_CYCLES=2, BRIDGE_ID=1 (H2PB Bridge ID), PERIPH_ID=2 (H2PB Peripheral ID), INSTANCE_ID=23 (Instance index for BROMC), MCLK_ID_AHB=32 (Index for BROMC AHB clock), MCLK_ID_APB=33 (Index for BROMC APB clock), PAC_ID=23 (Index for BROMC registers write protection)
CAN0 at 0x4402E000 (CAN)
  pins: RX PA10/H set 3 or PC01/H set 1 or PD06/H set 2; TX PA11/H set 3 or PC02/H set 1 or PD08/H set 2
  parameters: ECC_ERR_IMPLEMENTED=0 (ECC error implemented?), INTERNAL_TB_SOF=3 (0: No SOF and no internal Time base, 1: SOF and no internal Time), MSG_RAM_ADDR=0x20 (8-bits MSB), NUMBER_TS=1 (0: 4 Timestamp reg, 1: 8 timestamp reg, 2: 16 timestamp reg), PRIV_IMPLEMENTED=1 (Privilege access is implemented? 0: CTRLA.PRIV bit not implemented, 1: CTRLA.PRIV bit implemented), RXD_SYNC_METHOD=0 (RXD Synchronization Method), SYNT_TIMESTAMP=0x00000 (CAN_SYNT_TIMESTAMP[19:16]: CREL.YEAR reset value (BCD-coded),CAN_SYNT_TIMESTAMP[15:8]: CREL.MON reset value (BCD-coded), CAN_SYNT_TIMESTAMP[7:0]: CREL.DAY reset value (BCD-coded)), WPCTRL_IMPLEMENTED=0 (Write protection control register implemented?), WPCTRL_KEY=0x43414E (Write protection 24 bit key), GCLK_ID=6, BRIDGE_ID=0 (H2PB Bridge ID), PERIPH_ID=23 (H2PB Peripheral ID), INSTANCE_ID=17 (Instance index for CAN0), MCLK_ID_AHB=23 (Index for CAN0 AHB clock), PAC_ID=17 (Index for CAN0 registers write protection)
CAN1 at 0x44030000 (CAN)
  pins: RX PA00/H set 2 or PC05/H set 1 or PD12/H set 3; TX PA01/H set 2 or PC06/H set 1 or PD13/H set 3
  parameters: ECC_ERR_IMPLEMENTED=0 (ECC error implemented?), INTERNAL_TB_SOF=3 (0: No SOF and no internal Time base, 1: SOF and no internal Time), MSG_RAM_ADDR=0x20 (8-bits MSB), NUMBER_TS=1 (0: 4 Timestamp reg, 1: 8 timestamp reg, 2: 16 timestamp reg), PRIV_IMPLEMENTED=1 (Privilege access is implemented? 0: CTRLA.PRIV bit not implemented, 1: CTRLA.PRIV bit implemented), RXD_SYNC_METHOD=0 (RXD Synchronization Method), SYNT_TIMESTAMP=0x00000 (CAN_SYNT_TIMESTAMP[19:16]: CREL.YEAR reset value (BCD-coded),CAN_SYNT_TIMESTAMP[15:8]: CREL.MON reset value (BCD-coded), CAN_SYNT_TIMESTAMP[7:0]: CREL.DAY reset value (BCD-coded)), WPCTRL_IMPLEMENTED=0 (Write protection control register implemented?), WPCTRL_KEY=0x43414E (Write protection 24 bit key), GCLK_ID=7, BRIDGE_ID=0 (H2PB Bridge ID), PERIPH_ID=24 (H2PB Peripheral ID), INSTANCE_ID=18 (Instance index for CAN1), MCLK_ID_AHB=24 (Index for CAN1 AHB clock), PAC_ID=18 (Index for CAN1 registers write protection)
CCL0 at 0x4482E000 (CCL)
  pins: IN0 PC12/I set 2 or PC01/I set 1; IN1 PC02/I set 1 or PC14/I set 2; IN2 PC15/I set 2 or PC09/I set 1; IN3 PD00/I set 1 or PD18/I set 2; IN4 PD01/I set 1 or PD17/I set 2; IN5 PD10/I set 1 or PD19/I set 2; IN6 PA00/I set 1 or PA14/I set 2; IN7 PA01/I set 1 or PA15/I set 2; IN8 PA10/I set 1 or PA18/I set 2; IN9 PB12/I set 2 or PB05/I set 1; IN10 PB14/I set 2 or PB06/I set 1; IN11 PB15/I set 2 or PB10/I set 1; OUT0 PC13/I set 2 or PC03/I set 1; OUT1 PD14/I set 2 or PD08/I set 1; OUT2 PA02/I set 1 or PA19/I set 2; OUT3 PB16/I set 2 or PC00/I set 1
  parameters: LUT_NUM=4 (Number of LUT in a CCL), GCLK_ID=36, BRIDGE_ID=1 (H2PB Bridge ID), PERIPH_ID=23 (H2PB Peripheral ID), INSTANCE_ID=42 (Instance index for CCL0), MCLK_ID_APB=52 (Index for CCL0 APB clock), PAC_ID=42 (Index for CCL0 registers write protection)
CCL1 at 0x44830000 (CCL)
  pins: IN0 PC11/I set 2 or PC04/I set 1; IN1 PC17/I set 2 or PC05/I set 1; IN2 PC16/I set 2 or PC10/I set 1; IN3 PD06/I set 1 or PD20/I set 2; IN4 PD16/I set 2 or PD07/I set 1; IN5 PD11/I set 1 or PD12/I set 2; IN6 PA16/I set 2 or PA09/I set 1; IN7 PA17/I set 2 or PA06/I set 1; IN8 PA11/I set 1 or PA12/I set 2; IN9 PB11/I set 2 or PB04/I set 1; IN10 PB13/I set 2 or PB03/I set 1; IN11 PB07/I set 2 or PB08/I set 1; OUT0 PC19/I set 2 or PC06/I set 1; OUT1 PD15/I set 2 or PD09/I set 1; OUT2 PA05/I set 1 or PA20/I set 2; OUT3 PB00/I set 1 or PB17/I set 2
  parameters: LUT_NUM=4 (Number of LUT in a CCL), GCLK_ID=37, BRIDGE_ID=1 (H2PB Bridge ID), PERIPH_ID=24 (H2PB Peripheral ID), INSTANCE_ID=43 (Instance index for CCL1), MCLK_ID_APB=53 (Index for CCL1 APB clock), PAC_ID=43 (Index for CCL1 registers write protection)
CoreDebug at 0xE000EDF0
CoreDebug_NS at 0xE002EDF0 (CoreDebug)
DIB at 0xE000EFB0
DIB_NS at 0xE002EFB0 (DIB)
DMAC at 0x44802000
  parameters: CH_NUM=8, EVIN_NUM=4, EVOUT_NUM=4, LVL_NUM=4, QOSCTRL_D_RESETVALUE=2, QOSCTRL_F_RESETVALUE=2, QOSCTRL_WRB_RESETVALUE=2, SPLIT_IRQ_NUM=4, TRIG_NUM=43, BRIDGE_ID=1 (H2PB Bridge ID), PERIPH_ID=1 (H2PB Peripheral ID), INSTANCE_ID=21 (Instance index for DMAC), MCLK_ID_AHB=28 (Index for DMAC AHB clock), MCLK_ID_APB=29 (Index for DMAC APB clock), PAC_ID=21 (Index for DMAC registers write protection)
DSU at 0x44000000
  pins: MSA PC05/DSU_MSA; SWCCSTAT PC06/DSU_SWCCSTAT
  parameters: DSU_BASE_ADDR_INTERNAL=0x44000000, DSU_CPU_NUM=0, DSU_TZ_IMPLEMENTED=1, DSU_CORESIGHT_REVISION=0x0, DSU_CORESIGHT_ENTRY=0xE00FF001 0x0 0x0 0x0, DSU_ID_MASKID=0x00 (Microchip Device Mask ID which provides the value for bits [15:8] of the ID - Part Number.), DSU_ID_VER=0x0 (ID Version Code provides the Mask Revision value for the device. Use metal changeable cells to configure this value.), DSU_SD_KEY=0xFFABAFD0, DSU_DCFG_MASK=0xFF0FFF0F 0x10FC7F80 0xC0800203 0x0 0x0 0x0 0x0 0x0, DSU_DAL1_VAL=0x55, DSU_DAL2_VAL=0xAA, DSU_CTRLAPRIV_IMPLEMENTED=1, DSU_CTRLB_IMPLEMENTED_MASK=0x00000000, DSU_WPCTRL_IMPLEMENTED=0, DSU_WPCTRL_KEY=0x445355, DSU_PRVKEY_IMPLEMENTED=0 (key sourced by PUF, not DSU), DSU_BRCTRL_KEY=0x445355, DSU_TDID_DIE=0x00, DSU_TDID_MASK=0x00, DSU_SWCCS_IMPLEMENTED=1, DSU_TESTMODE_IMPLEMENTED_MASK=0x000007FF 0x00000000 0x00000000 0x00000000, DSU_FUSES_DATA_MSB=127 (128-bit bus), DSU_FUSES_RDY_MSB=14 (15 bit fuse ready bus), DSU_FUSES_ID_DEVID_START=24 (DEVID field is DSUCFG0[31:24]), DSU_FUSES_ID_DEVID_SIZE=8, DSU_FUSES_ID_DEVID_ROWID=8 (DEVID on RowID Index = 8), DSU_FUSES_DCFG_START=0 32 64 96 0 32 64 96, DSU_FUSES_DCFG_SIZE=32 32 32 32 32 32 32 32, DSU_FUSES_DCFG_ROWID=8 8 8 8 9 9 9 9 (DSUCFG7-0 = FCCFG39-32), DMAC_ID_DCC0=1, DMAC_ID_DCC1=2, BRIDGE_ID=0 (H2PB Bridge ID), PERIPH_ID=0 (H2PB Peripheral ID), INSTANCE_ID=0 (Instance index for DSU), MCLK_ID_AHB=0 (Index for DSU AHB clock), PAC_ID=0 (Index for DSU registers write protection)
DWT at 0xE0001000
  parameters: __WPT_NUM=2 (Number of DWT watchpoint comparators)
EIC at 0x44020000
  pins: EXTINT0 PA00/A or PA16/A or PB00/A or PB15/A or PC00/A or PC16/A or PD18/A; EXTINT1 PA01/A or PA17/A or PB01/A or PB16/A or PC01/A or PC17/A or PD01/A or PD19/A; EXTINT2 PA02/A or PA18/A or PB02/A or PB12/A or PB17/A or PC02/A or PC18/A or PD04/A or PD20/A; EXTINT3 PA03/A or PA19/A or PB03/A or PC03/A or PC19/A or PD05/A; EXTINT4 PA04/A or PA20/A or PB04/A or PC04/A or PD07/A; EXTINT5 PA05/A or PB05/A or PC05/A or PD08/A; EXTINT6 PA06/A or PB06/A or PC06/A or PD09/A; EXTINT7 PA07/A; EXTINT8 PA08/A or PB07/A or PD10/A; EXTINT9 PA09/A or PB08/A or PC09/A or PD11/A; EXTINT10 PA10/A or PB09/A or PC10/A or PD12/A; EXTINT11 PA11/A or PB10/A or PC11/A or PD13/A; EXTINT12 PA12/A or PB11/A or PC12/A or PD14/A; EXTINT13 PA13/A or PC13/A or PD15/A; EXTINT14 PA14/A or PB13/A or PC14/A or PD16/A; EXTINT15 PA15/A or PB14/A or PC15/A or PD17/A; NMI PD00/A
  parameters: EXTINT_NUM=16, NUMBER_OF_CONFIG_REGS=2 (=(EIC_EXTINT_NUM +7) / 8), NUMBER_OF_INTERRUPTS=16 (=(EIC_EXTINT_NUM)), SECURE_IMPLEMENTED=1, GCLK_ID=5, BRIDGE_ID=0 (H2PB Bridge ID), PERIPH_ID=16 (H2PB Peripheral ID), INSTANCE_ID=13 (Instance index for EIC), MCLK_ID_APB=13 (Index for EIC APB clock), PAC_ID=13 (Index for EIC registers write protection)
EVSYS at 0x44806000
  parameters: ASYNCHRONOUS_CHANNELS=0xFFFFF000, CHANNELS=12, CHANNELS_BITS=4 (=LEN( BIN(EVSYS_CHANNELS-1)) - 2)derived parameter), GENERATORS=90 (Should be 90), GENERATORS_BITS=7 (=LEN( BIN(EVSYS_GENERATORS-1)) - 2)derived parameter), SECURE_IMPLEMENTED=0, SPLIT_IRQ_NUM=12, SYNCH_NUM=12, SYNCH_NUM_BITS=4 (=LEN( BIN(EVSYS_SYNCH_NUM-1)) - 2)derived parameter), USERS=62 (Should be 62), USERS_BITS=6 (=LEN( BIN(EVSYS_USERS-1)) - 2)derived parameter), USERS_GROUPS=2 (=(EVSYS_USERS+31) / 32derived parameter), GCLK_ID_CH{n}={n+8} (n=0..11), BRIDGE_ID=1 (H2PB Bridge ID), PERIPH_ID=3 (H2PB Peripheral ID), INSTANCE_ID=25 (Instance index for EVSYS), MCLK_ID_APB=35 (Index for EVSYS APB clock), PAC_ID=25 (Index for EVSYS registers write protection)
FCR at 0x44002000
  parameters: FCR_AHB_PORTS_NB=1, FCR_CTRLAPRIV_IMPLEMENTED=1, FCR_INTFLAGSET_IMPLEMENTED=1, FCR_WPCTRL_IMPLEMENTED=0, FCR_WPCTRL_KEY=0x464352, FCR_PDMO_MSB=7, FCR_PFM_ADDR_BASE=0x0C000000, FCR_BFM_ADDR_BASE=0x08000000, FCR_CFM_ADDR_BASE=0x0A000000, FCR_FCD_ADDR_BASE=0x0B000000, FCR_VSS_CFG0_BASE=0x0A004000, FCR_VSS_CFG1_BASE=0x0A005000, FCR_VSS_CFG2_BASE=0, FCR_VSS_CFG3_BASE=0, FCR_VSS_CFG4_BASE=0, FCR_VSS_CFG5_BASE=0, FCR_CRC_PRESENT=1, FCR_FLT_PRESENT=1, FCR_HSM_PRESENT=0, FCR_ECC_PRESENT=1, FCR_PCHE_PRESENT=1, FCR_PCHE_AHB_NUM=0, FCR_PCHE_NUM_LINES=4, FCR_PCHE_TAG_MASK=0xF9F8000F, FCR_FUSES_READY_CYCLES=2, FCR_FUSES_DATA_CYCLES=4, FUSES_RDY_MSB=14, FUSES_DATA_MSB=127, FCR_HDATA_SIZE=32, FCR_F1RR_ADDR=0x0A007000, FCR_F2RR_ADDR=0 (Not applicable for QSilver), FCR_RR_NUM_READS=1, FCR_NUM_RR_SFR=1, FCR_FFF_ADDR=0x0A007040, FCR_NOT_FFF_VALUE=0xA5A5A5A5, FCR_OTPLOCK_ADDR=0x0A007060, FCR_CAL_ADDR=0x0A007080, FCR_CAL_NUM_READS=14, FCR_PBUCFG_ADDR=0x0A003400, FCR_PERIOD_MIN=75, FCR_PERIOD_NOM=116, FCR_TCALH_NS=10000, PFM_NUM_PANELS=1, PFM_PNL_ADDR_MSB=18, PFM_SYS_ADDR_MSB=18, PFM_ROW_ADDR_MSB=9, PFM_PAGE_ADDR_MSB=11, PFM_PNL_DATA_MSB=139, PFM_DATA_MSB=127, PFM_PNL_WDATA_MSB=34 (Parameter only in DOS Rev C, not in RTL), PFM_NUM_RR=2, PFM_SRHT_PRESENT=0, BFM_PNL_ADDR_MSB=13, BFM_SYS_ADDR_MSB=13, CFM_PNL_ADDR_MSB=14, CFM_SYS_ADDR_MSB=14, NVR_NUM_PAGES=12, PFM_TDPDH_NS=5000, PFM_TDPDS_NS=100, PFM_TMS_NS=5000 (See Note 2), PFM_TMH_NS=100 (See Note 2), PFM_TRT_NS=500, PFM_TRHR_NS=1000, PFM_TONWAIT_NS=6000, PFM_TLKCFG_NS=1000, PFM_ACC_NS=25, PFM_ACC_HT_NS=30, PFM_ACC_RECALL_NS=70, BRIDGE_ID=0 (H2PB Bridge ID), PERIPH_ID=1 (H2PB Peripheral ID), INSTANCE_ID=1 (Instance index for FCR), MCLK_ID_AHB=1 (Index for FCR AHB clock), PAC_ID=1 (Index for FCR registers write protection)
FCW at 0x44004000
  parameters: FCW_CTRLAPRIV_IMPLEMENTED=1, FCW_INTFLAGSET_IMPLEMENTED=1, FCW_WPCTRL_IMPLEMENTED=0, FCW_WPCTRL_KEY=0x464357, FCW_PFM_ADDR_BASE=0x0C000000, FCW_BFM_ADDR_BASE=0x08000000, FCW_CFM_ADDR_BASE=0x0A000000, FCW_VSS_CFG0_BASE=0x0A004000, FCW_VSS_CFG1_BASE=0x0A005000, FCW_VSS_CFG2_BASE=0 (Not applicable for QS), FCW_VSS_CFG3_BASE=0 (Not applicable for QS), FCW_VSS_CFG4_BASE=0 (Not applicable for QS), FCW_VSS_CFG5_BASE=0 (Not applicable for QS), FCW_PWP_REGIONS=4, FCW_PWP_MSB=6, FCW_HSM_PRESENT=0, FCW_TAMPER_PRESENT=1, FCW_TAMPER_ADDR=0x0A003200, FCW_TAMPER_DATA=0x00000000, FCW_SD_USE_CPCNT=1, FCW_NUM_DATA_SFR=4 ((PFM_DATA_MSB+1)/32), FCW_TPAR_MSB=3 ((PFM_PNL_DATA_MSB - PFM_DATA_MSB)/4), FCW_PERIOD_MIN=75, FCW_PERIOD_NOM=116, PFM_SIZE=6, PFM_NUM_PANELS=1, PFM_PNL_ADDR_MSB=18, PFM_SYS_ADDR_MSB=18, PFM_ROW_ADDR_MSB=9, PFM_PAGE_ADDR_MSB=11, PFM_PNL_DATA_MSB=139, PFM_DATA_MSB=127, PFM_NUM_RR=2, BFM_PNL_ADDR_MSB=13, BFM_SYS_ADDR_MSB=13, CFM_PNL_ADDR_MSB=14, CFM_SYS_ADDR_MSB=14, NVR_NUM_PAGES=12, PFM_TWS_NS=5 (value irrelevant, must be >0), PFM_TWH_NS=5 (value irrelevant, must be >0), PFM_TNVS_NS=4000 (See Note 2), PFM_TPROG_NS=18000 (See Note 3), PFM_TPREPROG_NS=3000 (See Note 3), PFM_TADS_NS=15 (See Note 2), PFM_TADH_NS=15 (See Note 2), PFM_TPGS_NS=8000 (See Note 2), PFM_TPREPGH_NS=15 (See Note 2), PFM_TPREPGS_NS=1000 (See Note 2), PFM_TPGH_NS=15 (See Note 2), PFM_TRCV_PROG_NS=5000 (See Note 2), PFM_TRCV_ERASE_NS=50000 (See Note 2), PFM_TERASE_NS=18000000 (See Note 3), PFM_TERASE_RETRY_NS=4500000 (See Note 3), PFM_TSCE_NS=18000000 (See Note 3), PFM_TRW_NS=100 (See Note 2), PFM_TPUMPENS=1000 (See Note 2), PFM_TPUMPENH=100 (See Note 2), PFM_TPUMP_CYCLES=1029 (See Note 2), BRIDGE_ID=0 (H2PB Bridge ID), PERIPH_ID=2 (H2PB Peripheral ID), FLASH_SIZE=524288, INSTANCE_ID=2 (Instance index for FCW), MCLK_ID_AHB=2 (Index for FCW AHB clock), PAC_ID=2 (Index for FCW registers write protection)
FPB at 0xE0002000
  parameters: __BKPT_NUM=4 (Number of FPB breakpoint comparators)
FREQM at 0x4400C000
  parameters: MSRCLK_NB=2 (Number of measured clock sources), GCLK_ID_MSR0=2, GCLK_ID_MSR1=3, GCLK_ID_REF=4, BRIDGE_ID=0 (H2PB Bridge ID), PERIPH_ID=6 (H2PB Peripheral ID), INSTANCE_ID=10 (Instance index for FREQM), MCLK_ID_APB=10 (Index for FREQM APB clock), PAC_ID=10 (Index for FREQM registers write protection)
FUSES at FUSES_ROMCFG 0x0A003000, FUSES_BOOTCFG1 0x0A002000, FUSES_BOOTCFG1A 0x0A000000 (FUSES_BOOTCFG1), FUSES_CALOTP 0x0A007000
GCLK at 0x44008000
  pins: IO0 PB06/K or PB15/K or PC09/K or PD05/K; IO1 PC00/K or PC10/K or PC05/K or PD04/K; IO2 PC01/K; IO3 PC02/K; IO4 PC03/K; IO5 PC04/K; IO6 PB16/K or PB10/K; IO7 PB09/K; TST_GCLK PC08/DSU_TEST_GCLK
  parameters: GEN_NUM=12, IO_NUM=8 (derived, # of "1" in GCLK_GEN_IO_EXIST), MUXED_NUM=39 (Number of GCLK channels), SOURCE_NUM=11, BRIDGE_ID=0 (H2PB Bridge ID), PERIPH_ID=4 (H2PB Peripheral ID), INSTANCE_ID=8 (Instance index for GCLK), MCLK_ID_APB=8 (Index for GCLK APB clock), PAC_ID=8 (Index for GCLK registers write protection)
H2PB0 at 0x44032000 (H2PB)
  parameters: H2PB_MST_N=2, H2PB_MST_MAX=1 (derived parameter), H2PB_SLV_N=32, H2PB_SLV_MAX=31 (derived parameter), H2PB_PADDR_IDXB=5 (derived parameter), H2PB_PADDR_LSB=13, H2PB_WPCTRL_IMPLEMENTED=0, H2PB_PAGE_SIZE=8192 (derived parameter), H2PB_OWN_SFR_SLOT=25, H2PB_PADDR_SIZE=18 (local parameter), H2PB_PADDR_MSB=17 (derived local parameter), H2PB_BASE_MSB=13 (derived parameter), H2PB_USE_HSEL=1, H2PB_USE_DPATH_PIPER=0 (1="all pipelined"0="address pipelined"), H2PB_USE_EARLY_PREAD=0, H2PB_CLK_DIV_EN=0 (1="n:1 clock"0="1:1 clock"), H2PB_USE_PSTRB_FOR_READS=1, H2PB_WPCTRL_KEY=0x504230, H2PB_NONSEC_INIT_VAL=0x00000001, BRIDGE_ID=0 (H2PB Bridge ID), PERIPH_ID=25 (H2PB Peripheral ID), INSTANCE_ID=19 (Instance index for H2PB0), MCLK_ID_AHB=25 (Index for H2PB0 AHB clock), MCLK_ID_APB=26 (Index for H2PB0 APB clock), PAC_ID=19 (Index for H2PB0 registers write protection)
H2PB1 at 0x44838000 (H2PB)
  parameters: H2PB_MST_N=2, H2PB_MST_MAX=1 (derived parameter), H2PB_SLV_N=32, H2PB_SLV_MAX=31 (derived parameter), H2PB_PADDR_IDXB=5 (derived parameter), H2PB_PADDR_LSB=13, H2PB_WPCTRL_IMPLEMENTED=0, H2PB_PAGE_SIZE=8192 (derived parameter), H2PB_OWN_SFR_SLOT=28, H2PB_PADDR_SIZE=18 (local parameter), H2PB_PADDR_MSB=17 (derived local parameter), H2PB_BASE_MSB=13 (derived parameter), H2PB_USE_HSEL=1, H2PB_USE_DPATH_PIPER=0 (1="all pipelined"0="address pipelined"), H2PB_USE_EARLY_PREAD=0, H2PB_CLK_DIV_EN=0 (1="n:1 clock"0="1:1 clock"), H2PB_USE_PSTRB_FOR_READS=1, H2PB_WPCTRL_KEY=0x504231, H2PB_NONSEC_INIT_VAL=0x00000000, BRIDGE_ID=1 (H2PB Bridge ID), PERIPH_ID=28 (H2PB Peripheral ID), INSTANCE_ID=46 (Instance index for H2PB1), MCLK_ID_AHB=57 (Index for H2PB1 AHB clock), MCLK_ID_APB=58 (Index for H2PB1 APB clock), PAC_ID=46 (Index for H2PB1 registers write protection)
H2PB2 at 0x4500E000 (H2PB)
  parameters: H2PB_MST_N=1, H2PB_MST_MAX=0 (derived parameter), H2PB_SLV_N=8, H2PB_SLV_MAX=7 (derived parameter), H2PB_PADDR_IDXB=3 (derived parameter), H2PB_PADDR_LSB=13, H2PB_WPCTRL_IMPLEMENTED=0, H2PB_PAGE_SIZE=8192 (derived parameter), H2PB_OWN_SFR_SLOT=7, H2PB_PADDR_SIZE=16 (local parameter), H2PB_PADDR_MSB=15 (derived local parameter), H2PB_BASE_MSB=15 (derived parameter), H2PB_USE_HSEL=1, H2PB_USE_DPATH_PIPER=1 (1="all pipelined"0="address pipelined"), H2PB_USE_EARLY_PREAD=0, H2PB_CLK_DIV_EN=1 (1="n:1 clock"0="1:1 clock"), H2PB_USE_PSTRB_FOR_READS=1, H2PB_WPCTRL_KEY=0x504232, H2PB_NONSEC_INIT_VAL=0x00, BRIDGE_ID=2 (H2PB Bridge ID), PERIPH_ID=7 (H2PB Peripheral ID), INSTANCE_ID=47 (Instance index for H2PB2), MCLK_ID_AHB=59 (Index for H2PB2 AHB clock), MCLK_ID_APB=60 (Index for H2PB2 APB clock), PAC_ID=47 (Index for H2PB2 registers write protection)
HMATRIX2 at 0x44010000
  parameters: BRIDGE_ID=0 (H2PB Bridge ID), PERIPH_ID=8 (H2PB Peripheral ID), INSTANCE_ID=22 (Instance index for HMATRIX2), MCLK_ID_AHB=30 (Index for HMATRIX2 AHB clock), MCLK_ID_APB=31 (Index for HMATRIX2 APB clock), PAC_ID=22 (Index for HMATRIX2 registers write protection)
HSM at 0x4F000000
  parameters: HSM_CTRLAPRIV_IMPLEMENTED=1, HSM_WPCTRL_IMPLEMENTED=0, HSM_WPCTRL_KEY=0x43414D, HSM_USE_MASKING=1 (Enable DPA), HSM_INCLUDE_DES=0, HSM_INCLUDE_SHA3=0, HSM_INCLUDE_CHACHA_POLY=0, HSM_RNG_NUMRINGS=55, HSM_RNG_NUMINV=13, INSTANCE_ID=48 (Instance index for HSM), MCLK_ID_AHB=62 (Index for HSM AHB clock), PAC_ID=48 (Index for HSM registers write protection)
ICB at 0xE000E000
ICB_NS at 0xE002E000 (ICB)
IDAU at 0x44012000
  parameters: GRANULARITY_ANSC=0x1000 (Application Non-Secure Callable region granularity), GRANULARITY_ANS=0x1000 (Application Non-Secure region granularity), GRANULARITY_AS=0x1000 (Application Secure region granularity), GRANULARITY_RS=0x1000 (RAM Secure region granularity), GRANULARITY_RNS=0x1000 (RAM Non-Secure region granularity), GRANULARITY_BNSC=0x1000 (Boot Flash Non-Secure Callable region granularity), GRANULARITY_BS=0x1000 (Boot Flash Secure region granularity), BRIDGE_ID=0 (H2PB Bridge ID), PERIPH_ID=9 (H2PB Peripheral ID), INSTANCE_ID=24 (Instance index for IDAU), MCLK_ID_APB=34 (Index for IDAU APB clock), PAC_ID=24 (Index for IDAU registers write protection)
MCLK at 0x4400A000
  parameters: MCLK_SYNC_EDGES=1, MCLK_DIV_CLK_NUM=3 (one for all other, one for H2PB2 domain, one for MBISTINTF), MCLK_CKDIV_REGS_BITS=8, MCLK_CKDIV_RESET_VALUE=0x1 0x2 0x4 0x1 0x1 0x1 0x1 0x1 0x1 0x1 0x1 0x1 (values must be binary divisor numberunused divisors must be 8'h1), MCLK_CKDIV_WRLOCK=0x00000000, MCLK_CPU_CLK_DIVIDER=0, MCLK_CPU_CLK_IDLE=0, MCLK_CPU_CLK_OFFDLY=2, MCLK_CPU_CLK_ONDLY=0, MCLK_SYS_CLK_DIVIDER=0, MCLK_SYS_CLK_OFFDLY=2, MCLK_CLKMSK_NUM=65, MCLK_CKPER_IMPLEMENTED=0xFFFFFFFF 0xFFFFFFFF 0x00000001 0x00000000 0x00000000 0x00000000 0x00000000 0x00000000 0x00000000, MCLK_CKPER_RSTVAL=0xFFEEFFFF 0xFFFFFFFF 0x00000001 0x00000000 0x00000000 0x00000000 0x00000000 0x00000000 0x00000000, MCLK_CKPER_DIVIDER=0 0 0 1 1 1 0 1 0 0 0 0 1 0 0 1 0 0 0 2 0 0 0 0 0 0 0 0 0 0 0 0 0 0 0 0 0 0 0 0 0 0 0 0 0 0 0 0 0 0 0 0 0 0 0 0 1 0 0 0 1 0 0 0 0 0 0 0 0 0 0 0 0 0 0 0 0 0 0 0 0 0 0 0 0 0 0 0 0 0 0 0 0 0 0 0 0 0 0 0 0 0 0 0 0 0 0 0 0 0 0 0 0 0 0 0 0 0 0 0 0 0 0 0 0 0 0 0 0 0 0 0 0 0 0 0 0 0 0 0 0 0 0 0 0 0 0 0 0 0 0 0 0 0 0 0 0 0 0 0 0 0 0 0 0 0 0 0 0 0 0 0 0 0 0 0 0 0 0 0 0 0 0 0 0 0 0 0 0 0 0 0 0 0 0 0 0 0 0 0 0 0 0 0 0 0 0 0 0 0 0 0 0 0 0 0 0 0 0 0 0 0 0 0 0 0 0 0 0 0 0 0 0 0 0 0 0 0 0 0 0 0 0 0 0 0 0 0 0 0 0 0 0 0 0 0 0 0 0 0 0 0 0 0 0 0 0 0 0 0 0 0 0 0 0 0 0 0 0 0 0 0 0 0 0 0 0 0, MCLK_CKPER_REQEXISTS=0xD9FFFFFF 0xE1FFFFFF 0x00000001 0x00000000 0x00000000 0x00000000 0x00000000 0x00000000 0x00000000, MCLK_CKPER_MASTER=0x11800004 0x40400000 0x00000000 0x00000000 0x00000000 0x00000000 0x00000000 0x00000000 0x00000000, MCLK_CKPER_WILLRISE=0x00080000 0x10000000 0x00000000 0x00000000 0x00000000 0x00000000 0x00000000 0x00000000 0x00000000, JTAG_IMPLEMENTED=1, BRIDGE_ID=0 (H2PB Bridge ID), PERIPH_ID=5 (H2PB Peripheral ID), INSTANCE_ID=9 (Instance index for MCLK), MCLK_ID_APB=9 (Index for MCLK APB clock), PAC_ID=9 (Index for MCLK registers write protection)
MCRAMC at 0x4402C000
  parameters: AHB_CLOCK_ENABLE=0, AHB_ECC=1, AHB_PORTS_NB=8, AHB_READ_PREBUFFERING=0, AHB_REQUEST_ISOLATION_REGISTER=0, ARBITRATION_TYPE=2 (Parameter should be "ENUM_HOPSCOTCH"Fix for text parameter in ConstellationCONST_DEV-1173), BIT_STROBE_RAM=0 (parameter n/a if STORE_BYTE_STROBE=0), CHANNELS_NB=2, ECC_SYNDROM_REGISTER=0, HADDR_READ_ISOLATION_REGISTER=0, HRDATA_ISOLATION_CONFIGURABLE=1, HRDATA_ISOLATION_DEFAULT=0 (default to 0 wait states), MCRAMC_CLK_GATER=0, MCRAMC_PADDR_SIZE=13, MEMORY_AUTO_CORRECTION=1, MEMORY_ENABLE_POLARITY=0, MW_CLOCK_ENABLE=0, MW_DATA_SIZE=32, MW_PORT_SLICES_NB=0, M0_CLOCK_ENABLE=0, M0_DATA_SIZE=32, M0_HYBRID_READ_WRITE_ACCESS=0, M0_PORT_SLICES_NB=0, PRIVILEGED_BIT_CHECK=1, RAM_ADD_SIZE=14, RAM_AHB_ADDRESS_OFFSET=0, RAM_ERASE=0, STORE_BYTE_STROBE=0, ULTRA=1, WP_KEY=0x465852 ("FXR"), WRITE_ENABLE_POLARITY=0, WRITE_ENABLE_USED=1, WRITE_MASK_POLARITY=0, WRITE_PROTECT_REGISTER=0, BRIDGE_ID=0 (H2PB Bridge ID), PERIPH_ID=22 (H2PB Peripheral ID), INSTANCE_ID=16 (Instance index for MCRAMC), MCLK_ID_APB=21 (Index for MCRAMC APB clock), MCLK_ID_AHB=22 (Index for MCRAMC AHB clock), PAC_ID=16 (Index for MCRAMC registers write protection)
MPU at 0xE000ED90
MPU_NS at 0xE002ED90 (MPU)
  parameters: __MPU_NS_REGIONS=8 (Number of MPU_NS regions), __MPU_S_REGIONS=8 (Number of MPU_S regions)
NVIC at 0xE000E100
NVIC_NS at 0xE002E100 (NVIC)
  parameters: NUM_IRQ=141 (Number of interrupt request lines)
OSC32KCTRL at 0x45008000
  pins: CLKIN3232 PB01/XOSC32K_XIN32_AMODE; XIN3232 PB01/XOSC32K_XIN32; XOUT3232 PB02/XOSC32K_XOUT32
  parameters: BRIDGE_ID=2 (H2PB Bridge ID), PERIPH_ID=4 (H2PB Peripheral ID), INSTANCE_ID=7 (Instance index for OSC32KCTRL), MCLK_ID_APB=7 (Index for OSC32KCTRL APB clock), PAC_ID=7 (Index for OSC32KCTRL registers write protection)
OSCCTRL at 0x44006000
  pins: CLKIN PD05/XOSC_XIN_AMODE; XIN PD05/XOSC_XIN; XOUT PD04/XOSC_XOUT
  parameters: DFLL48M_ATEST_IMPLEMENTED=1, DFLL48M_ATEST_SIZE=8, DFLL48M_IS_STARTUP_OSCILLATOR=1, DFLL48M_RC48MCAL0_PORVAL=0x00000000, DIV_8MHZ_NUM=2, FRACDIVS_NUM=0, FRACDIV_DIVIDER_RESET_VAL=0, FRACDIV_PLLSRC=0, PLLS_NUM=1, PLL0_OUTPUTS_NUM=5, PLL1_OUTPUTS_NUM=0, USBHS_NUM=1 (should be 0, but IP has bug), XOSC_ATEST_IMPLEMENTED=1, XOSC_ATEST_SIZE=4, XOSC_CFD_CLK_SELECT_SIZE=4, XOSC_CFD_HAS_RETENTION=0, GCLK_ID_DFLL48M=0, GCLK_ID_PLL=1, BRIDGE_ID=0 (H2PB Bridge ID), PERIPH_ID=3 (H2PB Peripheral ID), INSTANCE_ID=6 (Instance index for OSCCTRL), MCLK_ID_APB=6 (Index for OSCCTRL APB clock), PAC_ID=6 (Index for OSCCTRL registers write protection)
