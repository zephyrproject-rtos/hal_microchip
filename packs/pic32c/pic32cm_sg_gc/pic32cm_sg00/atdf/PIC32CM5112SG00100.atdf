# PIC32CM5112SG00100 device description
Architecture: CORTEX-M23; Family: PIC32CM; Series: PIC32CMSG00

## Peripheral instances (address, pins/pin function, parameters) (continued)
PAC at 0x44022000
  parameters: PAC_PER_WRPROT_MASK=0xFFFFFFFF 0x0003FFFF 0x00000000 0x00000000 (Peripheral implemented mask. If PAC_PER_WRPROT_MASK[x]=1 then the PAC implements an SFR bit in INTFLAG, STATUS, and LOCK with the location of <REG>(x/32)[x mod 32]), PAC_STATUS_RESET_VALUE=0x00000000 0x00000000 0x00000000 0x00000000 (WRP STATUS Reset Value for Peripherals. On reset STATUS(x/32)[x mod 32]=PAC_STATUS_RESET_VALUE[x]The reset value for each peripheral should always be 0. The parameter exists if there is an unforeseen circumstance requiring it to be 1. Test blocks are not one of them as they are protected by dsu_test_mode.), PAC_LOCK_RESET_VALUE=0x00000000 0x00000000 0x00000000 0x00000000, PAC_ERRORS_INBAND=1, PAC_CTRLAPRIV_IMPLEMENTED=1, PAC_INTFLAGSET_IMPLEMENTED=0, BRIDGE_ID=0 (H2PB Bridge ID), PERIPH_ID=17 (H2PB Peripheral ID), INSTANCE_ID=14 (Instance index for PAC), MCLK_ID_APB=14 (Index for PAC APB clock), PAC_ID=14 (Index for PAC registers write protection)
PDM
  pins: PDMDIS PDMDIS/TST_DIG; PDMI0 PD07/PDMI_TEST; PDMI1 PD08/PDMI_TEST; PDMI2 PD09/PDMI_TEST; PDMI3 PA00/PDMI_TEST; PDMO0 PB03/PDMO_LV_TEST; PDMO1 PB04/PDMO_LV_TEST; PDMO2 PB05/PDMO_LV_TEST; PDMO3 PB06/PDMO_LV_TEST; PDMO4 PC00/PDMO_LV_TEST; PDMO5 PC01/PDMO_LV_TEST; PDMO6 PC02/PDMO_LV_TEST; PDMO7 PC03/PDMO_LV_TEST; PDMO0_MV PB03/PDMO_MV_TEST; PDMO1_MV PB04/PDMO_MV_TEST; PDMO2_MV PB05/PDMO_MV_TEST; PDMO3_MV PB06/PDMO_MV_TEST; PDMO4_MV PC00/PDMO_MV_TEST; PDMO5_MV PC01/PDMO_MV_TEST; PDMO6_MV PC02/PDMO_MV_TEST; PDMO7_MV PC03/PDMO_MV_TEST
PM at 0x45000000
  parameters: BACKUP_IMPLEMENTED=1, PD_NUM=1 (Number of Switchable Power Domains2 total domains (PD_CORE_SW and PD_CORE_BU)), BRIDGE_ID=2 (H2PB Bridge ID), PERIPH_ID=0 (H2PB Peripheral ID), INSTANCE_ID=3 (Instance index for PM), MCLK_ID_APB=3 (Index for PM APB clock), PAC_ID=3 (Index for PM registers write protection)
PORT at 0x44800000
  pins: P{n} PA{n:02} (n=0..20); P{n} PB{n-32:02} (n=32..49); P{n} PC{n-64:02} (n=64..83); P{n} PD{n-96:02} (n=96..116)
  parameters: AHB_IMPLEMENTED=0 (No AHB bus), BITS=117, DIR_DEFAULT_VAL=0x00000000 0x00000000 0x00000000 0x00000000, DIR_IMPLEMENTED=0x001FFFFF 0x0003FFFF 0x000FFFFF 0x001FFFFF (DIR RegistersImplemented), DRVSTR=0 (No DRVSTR bits), DRVSTR_DEFAULT_VAL=0x00000000 0x00000000 0x00000000 0x00000000, DRVSTR_IMPLEMENTED=0x00000000 0x00000000 0x00000000 0x00000000 (PINCFG.DRVSTR0RegistersImplemented), DRVSTR1_DEFAULT_VAL=0x00000000 0x00000000 0x00000000 0x00000000, DRVSTR1_IMPLEMENTED=0x00000000 0x00000000 0x00000000 0x00000000 (PINCFG.DRVSTR1RegistersImplemented), EVENT_IMPLEMENTED=0x001FFFFF 0x0003FFFF 0x000FFFFF 0x001FFFFF (Event RegistersImplemented), EV_NUM=4, GROUPS=4, HADDR_MSB=31, INEN_DEFAULT_VAL=0x00000000 0x00000000 0x00000000 0x00000000, INEN_IMPLEMENTED=0x001FFFFF 0x0003FFFF 0x000FFFFF 0x001FFFFF (PINCFG.INENRegistersImplemented), IOBUS_IMPLEMENTED=0 (No IOBUS), MSB=116 (PORT_BITS-1), NONSEC_DEFAULT_VAL=0x00000000 0x00000000 0x00000000 0x00000000, NONSEC_IMPLEMENTED=0x001FFFFF 0x0003FFFF 0x000FFFFF 0x001FFFFF (NONSECRegistersImplemented), ODRAIN=1, ODRAIN_DEFAULT_VAL=0x00000000 0x00000000 0x00000000 0x00000000, ODRAIN_IMPLEMENTED=0x001FFFFF 0x0003FFFF 0x000FFFFF 0x001FFFFF (PINCFG.ODRAINRegistersImplemented), OUT_DEFAULT_VAL=0x00000000 0x00000000 0x00000000 0x00000000, OUT_IMPLEMENTED=0x001FFFFF 0x0003FFFF 0x000FFFFF 0x001FFFFF (OUT RegistersImplemented), PIN_IMPLEMENTED=0x001FFFFF 0x0003FFFF 0x000FFFFF 0x001FFFFF (Port PinsImplemented), PMUXBIT0_DEFAULT_VAL=0x00000000 0x00000000 0x00000000 0x0000000C, PMUXBIT0_IMPLEMENTED=0x001FFFFF 0x0003FFF9 0x000FFE7F 0x001FFFC3 (Bit 0 of PMUX field), PMUXBIT1_DEFAULT_VAL=0x00000000 0x00000000 0x000001E0 0x0000000C, PMUXBIT1_IMPLEMENTED=0x0007FFFF 0x000387F9 0x000FFE7F 0x001FFFF3 (Bit 1 of PMUX field), PMUXBIT2_DEFAULT_VAL=0x00000000 0x00000000 0x000001E0 0x0000000C, PMUXBIT2_IMPLEMENTED=0x001BFFFF 0x00007FF9 0x0000067F 0x00003FC3 (Bit 2 of PMUX field), PMUXBIT3_DEFAULT_VAL=0x00000000 0x00000000 0x00000000 0x00000000, PMUXBIT3_IMPLEMENTED=0x001FFFFF 0x0003FFF9 0x000BFE7F 0x001FDFF3 (Bit 3 of PMUX field), PMUXEN_DEFAULT_VAL=0x00000000 0x00000000 0x000001E0 0x00000000, PMUXEN_IMPLEMENTED=0x001FFFFF 0x0003FFFF 0x000FFFFF 0x001FFFFF (PINCFG.PMUXEN bit), PPP_IMPLEMENTED=0 (No IOBUS2), PULLEN_DEFAULT_VAL=0x00000000 0x00000000 0x00000000 0x00000000, PULLEN_IMPLEMENTED=0x001FFFFF 0x0003FFFF 0x000FFFFF 0x001FFFFF (PINCFG.PULLENRegistersImplemented), SECURE_IMPLEMENTED=1 (Mixed Secure Enabled), SLEWLIM=2 (Number of SLEWLIM bit), SLEWLIM_DEFAULT_VAL=0x00000000 0x00000000 0x00000000 0x00000000, SLEWLIM_IMPLEMENTED=0x0007C07F 0x00038078 0x000FF87F 0x001FCFC3 (PINCFG.SLEWLIM0RegistersImplemented), SLEWLIM1_DEFAULT_VAL=0x00000000 0x00000000 0x00000000 0x00000000, SLEWLIM1_IMPLEMENTED=0x0007C07F 0x00038078 0x000FF87F 0x001FCFC3 (PINCFG.SLEWLIM1RegistersImplemented), BRIDGE_ID=1 (H2PB Bridge ID), PERIPH_ID=0 (H2PB Peripheral ID), INSTANCE_ID=20 (Instance index for PORT), MCLK_ID_APB=27 (Index for PORT APB clock), PAC_ID=20 (Index for PORT registers write protection)
PTC at 0x4482C000
  pins: PTCXY0 PD06/P; PTCXY1 PD07/P; PTCXY2 PD08/P; PTCXY3 PD09/P; PTCXY{n} PA{n-4:02}/P (n=4..13); PTCXY14 PB00/P; PTCXY15 PB03/P; PTCXY16 PB04/P; PTCXY17 PB05/P; PTCXY18 PB06/P; PTCXY19 PC00/P; PTCXY20 PC01/P; PTCXY21 PC02/P; PTCXY22 PA10/P; PTCXY23 PA11/P; PTCXY24 PA12/P; PTCXY25 PA13/P; PTCXY26 PB07/P; PTCXY27 PB08/P; PTCXY28 PB09/P; PTCXY29 PB10/P; PTCXY30 PC09/P; PTCXY31 PC10/P; PTCXY32 PA14/P; PTCXY33 PA15/P; PTCXY34 PA16/P; PTCXY35 PA17/P; DRV0 PD06/P; DRV1 PD07/P; DRV2 PD08/P; DRV3 PD09/P; DRV{n} PA{n-4:02}/P (n=4..13); DRV14 PB00/P; DRV15 PB03/P; DRV16 PB04/P; DRV17 PB05/P; DRV18 PB06/P; DRV19 PC00/P; DRV20 PC01/P; DRV21 PC02/P; DRV22 PA10/P; DRV23 PA11/P; DRV24 PA12/P; DRV25 PA13/P; DRV26 PB07/P; DRV27 PB08/P; DRV28 PB09/P; DRV29 PB10/P; DRV30 PC09/P; DRV31 PC10/P; DRV32 PA14/P; DRV33 PA15/P; DRV34 PA16/P; DRV35 PA17/P; ECI0 PC03/P; ECI1 PC04/P
  parameters: PTC_PDATA_MSB=31 (APB Data Bus Size MSB), PTC_PADDR_MSB=12 (APB Address Bus Size MSB), PTC_PADDR_SIZE=13 (Number of bits of the paddr input busPossible Values = PTC_PADDR_MSB -1), PTC_LINES_NUM=36 (Number of PTC lines desired (0 to 64)), PTC_CAL_IMPLEMENTED=1 (Defines if the CALIB register is implemented (1 = implemented)), PTC_CAL_SIZE=16 (Defines Bitfield size for CALIB register), PTC_CAL_PORVAL=0x00000000 (Defines the CALIB register reset value after POR0x00000000 to 0xFFFFFFFF), PTC_ATEST_IMPLEMENTED=1 (Defines if the ATEST register is implemented (1 = implemented)), PTC_ATEST_SIZE=8 (Defines the number of effective bits in ATEST register), PTC_WPCTRL_IMPLEMENTED=0 (Implement the WPCTRL register for write protection.0 = Use apb_ptc_wrprot to control write protection enable/disable1 = Use WPCTRL register to control write protection enable/disable.), PTC_PRIV_IMPLEMENTED=1 (Implement the PRIV register for privilege/non-privilege bus accesses.0 = Register not present1 = Register present), PTC_WPCTRL_KEY=0x505443 (WPCTRL 24-bit key value. See register description for usage.Set to a unique value for each macro.), GCLK_ID=35, DMAC_ID_EOC=38, DMAC_ID_SEQ=39, DMAC_ID_WCOMP=40, BRIDGE_ID=1 (H2PB Bridge ID), PERIPH_ID=22 (H2PB Peripheral ID), INSTANCE_ID=41 (Instance index for PTC), MCLK_ID_APB=51 (Index for PTC APB clock), PAC_ID=41 (Index for PTC registers write protection)
PUF at 0x44834000
  parameters: PUF_CTRLAPRIV_IMPLEMENTED=1 (Implement the CTRLA.PRIV bit and privilege access filtering to registers.0 = CTRLA.PRIV not implemented1 = CTRLA.PRIV implemented), PUF_WPCTRL_IMPLEMENTED=0 (Implement the WPCTRL register for write protection. 1 = The WPCTRL register is present . Used to control write protection enable/disable. 0 = No WPCTRL register, only used in legacy device with a PACUse puf_s_wrprot to control write protection enable/disable), PUF_WPCTRL_KEY=0x505546 (WPCTRL 24-bit key value. See register description for usage.Set to a unique value for each macro. ASCII of "PUF"), DMAC_ID_PUFDI=41, DMAC_ID_PUFDO=42, BRIDGE_ID=1 (H2PB Bridge ID), PERIPH_ID=26 (H2PB Peripheral ID), INSTANCE_ID=49 (Instance index for PUF), MCLK_ID_APB=63 (Index for PUF APB clock), PAC_ID=49 (Index for PUF registers write protection)
RSTC at 0x45004000
  parameters: BACKUP_IMPLEMENTED=1, CM_DBGRESET_STRETCHED=3 (Reset stretcher size for Cortex CPU related to DBGRESET.), CM_HRESET_N_STRETCHED=3 (Reset stretcher size for Cortex CPU related to HRESETn.), CM_PORESET_STRETCHED=3 (Reset stretcher size for Cortex CPU related to PORESET.), HIB_IMPLEMENTED=1, VBAT_IMPLEMENTED=0 (One if VBAT (Battery backup mode) is supported), BRIDGE_ID=2 (H2PB Bridge ID), PERIPH_ID=2 (H2PB Peripheral ID), INSTANCE_ID=5 (Instance index for RSTC), MCLK_ID_APB=5 (Index for RSTC APB clock), PAC_ID=5 (Index for RSTC registers write protection)
RTC at 0x45006000
  pins: IN0 PA07/RTC_PAD_IE; IN1 PA08/RTC_PAD_IE; IN2 PA09/RTC_PAD_IE; IN3 PB00/RTC_PAD_IE; IN4 PB07/RTC_PAD_IE; IN5 PB08/RTC_PAD_IE; IN6 PB11/RTC_PAD_IE; IN7 PB12/RTC_PAD_IE; OUT0 PB03/_RTC_PAD_OE_N; OUT1 PB04/_RTC_PAD_OE_N; OUT2 PB05/_RTC_PAD_OE_N; OUT3 PB06/_RTC_PAD_OE_N; OUT4 PB09/_RTC_PAD_OE_N; OUT5 PB10/_RTC_PAD_OE_N; OUT6 PB13/_RTC_PAD_OE_N; OUT7 PB14/_RTC_PAD_OE_N
  parameters: NUM_OF_ALARMS=2, NUM_OF_BKREGS=0, NUM_OF_COMP16=4 (=2 * RTC_NUM_OF_ALARMS), NUM_OF_TAMPERS=8, DMAC_ID_TIMESTAMP=3, BRIDGE_ID=2 (H2PB Bridge ID), PERIPH_ID=3 (H2PB Peripheral ID), INSTANCE_ID=12 (Instance index for RTC), MCLK_ID_APB=12 (Index for RTC APB clock), PAC_ID=12 (Index for RTC registers write protection)
SAU at 0xE000EDD0
SCB at 0xE000ED00
SCB_NS at 0xE002ED00 (SCB)
SERCOM0 at 0x44808000 (SERCOM)
  pins: PAD0 PB15/D set 2 or PC00/D set 1; PAD1 PB16/D set 2 or PC01/D set 1; PAD2 PB17/D set 2 or PC02/D set 1; PAD3 PC11/D set 2 or PC03/D set 1
  parameters: CLK_REDUCTION=1 (Reduce clock options to pin 1 for SPI and USART), DMA=1 (DMA support implemented?), FIFO_IMPLEMENTED=1 (FIFO Rx/Tx implemented?), FIFO_SIZE=16 (Rx-Tx FIFO size in bytes), FSYNC_IMPLEMENTED=1 (SPI Frame Synch mode implemented?), SPI=1 (SPI mode implemented?), TWIM=1 (TWI Master mode implemented?), TWIS=1 (TWI Slave mode implemented?), TWI_HSMODE=1 (TWI HighSpeed mode implemented?), ULTRA_IMPLEMENTATION=0 (ULTRA platform compatibility?), USART=1 (USART mode implemented?), USART_AUTOBAUD=1 (USART autobaud implemented?), USART_IRDA=1 (USART IrDA implemented?), USART_LIN_MASTER=1 (USART LIN Master mode implemented?), USART_RS485=1 (USART RS485 mode implemented?), GCLK_ID_SLOW=20, GCLK_ID_CORE=21, DMAC_ID_RX=4, DMAC_ID_TX=5, BRIDGE_ID=1 (H2PB Bridge ID), PERIPH_ID=4 (H2PB Peripheral ID), INSTANCE_ID=26 (Instance index for SERCOM0), MCLK_ID_APB=36 (Index for SERCOM0 APB clock), PAC_ID=26 (Index for SERCOM0 registers write protection)
SERCOM1 at 0x4480A000 (SERCOM)
  pins: PAD0 PC15/D set 3 or PD01/D; PAD1 PC14/D set 3 or PD00/D; PAD2 PC13/D set 3 or PC06/D set 1 or PD10/D set 2; PAD3 PC12/D set 3 or PC05/D set 1 or PD11/D set 2
  parameters: CLK_REDUCTION=1 (Reduce clock options to pin 1 for SPI and USART), DMA=1 (DMA support implemented?), FIFO_IMPLEMENTED=1 (FIFO Rx/Tx implemented?), FIFO_SIZE=16 (Rx-Tx FIFO size in bytes), FSYNC_IMPLEMENTED=1 (SPI Frame Synch mode implemented?), SPI=1 (SPI mode implemented?), TWIM=1 (TWI Master mode implemented?), TWIS=1 (TWI Slave mode implemented?), TWI_HSMODE=1 (TWI HighSpeed mode implemented?), ULTRA_IMPLEMENTATION=0 (ULTRA platform compatibility?), USART=1 (USART mode implemented?), USART_AUTOBAUD=1 (USART autobaud implemented?), USART_IRDA=1 (USART IrDA implemented?), USART_LIN_MASTER=1 (USART LIN Master mode implemented?), USART_RS485=1 (USART RS485 mode implemented?), GCLK_ID_SLOW=20, GCLK_ID_CORE=22, DMAC_ID_RX=6, DMAC_ID_TX=7, BRIDGE_ID=1 (H2PB Bridge ID), PERIPH_ID=5 (H2PB Peripheral ID), INSTANCE_ID=27 (Instance index for SERCOM1), MCLK_ID_APB=37 (Index for SERCOM1 APB clock), PAC_ID=27 (Index for SERCOM1 registers write protection)
SERCOM2 at 0x4480C000 (SERCOM)
  pins: PAD0 PC04/D set 1 or PC19/D set 2; PAD1 PC18/D set 2 or PD06/D set 1; PAD2 PC17/D set 2 or PD07/D set 1; PAD3 PC16/D set 2 or PD08/D set 1
  parameters: CLK_REDUCTION=1 (Reduce clock options to pin 1 for SPI and USART), DMA=1 (DMA support implemented?), FIFO_IMPLEMENTED=1 (FIFO Rx/Tx implemented?), FIFO_SIZE=16 (Rx-Tx FIFO size in bytes), FSYNC_IMPLEMENTED=1 (SPI Frame Synch mode implemented?), SPI=1 (SPI mode implemented?), TWIM=1 (TWI Master mode implemented?), TWIS=1 (TWI Slave mode implemented?), TWI_HSMODE=0 (TWI HighSpeed mode implemented?), ULTRA_IMPLEMENTATION=0 (ULTRA platform compatibility?), USART=1 (USART mode implemented?), USART_AUTOBAUD=1 (USART autobaud implemented?), USART_IRDA=1 (USART IrDA implemented?), USART_LIN_MASTER=1 (USART LIN Master mode implemented?), USART_RS485=1 (USART RS485 mode implemented?), GCLK_ID_SLOW=20, GCLK_ID_CORE=23, DMAC_ID_RX=8, DMAC_ID_TX=9, BRIDGE_ID=1 (H2PB Bridge ID), PERIPH_ID=6 (H2PB Peripheral ID), INSTANCE_ID=28 (Instance index for SERCOM2), MCLK_ID_APB=38 (Index for SERCOM2 APB clock), PAC_ID=28 (Index for SERCOM2 registers write protection)
SERCOM3 at 0x4480E000 (SERCOM)
  pins: PAD0 PD16/D set 2 or PD09/D set 1; PAD1 PA00/D set 1 or PD15/D set 2; PAD2 PA01/D set 1 or PD17/D set 2; PAD3 PA02/D set 1 or PD14/D set 2
  parameters: CLK_REDUCTION=1 (Reduce clock options to pin 1 for SPI and USART), DMA=1 (DMA support implemented?), FIFO_IMPLEMENTED=1 (FIFO Rx/Tx implemented?), FIFO_SIZE=16 (Rx-Tx FIFO size in bytes), FSYNC_IMPLEMENTED=1 (SPI Frame Synch mode implemented?), SPI=1 (SPI mode implemented?), TWIM=1 (TWI Master mode implemented?), TWIS=1 (TWI Slave mode implemented?), TWI_HSMODE=0 (TWI HighSpeed mode implemented?), ULTRA_IMPLEMENTATION=0 (ULTRA platform compatibility?), USART=1 (USART mode implemented?), USART_AUTOBAUD=1 (USART autobaud implemented?), USART_IRDA=1 (USART IrDA implemented?), USART_LIN_MASTER=1 (USART LIN Master mode implemented?), USART_RS485=1 (USART RS485 mode implemented?), GCLK_ID_SLOW=20, GCLK_ID_CORE=24, DMAC_ID_RX=10, DMAC_ID_TX=11, BRIDGE_ID=1 (H2PB Bridge ID), PERIPH_ID=7 (H2PB Peripheral ID), INSTANCE_ID=29 (Instance index for SERCOM3), MCLK_ID_APB=39 (Index for SERCOM3 APB clock), PAC_ID=29 (Index for SERCOM3 registers write protection)
SERCOM4 at 0x44820000 (SERCOM)
  pins: PAD0 PA03/D set 1 or PD19/D set 2; PAD1 PA04/D set 1 or PD20/D set 2; PAD2 PA05/D set 1 or PD18/D set 2; PAD3 PA14/D set 2 or PA06/D set 1
  parameters: CLK_REDUCTION=1 (Reduce clock options to pin 1 for SPI and USART), DMA=1 (DMA support implemented?), FIFO_IMPLEMENTED=1 (FIFO Rx/Tx implemented?), FIFO_SIZE=16 (Rx-Tx FIFO size in bytes), FSYNC_IMPLEMENTED=1 (SPI Frame Synch mode implemented?), SPI=1 (SPI mode implemented?), TWIM=0 (TWI Master mode implemented?), TWIS=0 (TWI Slave mode implemented?), TWI_HSMODE=0 (TWI HighSpeed mode implemented?), ULTRA_IMPLEMENTATION=0 (ULTRA platform compatibility?), USART=1 (USART mode implemented?), USART_AUTOBAUD=1 (USART autobaud implemented?), USART_IRDA=1 (USART IrDA implemented?), USART_LIN_MASTER=1 (USART LIN Master mode implemented?), USART_RS485=1 (USART RS485 mode implemented?), GCLK_ID_CORE=28, DMAC_ID_RX=24, DMAC_ID_TX=25, BRIDGE_ID=1 (H2PB Bridge ID), PERIPH_ID=16 (H2PB Peripheral ID), INSTANCE_ID=34 (Instance index for SERCOM4), MCLK_ID_APB=44 (Index for SERCOM4 APB clock), PAC_ID=34 (Index for SERCOM4 registers write protection)
SERCOM5 at 0x44822000 (SERCOM)
  pins: PAD0 PA16/D set 2 or PB03/D set 1; PAD1 PA17/D set 2 or PB04/D set 1; PAD2 PA18/D set 2 or PB05/D set 1; PAD3 PA15/D set 2 or PB06/D set 1
  parameters: CLK_REDUCTION=1 (Reduce clock options to pin 1 for SPI and USART), DMA=1 (DMA support implemented?), FIFO_IMPLEMENTED=1 (FIFO Rx/Tx implemented?), FIFO_SIZE=16 (Rx-Tx FIFO size in bytes), FSYNC_IMPLEMENTED=1 (SPI Frame Synch mode implemented?), SPI=1 (SPI mode implemented?), TWIM=0 (TWI Master mode implemented?), TWIS=0 (TWI Slave mode implemented?), TWI_HSMODE=0 (TWI HighSpeed mode implemented?), ULTRA_IMPLEMENTATION=0 (ULTRA platform compatibility?), USART=1 (USART mode implemented?), USART_AUTOBAUD=1 (USART autobaud implemented?), USART_IRDA=1 (USART IrDA implemented?), USART_LIN_MASTER=1 (USART LIN Master mode implemented?), USART_RS485=1 (USART RS485 mode implemented?), GCLK_ID_CORE=29, DMAC_ID_RX=26, DMAC_ID_TX=27, BRIDGE_ID=1 (H2PB Bridge ID), PERIPH_ID=17 (H2PB Peripheral ID), INSTANCE_ID=35 (Instance index for SERCOM5), MCLK_ID_APB=45 (Index for SERCOM5 APB clock), PAC_ID=35 (Index for SERCOM5 registers write protection)
SUPC at 0x45002000
  pins: RESETn RESET_N/RES; SMOR_DTEST0 PD08/SUPC_VREF_TESTMODE; SMOR_DTEST1 PD09/SUPC_VREF_TESTMODE; SMOR_DTEST2 PD07/SUPC_VREF_TESTMODE; SMOR_DTEST3 PA00/SUPC_VREF_TESTMODE; SMOR_DTEST4 PA01/SUPC_VREF_TESTMODE; SMOR_DTEST5 PA02/SUPC_VREF_TESTMODE; SMOR_DTEST6 PA03/SUPC_VREF_TESTMODE; SMOR_DTEST7 PA04/SUPC_VREF_TESTMODE; SMOR_DTEST8 PB03/SUPC_VREF_TESTMODE; SMOR_DTEST9 PB04/SUPC_VREF_TESTMODE; SMOR_DTEST10 PB05/SUPC_VREF_TESTMODE; SMOR_DTEST11 PB06/SUPC_VREF_TESTMODE; SMOR_DTEST12 PC00/SUPC_VREF_TESTMODE; SMOR_DTEST13 PA06/SUPC_VREF_TESTMODE; SMOR_DTEST14 PA07/SUPC_VREF_TESTMODE; SMOR_DTEST15 PC03/SUPC_VREF_TESTMODE; OUT0 PB04; OUT1 PB05; USERLDO PD06/USER_LDO; USERLDO_OUT USERLDO/USER_LDO_OP_AMP
  parameters: ADDVREG_NUM=1 (Jira PWR109-210), ADDVREG_PLL_NUM=0, ADDVREG_PLL_START_INDEX=1, BKOUT_NUM=2, BORVDDUSB_NUM=1 ((Jira PWR109-219)), CHRG_PUMP_NUM=2, IOB_IMPLEMENTED=0, USER_LDO_IMPLEMENTED=1, VBAT_IMPLEMENTED=0, VREGSW_NUM=1, BRIDGE_ID=2 (H2PB Bridge ID), PERIPH_ID=1 (H2PB Peripheral ID), INSTANCE_ID=4 (Instance index for SUPC), MCLK_ID_APB=4 (Index for SUPC APB clock), PAC_ID=4 (Index for SUPC registers write protection)
SysTick at 0xE000E010
SysTick_NS at 0xE002E010 (SysTick)
  parameters: __SYST_NUM=2 (Number of implemented SysTick timers)
TCC0 at 0x44810000 (TCC)
  pins: WO0 PA19/F set 2 or PB11/F set 3 or PC00/F set 1; WO1 PA20/F set 2 or PB12/F set 3 or PC01/F set 1
  parameters: CC_NUM=2 (Number of Compare/Capture units), DITHERING=0 (Dithering feature implemented), DTI=0 (Dead-Time-Insertion feature implemented), MASTER_SLAVE_MODE=1 (TCC type 0 : NA, 1 : Master, 2 : Slave), OTMX=0 (Output Matrix feature implemented), OW_NUM=2 (Number of Output Waveforms), PG=0 (Pattern Generation feature implemented), SIZE=16, SWAP=0 (DTI outputs swap feature implemented), GCLK_ID_TCC01=25, DMAC_ID_OVF=12, DMAC_ID_MC0=13, DMAC_ID_MC1=14, BRIDGE_ID=1 (H2PB Bridge ID), PERIPH_ID=8 (H2PB Peripheral ID), INSTANCE_ID=30 (Instance index for TCC0), MCLK_ID_APB=40 (Index for TCC0 APB clock), PAC_ID=30 (Index for TCC0 registers write protection)
TCC1 at 0x44812000 (TCC)
  pins: WO0 PC02/F set 1 or PC09/F set 2; WO1 PC03/F set 1 or PC10/F set 2
  parameters: CC_NUM=2 (Number of Compare/Capture units), DITHERING=0 (Dithering feature implemented), DTI=0 (Dead-Time-Insertion feature implemented), MASTER_SLAVE_MODE=2 (TCC type 0 : NA, 1 : Master, 2 : Slave), OTMX=0 (Output Matrix feature implemented), OW_NUM=2 (Number of Output Waveforms), PG=0 (Pattern Generation feature implemented), SIZE=16, SWAP=0 (DTI outputs swap feature implemented), GCLK_ID_TCC01=25, DMAC_ID_OVF=15, DMAC_ID_MC0=16, DMAC_ID_MC1=17, BRIDGE_ID=1 (H2PB Bridge ID), PERIPH_ID=9 (H2PB Peripheral ID), INSTANCE_ID=31 (Instance index for TCC1), MCLK_ID_APB=41 (Index for TCC1 APB clock), PAC_ID=31 (Index for TCC1 registers write protection)
TCC2 at 0x44814000 (TCC)
  pins: WO0 PB09/F set 2 or PC04/F set 1; WO1 PB08/F set 2 or PC05/F set 1
  parameters: CC_NUM=2 (Number of Compare/Capture units), DITHERING=0 (Dithering feature implemented), DTI=0 (Dead-Time-Insertion feature implemented), MASTER_SLAVE_MODE=0 (TCC type 0 : NA, 1 : Master, 2 : Slave), OTMX=0 (Output Matrix feature implemented), OW_NUM=2 (Number of Output Waveforms), PG=0 (Pattern Generation feature implemented), SIZE=16, SWAP=0 (DTI outputs swap feature implemented), GCLK_ID=26, DMAC_ID_OVF=18, DMAC_ID_MC0=19, DMAC_ID_MC1=20, BRIDGE_ID=1 (H2PB Bridge ID), PERIPH_ID=10 (H2PB Peripheral ID), INSTANCE_ID=32 (Instance index for TCC2), MCLK_ID_APB=42 (Index for TCC2 APB clock), PAC_ID=32 (Index for TCC2 registers write protection)
TCC3 at 0x44816000 (TCC)
  pins: WO0 PB13/F set 2 or PD00/F set 1; WO1 PB14/F set 2 or PD01/F set 1
  parameters: CC_NUM=2 (Number of Compare/Capture units), DITHERING=0 (Dithering feature implemented), DTI=0 (Dead-Time-Insertion feature implemented), MASTER_SLAVE_MODE=0 (TCC type 0 : NA, 1 : Master, 2 : Slave), OTMX=0 (Output Matrix feature implemented), OW_NUM=2 (Number of Output Waveforms), PG=0 (Pattern Generation feature implemented), SIZE=16, SWAP=0 (DTI outputs swap feature implemented), GCLK_ID=27, DMAC_ID_OVF=21, DMAC_ID_MC0=22, DMAC_ID_MC1=23, BRIDGE_ID=1 (H2PB Bridge ID), PERIPH_ID=11 (H2PB Peripheral ID), INSTANCE_ID=33 (Instance index for TCC3), MCLK_ID_APB=43 (Index for TCC3 APB clock), PAC_ID=33 (Index for TCC3 registers write protection)
TCC4 at 0x44824000 (TCC)
  pins: WO0 PA10/F set 2 or PD07/F set 1; WO1 PA11/F set 2 or PD08/F set 1
  parameters: CC_NUM=2 (Number of Compare/Capture units), DITHERING=0 (Dithering feature implemented), DTI=0 (Dead-Time-Insertion feature implemented), MASTER_SLAVE_MODE=0 (TCC type 0 : NA, 1 : Master, 2 : Slave), OTMX=0 (Output Matrix feature implemented), OW_NUM=2 (Number of Output Waveforms), PG=0 (Pattern Generation feature implemented), SIZE=16, SWAP=0 (DTI outputs swap feature implemented), GCLK_ID=30, DMAC_ID_OVF=28, DMAC_ID_MC0=29, DMAC_ID_MC1=30, BRIDGE_ID=1 (H2PB Bridge ID), PERIPH_ID=18 (H2PB Peripheral ID), INSTANCE_ID=36 (Instance index for TCC4), MCLK_ID_APB=46 (Index for TCC4 APB clock), PAC_ID=36 (Index for TCC4 registers write protection)
TCC5 at 0x44826000 (TCC)
  pins: WO0 PD10/F set 2 or PD09/F set 1; WO1 PA00/F set 1 or PD11/F set 2
  parameters: CC_NUM=2 (Number of Compare/Capture units), DITHERING=0 (Dithering feature implemented), DTI=0 (Dead-Time-Insertion feature implemented), MASTER_SLAVE_MODE=0 (TCC type 0 : NA, 1 : Master, 2 : Slave), OTMX=0 (Output Matrix feature implemented), OW_NUM=2 (Number of Output Waveforms), PG=0 (Pattern Generation feature implemented), SIZE=16, SWAP=0 (DTI outputs swap feature implemented), GCLK_ID=31, DMAC_ID_OVF=31, DMAC_ID_MC0=32, DMAC_ID_MC1=33, BRIDGE_ID=1 (H2PB Bridge ID), PERIPH_ID=19 (H2PB Peripheral ID), INSTANCE_ID=37 (Instance index for TCC5), MCLK_ID_APB=47 (Index for TCC5 APB clock), PAC_ID=37 (Index for TCC5 registers write protection)
TCC6 at 0x44828000 (TCC)
  pins: WO0 PA01/F set 1 or PD12/F set 2; WO1 PA02/F set 1 or PD13/F set 2
  parameters: CC_NUM=2 (Number of Compare/Capture units), DITHERING=0 (Dithering feature implemented), DTI=0 (Dead-Time-Insertion feature implemented), MASTER_SLAVE_MODE=0 (TCC type 0 : NA, 1 : Master, 2 : Slave), OTMX=0 (Output Matrix feature implemented), OW_NUM=2 (Number of Output Waveforms), PG=0 (Pattern Generation feature implemented), SIZE=16, SWAP=0 (DTI outputs swap feature implemented), GCLK_ID=32, DMAC_ID_OVF=34, DMAC_ID_MC0=35, DMAC_ID_MC1=36, BRIDGE_ID=1 (H2PB Bridge ID), PERIPH_ID=20 (H2PB Peripheral ID), INSTANCE_ID=38 (Instance index for TCC6), MCLK_ID_APB=48 (Index for TCC6 APB clock), PAC_ID=38 (Index for TCC6 registers write protection)
TESTVAL
  pins: VALIO0 PD00/VALIO; VALIO1 PD01/VALIO; VALIO2 PC04/VALIO; VALIO3 PA05/VALIO; VALIO4 PC01/VALIO; VALIO5 PC02/VALIO
TRAM at 0x4500A000
  parameters: ADDR_MSB=6, BRIDGE_ID=2 (H2PB Bridge ID), PERIPH_ID=5 (H2PB Peripheral ID), INSTANCE_ID=15 (Instance index for TRAM), MCLK_ID_APB=15 (Index for TRAM APB clock), PAC_ID=15 (Index for TRAM registers write protection)
USB at 0x44832000
  pins: SOF PD01/H; USBDM PD02/H; USBDP PD03/H
  parameters: AHB_2_USB_FIFO_DEPTH=4 (bytes number, should be at least 2, and 2^n (4,8,16 ...)), AHB_2_USB_RD_DATA_BITS=8 (8, 16 or 32, here : 8-bits is required as UTMI interface should work in 8-bits mode), AHB_2_USB_WR_DATA_BITS=32 (8, 16 or 32 : here, AHB transfer is made in word mode), AHB_2_USB_WR_THRESHOLD=2 (as soon as there are N bytes-free inside the fifo, ahb read transfer is requested), DATA_BUS_16_8=0 (UTMI/SIE data bus size : 0 -> 8 bits, 1 -> 16 bits), EPNUM=8 (parameter for rtl : max of ENDPOINT and PIPE NUM), EPT_NUM=8 (Number of USB end points), INITIAL_CONTROL_QOS=3 (CONTROL QOS RESET value), INITIAL_DATA_QOS=3 (DATA QOS RESET value), MISSING_SOF_DET_IMPLEMENTED=1 (48 mHz xPLL feature implemented), PIPE_NUM=8 (Number of USB pipes), SYSTEM_CLOCK_IS_CKUSB=0 (Dual (1'b0) or Single (1'b1) clock system), USB_2_AHB_FIFO_DEPTH=4 (bytes number, should be at least 2, and 2^n (4,8,16 ...)), USB_2_AHB_RD_DATA_BITS=16 (8, 16 or 32, here : 8-bits is required as UTMI interface should work in 8-bits mode), USB_2_AHB_RD_THRESHOLD=2 (as soon as there are 16 bytes-free inside the fifo, ahb read transfer is requested), USB_2_AHB_WR_DATA_BITS=8 (8, 16 or 32 : here : 8-bits is required as UTMI interface should work in 8-bits mode), GCLK_ID=38, BRIDGE_ID=1 (H2PB Bridge ID), PERIPH_ID=25 (H2PB Peripheral ID), INSTANCE_ID=44 (Instance index for USB), MCLK_ID_AHB=54 (Index for USB AHB clock), MCLK_ID_APB=55 (Index for USB APB clock), PAC_ID=44 (Index for USB registers write protection)
WDT at 0x4400E000
  parameters: FUSES_UPDATE_SUPPORT=0 (WDT Fuse Update Support), BRIDGE_ID=0 (H2PB Bridge ID), PERIPH_ID=7 (H2PB Peripheral ID), INSTANCE_ID=11 (Instance index for WDT), MCLK_ID_APB=11 (Index for WDT APB clock), PAC_ID=11 (Index for WDT registers write protection)

## Interrupts
-15 Reset — Reset Vector, invoked on Power up and warm reset
-14 NonMaskableInt — Non maskable Interrupt, cannot be stopped or preempted
-13 HardFault — Hard Fault, all classes of Fault
-5 SVCall — System Service Call via SVC instruction
-2 PendSV — Pendable request for system service
-1 SysTick — System Tick Timer
0 FCR
1 FCW
2 PM
3 SUPC
4 OSCCTRL_XOSCRDY (OSCCTRL)
5 OSCCTRL_DFLLRDY (OSCCTRL)
6 OSCCTRL_PLLLOCKR_0 (OSCCTRL)
7 OSC32KCTRL_XOSC32KRDY (OSC32KCTRL)
8 OSC32KCTRL_XOSC32KFAIL (OSC32KCTRL)
9 MCLK
10 FREQM
11 WDT
12 RTC_TAMPER (RTC)
13 RTC_OVF (RTC)
14 RTC_PER0 (RTC)
15 RTC_CMP0 (RTC)
{n+16} EIC_EXTINT{n} (EIC) (n=0..15)
32 EIC_NSCHK (EIC)
33 TRAM
34 MCRAMC
35 CAN0_INT0 (CAN0)
36 CAN0_INT1 (CAN0)
37 CAN0_BERR (CAN0)
38 CAN1_INT0 (CAN1)
39 CAN1_INT1 (CAN1)
40 CAN1_BERR (CAN1)
41 PORT
42 DMAC_TCMPL0 (DMAC)
43 DMAC_TCMPL1 (DMAC)
44 DMAC_TCMPL2 (DMAC)
45 DMAC_TCMPL3 (DMAC)
46 DMAC_TCMPL4 (DMAC)
47 HMATRIX2
{n+48} EVSYS_EVD{n} (EVSYS) (n=0..11)
60 SERCOM0_6 (SERCOM0)
61 SERCOM0_5 (SERCOM0)
62 SERCOM0_0 (SERCOM0)
63 SERCOM0_1 (SERCOM0)
64 SERCOM0_2 (SERCOM0)
65 SERCOM0_3 (SERCOM0)
66 SERCOM0_4 (SERCOM0)
67 SERCOM1_6 (SERCOM1)
68 SERCOM1_5 (SERCOM1)
69 SERCOM1_0 (SERCOM1)
70 SERCOM1_1 (SERCOM1)
71 SERCOM1_2 (SERCOM1)
72 SERCOM1_3 (SERCOM1)
73 SERCOM1_4 (SERCOM1)
74 SERCOM2_6 (SERCOM2)
75 SERCOM2_5 (SERCOM2)
76 SERCOM2_0 (SERCOM2)
77 SERCOM2_1 (SERCOM2)
78 SERCOM2_2 (SERCOM2)
79 SERCOM2_3 (SERCOM2)
80 SERCOM2_4 (SERCOM2)
81 SERCOM3_6 (SERCOM3)
82 SERCOM3_5 (SERCOM3)
83 SERCOM3_0 (SERCOM3)
84 SERCOM3_1 (SERCOM3)
85 SERCOM3_2 (SERCOM3)
86 SERCOM3_3 (SERCOM3)
87 SERCOM3_4 (SERCOM3)
88 TCC0_DFS (TCC0)
89 TCC0_CNT (TCC0)
90 TCC0_MC0 (TCC0)
91 TCC0_MC1 (TCC0)
92 TCC1_DFS (TCC1)
93 TCC1_CNT (TCC1)
94 TCC1_MC0 (TCC1)
95 TCC1_MC1 (TCC1)
96 TCC2_DFS (TCC2)
97 TCC2_CNT (TCC2)
98 TCC2_MC0 (TCC2)
99 TCC2_MC1 (TCC2)
100 TCC3_DFS (TCC3)
101 TCC3_CNT (TCC3)
102 TCC3_MC0 (TCC3)
103 TCC3_MC1 (TCC3)
104 SERCOM4_6 (SERCOM4)
105 SERCOM4_5 (SERCOM4)
106 SERCOM4_0 (SERCOM4)
107 SERCOM4_1 (SERCOM4)
108 SERCOM4_2 (SERCOM4)
109 SERCOM4_3 (SERCOM4)
110 SERCOM4_4 (SERCOM4)
111 SERCOM5_6 (SERCOM5)
112 SERCOM5_5 (SERCOM5)
113 SERCOM5_0 (SERCOM5)
114 SERCOM5_1 (SERCOM5)
115 SERCOM5_2 (SERCOM5)
116 SERCOM5_3 (SERCOM5)
117 SERCOM5_4 (SERCOM5)
118 TCC4_DFS (TCC4)
119 TCC4_CNT (TCC4)
120 TCC4_MC0 (TCC4)
121 TCC4_MC1 (TCC4)
122 TCC5_DFS (TCC5)
123 TCC5_CNT (TCC5)
124 TCC5_MC0 (TCC5)
125 TCC5_MC1 (TCC5)
126 TCC6_DFS (TCC6)
127 TCC6_CNT (TCC6)
128 TCC6_MC0 (TCC6)
129 TCC6_MC1 (TCC6)
130 ADC_REQ0 (ADC)
131 ADC_REQ1 (ADC)
132 AC
133 PTC
134 USB_EORSMDNRSM (USB)
135 USB_SOFHSOF (USB)
136 USB_TRCPT00 (USB)
137 USB_TRCPT10 (USB)
138 AT
139 HSM
140 PUF

## Event generators
1 SUPC_LVDET, 2 OSCCTRL_XOSCFAIL, 3 OSC32KCTRL_XOSC32KFAIL, 4 FREQM_DONE, 5 FREQM_WINMON, {n+6} RTC_PER{n} (n=0..7), {n+14} RTC_CMP{n} (n=0..3), 18 RTC_TAMPER, 19 RTC_OVF, 20 RTC_PERD, {n+21} EIC_EXTINT{n} (n=0..15), {n+37} DMAC_CH{n} (n=0..3), {5n+41} TCC{n}_OVF (n=0..6), {5n+42} TCC{n}_TRG (n=0..6), {5n+43} TCC{n}_CNT (n=0..6), {5n+44} TCC{n}_MC0 (n=0..6), {5n+45} TCC{n}_MC1 (n=0..6), 76 ADC_CHRDY, 77 ADC_CMP, 78 AC_COMP0, 79 AC_COMP1, 80 AC_WIN0, 81 PTC_EOC, 82 PTC_WCOMP, {n+83} CCL0_LUTOUT{n} (n=0..3), {n+87} CCL1_LUTOUT{n} (n=0..3)

## Event users
0 FREQM_START, 1 RTC_TAMPER, {n+2} PORT_EV{n} (n=0..3), {n+6} DMAC_CH{n} (n=0..3), {4n+10} TCC{n}_EV0 (n=0..6), {4n+11} TCC{n}_EV1 (n=0..6), {4n+12} TCC{n}_MC0 (n=0..6), {4n+13} TCC{n}_MC1 (n=0..6), {n+38} ADC_TRIG{n} (n=0..10), 49 AC_SOC0, 50 AC_SOC1, 51 PTC_DSEQR, 52 PTC_STCONV, {n+53} CCL0_LUTIN{n} (n=0..3), {n+57} CCL1_LUTIN{n} (n=0..3), 61 AT_TAMPSRC5

## Properties
SIGNATURES: DSU_DID=0x0AC08053

## Pinouts (pin number, pad)
P100: 1 PA00, 2 PA14, 3 PA01, 4 PA15, 5 PA02, 6 VSSIO1, 7 VDDIO, 8 PA10, 9 PA11, 10 PA12, 11 PA16, 12 PA17, 13 PA18, 14 PA03, 15 PA04, 16 PA05, 17 PA06, 18 PA13, 19 VDDIO, 20 VSSIO3, 21 PA07, 22 PA08, 23 PA09, 24 PA20, 25 PA19, 26 PB00, 27 PB07, 28 AVDD, 29 AVSS, 30 PB01, 31 PB02, 32 VDDIO, 33 VSSIO4, 34 VDDREG, 35 PB11, 36 PB12, 37 PB13, 38 PB14, 39 PB03, 40 PB04, 41 PB05, 42 PB08, 43 PB09, 44 PB06, 45 VSSIO5, 46 VDDIO, 47 PB15, 48 PB16, 49 PB17, 50 PB10, 51 PC00, 52 PC11, 53 PC12, 54 PC01, 55 PC13, 56 VDDIO, 57 VSSIO6, 58 PC02, 59 PC14, 60 PC15, 61 PC03, 62 PC16, 63 PC09, 64 PC04, 65 PC17, 66 PC10, 67 RESET_N, 68 VDDIO, 69 VSSIO7, 70 PC18, 71 PC19, 72 PC05, 73 PC06, 74 PC07, 75 PC08, 76 PD00, 77 PD10, 78 PD14, 79 PD11, 80 PD01, 81 VSSIO8, 82 VDDIO, 83 PD02, 84 PD03, 85 PD15, 86 PD16, 87 PD17, 88 PD12, 89 PD18, 90 PD13, 91 VSSIO, 92 VDDF, 93 PD06, 94 PD07, 95 PD19, 96 PD04, 97 PD05, 98 PD08, 99 PD20, 100 PD09
