# PIC32CM5112GC00100 device description
Architecture: CORTEX-M23; Family: PIC32CM; Series: PIC32CMGC00

## Interrupts
-15 Reset — Reset Vector, invoked on Power up and warm reset
-14 NonMaskableInt — Non maskable Interrupt, cannot be stopped or preempted
-13 HardFault — Hard Fault, all classes of Fault
-5 SVCall — System Service Call via SVC instruction
-2 PendSV — Pendable request for system service
-1 SysTick — System Tick Timer
0 FCR
1 FCW
2 PM
3 SUPC
4 OSCCTRL_XOSCRDY (OSCCTRL)
5 OSCCTRL_DFLLRDY (OSCCTRL)
6 OSCCTRL_PLLLOCKR_0 (OSCCTRL)
7 OSC32KCTRL_XOSC32KRDY (OSC32KCTRL)
8 OSC32KCTRL_XOSC32KFAIL (OSC32KCTRL)
9 MCLK
10 FREQM
11 WDT
12 RTC_TAMPER (RTC)
13 RTC_OVF (RTC)
14 RTC_PER0 (RTC)
15 RTC_CMP0 (RTC)
{n+16} EIC_EXTINT{n} (EIC) (n=0..15)
32 EIC_NSCHK (EIC)
34 MCRAMC
35 CAN0_INT0 (CAN0)
36 CAN0_INT1 (CAN0)
37 CAN0_BERR (CAN0)
38 CAN1_INT0 (CAN1)
39 CAN1_INT1 (CAN1)
40 CAN1_BERR (CAN1)
41 PORT
42 DMAC_TCMPL0 (DMAC)
43 DMAC_TCMPL1 (DMAC)
44 DMAC_TCMPL2 (DMAC)
45 DMAC_TCMPL3 (DMAC)
46 DMAC_TCMPL4 (DMAC)
47 HMATRIX2
{n+48} EVSYS_EVD{n} (EVSYS) (n=0..11)
60 SERCOM0_6 (SERCOM0)
61 SERCOM0_5 (SERCOM0)
62 SERCOM0_0 (SERCOM0)
63 SERCOM0_1 (SERCOM0)
64 SERCOM0_2 (SERCOM0)
65 SERCOM0_3 (SERCOM0)
66 SERCOM0_4 (SERCOM0)
67 SERCOM1_6 (SERCOM1)
68 SERCOM1_5 (SERCOM1)
69 SERCOM1_0 (SERCOM1)
70 SERCOM1_1 (SERCOM1)
71 SERCOM1_2 (SERCOM1)
72 SERCOM1_3 (SERCOM1)
73 SERCOM1_4 (SERCOM1)
74 SERCOM2_6 (SERCOM2)
75 SERCOM2_5 (SERCOM2)
76 SERCOM2_0 (SERCOM2)
77 SERCOM2_1 (SERCOM2)
78 SERCOM2_2 (SERCOM2)
79 SERCOM2_3 (SERCOM2)
80 SERCOM2_4 (SERCOM2)
81 SERCOM3_6 (SERCOM3)
82 SERCOM3_5 (SERCOM3)
83 SERCOM3_0 (SERCOM3)
84 SERCOM3_1 (SERCOM3)
85 SERCOM3_2 (SERCOM3)
86 SERCOM3_3 (SERCOM3)
87 SERCOM3_4 (SERCOM3)
88 TCC0_DFS (TCC0)
89 TCC0_CNT (TCC0)
90 TCC0_MC0 (TCC0)
91 TCC0_MC1 (TCC0)
92 TCC1_DFS (TCC1)
93 TCC1_CNT (TCC1)
94 TCC1_MC0 (TCC1)
95 TCC1_MC1 (TCC1)
96 TCC2_DFS (TCC2)
97 TCC2_CNT (TCC2)
98 TCC2_MC0 (TCC2)
99 TCC2_MC1 (TCC2)
100 TCC3_DFS (TCC3)
101 TCC3_CNT (TCC3)
102 TCC3_MC0 (TCC3)
103 TCC3_MC1 (TCC3)
104 SERCOM4_6 (SERCOM4)
105 SERCOM4_5 (SERCOM4)
106 SERCOM4_0 (SERCOM4)
107 SERCOM4_1 (SERCOM4)
108 SERCOM4_2 (SERCOM4)
109 SERCOM4_3 (SERCOM4)
110 SERCOM4_4 (SERCOM4)
111 SERCOM5_6 (SERCOM5)
112 SERCOM5_5 (SERCOM5)
113 SERCOM5_0 (SERCOM5)
114 SERCOM5_1 (SERCOM5)
115 SERCOM5_2 (SERCOM5)
116 SERCOM5_3 (SERCOM5)
117 SERCOM5_4 (SERCOM5)
118 TCC4_DFS (TCC4)
119 TCC4_CNT (TCC4)
120 TCC4_MC0 (TCC4)
121 TCC4_MC1 (TCC4)
122 TCC5_DFS (TCC5)
123 TCC5_CNT (TCC5)
124 TCC5_MC0 (TCC5)
125 TCC5_MC1 (TCC5)
126 TCC6_DFS (TCC6)
127 TCC6_CNT (TCC6)
128 TCC6_MC0 (TCC6)
129 TCC6_MC1 (TCC6)
130 ADC_REQ0 (ADC)
131 ADC_REQ1 (ADC)
132 AC
133 PTC
134 USB_EORSMDNRSM (USB)
135 USB_SOFHSOF (USB)
136 USB_TRCPT00 (USB)
137 USB_TRCPT10 (USB)
138 AT

## Event generators
1 SUPC_LVDET, 2 OSCCTRL_XOSCFAIL, 3 OSC32KCTRL_XOSC32KFAIL, 4 FREQM_DONE, 5 FREQM_WINMON, {n+6} RTC_PER{n} (n=0..7), {n+14} RTC_CMP{n} (n=0..3), 18 RTC_TAMPER, 19 RTC_OVF, 20 RTC_PERD, {n+21} EIC_EXTINT{n} (n=0..15), {n+37} DMAC_CH{n} (n=0..3), {5n+41} TCC{n}_OVF (n=0..6), {5n+42} TCC{n}_TRG (n=0..6), {5n+43} TCC{n}_CNT (n=0..6), {5n+44} TCC{n}_MC0 (n=0..6), {5n+45} TCC{n}_MC1 (n=0..6), 76 ADC_CHRDY, 77 ADC_CMP, 78 AC_COMP0, 79 AC_COMP1, 80 AC_WIN0, 81 PTC_EOC, 82 PTC_WCOMP, {n+83} CCL0_LUTOUT{n} (n=0..3), {n+87} CCL1_LUTOUT{n} (n=0..3)

## Event users
0 FREQM_START, 1 RTC_TAMPER, {n+2} PORT_EV{n} (n=0..3), {n+6} DMAC_CH{n} (n=0..3), {4n+10} TCC{n}_EV0 (n=0..6), {4n+11} TCC{n}_EV1 (n=0..6), {4n+12} TCC{n}_MC0 (n=0..6), {4n+13} TCC{n}_MC1 (n=0..6), {n+38} ADC_TRIG{n} (n=0..10), 49 AC_SOC0, 50 AC_SOC1, 51 PTC_DSEQR, 52 PTC_STCONV, {n+53} CCL0_LUTIN{n} (n=0..3), {n+57} CCL1_LUTIN{n} (n=0..3), 61 AT_TAMPSRC5

## Properties
SIGNATURES: DSU_DID=0x0AC00053

## Pinouts (pin number, pad)
P100: 1 PA00, 2 PA14, 3 PA01, 4 PA15, 5 PA02, 6 VSSIO1, 7 VDDIO, 8 PA10, 9 PA11, 10 PA12, 11 PA16, 12 PA17, 13 PA18, 14 PA03, 15 PA04, 16 PA05, 17 PA06, 18 PA13, 19 VDDIO, 20 VSSIO3, 21 PA07, 22 PA08, 23 PA09, 24 PA20, 25 PA19, 26 PB00, 27 PB07, 28 AVDD, 29 AVSS, 30 PB01, 31 PB02, 32 VDDIO, 33 VSSIO4, 34 VDDREG, 35 PB11, 36 PB12, 37 PB13, 38 PB14, 39 PB03, 40 PB04, 41 PB05, 42 PB08, 43 PB09, 44 PB06, 45 VSSIO5, 46 VDDIO, 47 PB15, 48 PB16, 49 PB17, 50 PB10, 51 PC00, 52 PC11, 53 PC12, 54 PC01, 55 PC13, 56 VDDIO, 57 VSSIO6, 58 PC02, 59 PC14, 60 PC15, 61 PC03, 62 PC16, 63 PC09, 64 PC04, 65 PC17, 66 PC10, 67 RESET_N, 68 VDDIO, 69 VSSIO7, 70 PC18, 71 PC19, 72 PC05, 73 PC06, 74 PC07, 75 PC08, 76 PD00, 77 PD10, 78 PD14, 79 PD11, 80 PD01, 81 VSSIO8, 82 VDDIO, 83 PD02, 84 PD03, 85 PD15, 86 PD16, 87 PD17, 88 PD12, 89 PD18, 90 PD13, 91 VSSIO, 92 VDDF, 93 USERLDO, 94 PD07, 95 PD19, 96 PD04, 97 PD05, 98 PD08, 99 PD20, 100 PD09

## Notices in the file
Copyright (c) 2024 Microchip Technology Inc.
SPDX-License-Identifier: Apache-2.0
Licensed under the Apache License, Version 2.0 (the "License");
you may not use this file except in compliance with the License.
You may obtain a copy of the License at
http://www.apache.org/licenses/LICENSE-2.0
Unless required by applicable law or agreed to in writing, software
distributed under the License is distributed on an "AS IS" BASIS,
WITHOUT WARRANTIES OR CONDITIONS OF ANY KIND, either express or implied.
See the License for the specific language governing permissions and
limitations under the License.
