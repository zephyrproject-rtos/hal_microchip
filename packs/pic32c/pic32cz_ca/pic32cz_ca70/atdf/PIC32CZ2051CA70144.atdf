# PIC32CZ2051CA70144 device description
Architecture: CORTEX-M7; Family: PIC32C; Series: PIC32CZCA70
Parameters: __CM7_REV=0x0101 (CM7 Core Revision), __NVIC_PRIO_BITS=3 (Number of Bits used for Priority Levels), __Vendor_SysTickConfig=0 (Set to 1 if different SysTick Config is used), __MPU_PRESENT=1 (MPU present or not), __VTOR_PRESENT=1 (Vector Table Offset Register present or not), __FPU_PRESENT=1 (FPU present or not), __FPU_DP=1 (Double Precision FPU), __ICACHE_PRESENT=1 (Instruction Cache present), __DCACHE_PRESENT=1 (Data Cache present), __ITCM_PRESENT=1 (Instruction TCM present), __DTCM_PRESENT=1 (Data TCM present), __DEBUG_LVL=1, __TRACE_LVL=1, LITTLE_ENDIAN=1, __ARCH_ARM=1, __ARCH_ARM_CORTEX_M=1, __DEVICE_IS_SAM=1
Programming and debug interfaces: JTAG, SWD
Registers are 32-bit, read-write, no defined reset value unless marked. A register's access mark holds for its fields unless they carry their own. Offsets are from the block's base; lines under a group give offsets from that group; [hi:lo] are bit positions; {n}, {i} and the like mark numbered series; 'fields as' and 'values as' point back to an identical list; <NAME> marks a mode.

## Ordering variants
PIC32CZ2051CA70144-I/B4B: BGA144, pinout PIC32CZCA144B4B, up to 300 MHz, 85 to -40 C, 2.50 to 3.6 V
PIC32CZ2051CA70144-V/B4B: BGA144, pinout PIC32CZCA144B4B, up to 300 MHz, 105 to -40 C, 2.50 to 3.6 V
PIC32CZ2051CA70144-I/Z8X: TQFP144, pinout PIC32CZCA144Z8X, up to 300 MHz, 85 to -40 C, 2.50 to 3.6 V
PIC32CZ2051CA70144-V/Z8X: TQFP144, pinout PIC32CZCA144Z8X, up to 300 MHz, 105 to -40 C, 2.50 to 3.6 V
PIC32CZ2051CA70144-I/XFB: ETQFP144, pinout PIC32CZCA144XFB, up to 300 MHz, 85 to -40 C, 2.50 to 3.6 V
PIC32CZ2051CA70144-V/XFB: ETQFP144, pinout PIC32CZCA144XFB, up to 300 MHz, 105 to -40 C, 2.50 to 3.6 V

## Memory
base space: start 0 size 0x100000000, little endian
  0x40000000 PERIPHERALS size 0x20000000 io, rw
  0xE0000000 SYSTEM size 0x10000000 io, rw
  0x80000000 QSPIMEM size 0x20000000 other, rw, executable
  0xA0000000 AXIMX size 0x00100000 other, rw
  0x00000000 ITCM size 0x00020000 other, rw, executable
  0x00400000 IFLASH size 0x00200000 flash, rw, executable, page 512
  0x00800000 IROM size 0x00004000 rom, executable
  0x20000000 DTCM size 0x00020000 other, rw, executable
  0x20400000 IRAM size 0x00080000 ram, rw, executable
  0x60000000 EBI_CS0 size 0x01000000 other, rw, executable
  0x61000000 EBI_CS1 size 0x01000000 other, rw, executable
  0x62000000 EBI_CS2 size 0x01000000 other, rw, executable
  0x63000000 EBI_CS3 size 0x01000000 other, rw, executable
fuses space: start 0 size 1, little endian
lockbits space: start 0 size 0x10, little endian

## Peripheral instances (address, pins/pin function, parameters)
ACC at 0x40044000
  parameters: INSTANCE_ID=33, CLOCK_ID=33, HAS_PLUS_COMPARATOR_SELECTION=1, HAS_MINUS_COMPARATOR_SELECTION=1, HAS_INVERTED_COMPARATOR=1, HAS_EDGETYPE_SELECTION=1, HAS_INTERRUPTS=1, HAS_CURRENT_SELECTION=1, HAS_HYSTERESIS=1, HAS_FAULT_ENABLE=1
AES at 0x4006C000
  parameters: DMAC_ID_TX=37, DMAC_ID_RX=38, INSTANCE_ID=56, CLOCK_ID=56
AFEC0 at 0x4003C000 (AFEC)
  pins: ADTRG PA08/B; AD0 PD30/X1; AD1 PA21/X1; AD2 PB03/X1; AD3 PE05/X1; AD4 PE04/X1; AD5 PB02/X1; AD6 PA17/X1; AD7 PA18/X1; AD8 PA19/X1; AD9 PA20/X1; AD10 PB00/X1
  parameters: DMAC_ID_RX=35, INSTANCE_ID=29, CLOCK_ID=29, TRGSEL_AFEC_TRIG0=0x0 (External ADC Trigger Input (AFE0_ADTRG pin)), TRGSEL_AFEC_TRIG1=0x1 (TC0 Channel 0 Output (TIOA0)), TRGSEL_AFEC_TRIG2=0x2 (TC0 Channel 1 Output (TIOA1)), TRGSEL_AFEC_TRIG3=0x3 (TC0 Channel 2 Output (TIOA2)), TRGSEL_AFEC_TRIG4=0x4 (PWM0 event line 0), TRGSEL_AFEC_TRIG5=0x5 (PWM0 event line 1), TRGSEL_AFEC_TRIG6=0x6 (Analog Comparator Fault Output), TEMP_SENSOR_CH_NUM=11 (Temperature Sensor Channel)
AFEC1 at 0x40064000 (AFEC)
  pins: ADTRG PD09/C; AD0 PB01/X1; AD1 PC13/X1; AD2 PC15/X1; AD3 PC12/X1; AD4 PC29/X1; AD5 PC30/X1; AD6 PC31/X1; AD7 PC26/X1; AD8 PC27/X1; AD9 PC00/X1; AD10 PE03/X1; AD11 PE00/X1
  parameters: DMAC_ID_RX=36, INSTANCE_ID=40, CLOCK_ID=40, TRGSEL_AFEC_TRIG0=0x0 (External ADC Trigger Input (AFE1_ADTRG Pin)), TRGSEL_AFEC_TRIG1=0x1 (TC1 Channel 0 Output (TIOA3)), TRGSEL_AFEC_TRIG2=0x2 (TC1 Channel 1 Output (TIOA4)), TRGSEL_AFEC_TRIG3=0x3 (TC1 Channel 2 Output (TIOA5)), TRGSEL_AFEC_TRIG4=0x4 (PWM1 event line 0), TRGSEL_AFEC_TRIG5=0x5 (PWM1 event line 1), TRGSEL_AFEC_TRIG6=0x6 (Analog Comparator Fault Output)
CHIPID at 0x400E0940
DACC at 0x40040000
  pins: DAC0 PB13/X1; DAC1 PD00/X1; DATRG PA02/C
  parameters: DMAC_ID_CH0_TX=30, DMAC_ID_CH1_TX=31, INSTANCE_ID=30, CLOCK_ID=30
EBI
  pins: A{n} PC{n+18}/A (n=0..13); A14 PA18/C; A15 PA19/C; A16 PA20/C; A17 PA00/C; A18 PA01/C; A19 PA23/C; A20 PA24/C; A21 PC16/A; A22 PC17/A; A23 PA25/C; D{n} PC{n:02}/A (n=0..7); D8 PE00/A; D9 PE01/A; D10 PE02/A; D11 PE03/A; D12 PE04/A; D13 PE05/A; D14 PA15/A; D15 PA16/A; NWAIT PC13/A; NCS0 PC14/A; NCS1 PC15/A or PD18/A; NCS2 PA22/C; NCS3 PC12/A or PD19/A; NWR0 PC08/A; NWR1 PD15/C; NRD PC11/A; NWE PC08/A; NBS0 PC18/A; NBS1 PD15/C; NANDALE PC16/A; NANDCLE PC17/A; NANDOE PC09/A; NANDWE PC10/A
EFC at 0x400E0C00
  pins: ERASE PB12/X1
  parameters: FLASH_SIZE=2097152, PAGE_SIZE=512, INSTANCE_ID=6, PAGES_PR_REGION=32
GMAC at 0x40050000
  pins: GCOL PD13/A; GCRS PD10/A; GMDC PD08/A; GMDIO PD09/A; GRXCK PD14/A; GRXDV PD04/A; GRXER PD07/A; GRX0 PD05/A; GRX1 PD06/A; GRX2 PD11/A; GRX3 PD12/A; GTSUCOMP PB01/B or PB12/B or PD11/C or PD20/C; GTXCK PD00/A; GTXEN PD01/A; GTXER PD17/A; GTX0 PD02/A; GTX1 PD03/A; GTX2 PD15/A; GTX3 PD16/A
  parameters: INSTANCE_ID=39, CLOCK_ID=39
GPBR at 0x400E1890
HSMCI at 0x40000000
  pins: MCCDA PA28/C; MCCK PA25/D; MCDA0 PA30/C; MCDA1 PA31/C; MCDA2 PA26/C; MCDA3 PA27/C
  parameters: DMAC_ID_RX=0, DMAC_ID_TX=0, INSTANCE_ID=18, CLOCK_ID=18
I2SC0 at 0x4008C000 (I2SC)
  pins: CK PA01/D; DI0 PA16/D; DO0 PA30/D; MCK PA00/D; WS PA15/D
  parameters: INSTANCE_ID=69, CLOCK_ID=69, DMAC_ID_TX_LEFT=44, DMAC_ID_RX_LEFT=45, DMAC_ID_TX_RIGHT=48, DMAC_ID_RX_RIGHT=49
I2SC1 at 0x40090000 (I2SC)
  pins: CK PA20/D; DI0 PE02/C; DO0 PE01/C; MCK PA19/D; WS PE00/C
  parameters: INSTANCE_ID=70, CLOCK_ID=70, DMAC_ID_TX_LEFT=46, DMAC_ID_RX_LEFT=47, DMAC_ID_TX_RIGHT=50, DMAC_ID_RX_RIGHT=51
ICM at 0x40048000
  parameters: INSTANCE_ID=32, CLOCK_ID=32
ISI at 0x4004C000
  pins: D0 PD22/D; D1 PD21/D; D2 PB03/D; D3 PA09/B; D4 PA05/B; D5 PD11/D; D6 PD12/D; D7 PA27/D; D8 PD27/D; D9 PD28/D; D10 PD30/D; D11 PD31/D; HSYNC PD24/D; PCK PA24/D; VSYNC PD25/D
  parameters: INSTANCE_ID=59, CLOCK_ID=59
MATRIX at 0x40088000
MCAN0 at 0x40030000 (MCAN)
  pins: CANRX0 PB03/A; CANTX0 PB02/A
  parameters: INSTANCE_ID=35, CLOCK_ID=35
MCAN1 at 0x40034000 (MCAN)
  pins: CANRX1 PC12/C; CANTX1 PC14/C or PD12/B
  parameters: INSTANCE_ID=37, CLOCK_ID=37
MLB at 0x40068000
  pins: MLBCLK PB04/C; MLBDAT PB05/C; MLBSIG PD10/D
  parameters: INSTANCE_ID=53, CLOCK_ID=53
PIOA at 0x400E0E00 (PIO)
  pins: P{n} PA{n:02} (n=0..31); PIODC0 PA03/X1; PIODC1 PA04/X1; PIODC2 PA05/X1; PIODC3 PA09/X1; PIODC4 PA10/X1; PIODC5 PA11/X1; PIODC6 PA12/X1; PIODC7 PA13/X1; PIODCEN1 PA14/X1; PIODCEN2 PA21/X1; PIODCCLK PA22/X1
  parameters: DMAC_ID_RX=34, INSTANCE_ID=10, CLOCK_ID=10
PIOB at 0x400E1000 (PIO)
  pins: P{n} PB{n-32:02} (n=32..41); P44 PB12; P45 PB13
  parameters: INSTANCE_ID=11, CLOCK_ID=11
PIOC at 0x400E1200 (PIO)
  pins: P{n} PC{n-64:02} (n=64..95)
  parameters: INSTANCE_ID=12, CLOCK_ID=12
PIOD at 0x400E1400 (PIO)
  pins: P{n} PD{n-96:02} (n=96..127)
  parameters: INSTANCE_ID=16, CLOCK_ID=16
PIOE at 0x400E1600 (PIO)
  pins: P128 PE00; P129 PE01; P130 PE02; P131 PE03; P132 PE04; P133 PE05
  parameters: INSTANCE_ID=17, CLOCK_ID=17
PMC at 0x400E0600
  pins: PCK0 PA06/B or PB12/D or PB13/B; PCK1 PA17/B or PA21/B; PCK2 PA03/C or PA18/B or PA31/B or PB03/B or PD31/C; XIN PB09/X1; XOUT PB08/X1; XIN32 PA07/X1; XOUT32 PA08/X1
  parameters: INSTANCE_ID=5
PWM0 at 0x40020000 (PWM)
  pins: PWMEXTRG0 PA10/B; PWMEXTRG1 PA22/B; PWMFI0 PA09/C; PWMFI1 PD08/B; PWMFI2 PD09/B; PWMH0 PA00/A or PA11/B or PA23/B or PB00/A or PD11/B or PD20/A; PWMH1 PA02/A or PA12/B or PA24/B or PB01/A or PD21/A; PWMH2 PA13/B or PA25/B or PB04/B or PC19/B or PD22/A; PWMH3 PA07/B or PA14/B or PA17/C or PC13/B or PC21/B or PD23/A; PWML0 PA01/A or PA19/B or PB05/B or PC00/B or PD10/B or PD24/A; PWML1 PA20/B or PB12/A or PC01/B or PC18/B or PD25/A; PWML2 PA16/C or PA30/A or PB13/A or PC02/B or PC20/B or PD26/A; PWML3 PA15/C or PC03/B or PC15/B or PC22/B or PD27/A
  parameters: DMAC_ID_TX=13, INSTANCE_ID=31, CLOCK_ID=31, FAULT_PWM_ID0=0x0 (Fault 0 - PWM0_PWMFI0 Input pin), FAULT_PWM_ID1=0x1 (Fault 1 - PWM0_PWMFI1 Input pin), FAULT_PWM_ID2=0x2 (Fault 2 - PWM0_PWMFI2 Input pin), FAULT_PWM_ID3=0x3 (Fault 3 - MAIN_OSC_PMC), FAULT_PWM_ID4=0x4 (Fault 4 - AFEC0), FAULT_PWM_ID5=0x5 (Fault 5 - AFEC1), FAULT_PWM_ID6=0x6 (Fault 6 - ACC), FAULT_PWM_ID7=0x7 (Fault 7 - TC0)
PWM1 at 0x4005C000 (PWM)
  pins: PWMEXTRG0 PA30/B; PWMEXTRG1 PA18/A; PWMFI0 PA21/C; PWMFI1 PA26/D; PWMFI2 PA28/D; PWMH0 PA12/C or PD01/B; PWMH1 PA14/C or PD03/B; PWMH2 PA31/D or PD05/B; PWMH3 PA08/A or PD07/B; PWML0 PA11/C or PD00/B; PWML1 PA13/C or PD02/B; PWML2 PA23/D or PD04/B; PWML3 PA05/A or PD06/B
  parameters: DMAC_ID_TX=39, INSTANCE_ID=60, CLOCK_ID=60, FAULT_PWM_ID0=0x0 (Fault 0 - PWM0_PWMFI0 Input pin), FAULT_PWM_ID1=0x1 (Fault 1 - PWM0_PWMFI1 Input pin), FAULT_PWM_ID2=0x2 (Fault 2 - PWM0_PWMFI2 Input pin), FAULT_PWM_ID3=0x3 (Fault 3 - MAIN_OSC_PMC), FAULT_PWM_ID4=0x4 (Fault 4 - AFEC0), FAULT_PWM_ID5=0x5 (Fault 5 - AFEC1), FAULT_PWM_ID6=0x6 (Fault 6 - ACC), FAULT_PWM_ID7=0x7 (Fault 7 - TC1)
QSPI at 0x4007C000
  pins: QCS PA11/A; QIO0 PA13/A; QIO1 PA12/A; QIO2 PA17/A; QIO3 PD31/A; QSCK PA14/A
  parameters: DMAC_ID_RX=6, DMAC_ID_TX=5, INSTANCE_ID=43, CLOCK_ID=43
RSTC at 0x400E1800
  parameters: INSTANCE_ID=1
RSWDT at 0x400E1900
  parameters: INSTANCE_ID=63
RTC at 0x400E1860
  pins: RTCOUT0 PB00/X1; RTCOUT1 PB01/X1
  parameters: INSTANCE_ID=2
RTT at 0x400E1830
  parameters: INSTANCE_ID=3
SMC at 0x40080000
  parameters: INSTANCE_ID=9, CLOCK_ID=9
SPI0 at 0x40008000 (SPI)
  pins: MISO PD20/B; MOSI PD21/B; NPCS0 PB02/D; NPCS1 PA31/A or PD25/B; NPCS2 PD12/C; NPCS3 PD27/B; SPCK PD22/B
  parameters: DMAC_ID_RX=2, DMAC_ID_TX=1, INSTANCE_ID=21, CLOCK_ID=21
SPI1 at 0x40058000 (SPI)
  pins: MISO PC26/C; MOSI PC27/C; NPCS0 PC25/C; NPCS1 PC28/C or PD00/C; NPCS2 PC29/C or PD01/C; NPCS3 PC30/C or PD02/C; SPCK PC24/C
  parameters: DMAC_ID_RX=4, DMAC_ID_TX=3, INSTANCE_ID=42, CLOCK_ID=42
SSC at 0x40004000
  pins: RD PA10/C; RF PD24/B; RK PA22/A; TD PB05/D or PD10/C or PD26/B; TF PB00/D; TK PB01/D
  parameters: DMAC_ID_RX=33, DMAC_ID_TX=32, INSTANCE_ID=22, CLOCK_ID=22
SUPC at 0x400E1810
  pins: WKUP0 PA00/X1; WKUP1 PA01/X1; WKUP2 PA02/X1; WKUP3 PA04/X1; WKUP4 PA05/X1; WKUP6 PA09/X1; WKUP7 PA11/X1; WKUP8 PA14/X1; WKUP9 PA19/X1; WKUP10 PA20/X1; WKUP11 PA30/X1; WKUP12 PB03/X1; WKUP13 PB05/X1; WKUP5 PD28/X1
  parameters: INSTANCE_ID=0
TC0 at 0x4000C000 (TC)
  pins: TCLK0 PA04/B; TCLK1 PA28/B; TCLK2 PA29/B; TIOA0 PA00/B; TIOA1 PA15/B; TIOA2 PA26/B; TIOB0 PA01/B; TIOB1 PA16/B; TIOB2 PA27/B
  parameters: DMAC_ID_RX=40, INSTANCE_ID_CHANNEL0=23, INSTANCE_ID_CHANNEL1=24, INSTANCE_ID_CHANNEL2=25, CLOCK_ID_CHANNEL0=23, CLOCK_ID_CHANNEL1=24, CLOCK_ID_CHANNEL2=25, TCCLKS_=0 (MCK), TCCLKS_TIMER_CLOCK1=1 (PCK), TCCLKS_TIMER_CLOCK2=2 (MCK/8), TCCLKS_TIMER_CLOCK3=3 (MCK/32), TCCLKS_TIMER_CLOCK4=4 (MCK/128), TCCLKS_TIMER_CLOCK5=5 (SLCK), TCCLKS_XC0=6 (XC0), TCCLKS_XC1=7 (XC1), TCCLKS_XC2=8 (XC2), NUM_INTERRUPT_LINES=3, TIMER_WIDTH=16
TC1 at 0x40010000 (TC)
  pins: TCLK3 PC25/B; TCLK4 PC28/B; TCLK5 PC31/B; TIOA3 PC23/B; TIOA4 PC26/B; TIOA5 PC29/B; TIOB3 PC24/B; TIOB4 PC27/B; TIOB5 PC30/B
  parameters: DMAC_ID_RX=41, INSTANCE_ID_CHANNEL0=26, INSTANCE_ID_CHANNEL1=27, INSTANCE_ID_CHANNEL2=28, CLOCK_ID_CHANNEL0=26, CLOCK_ID_CHANNEL1=27, CLOCK_ID_CHANNEL2=28, TCCLKS_=0 (MCK), TCCLKS_TIMER_CLOCK1=1 (PCK6), TCCLKS_TIMER_CLOCK2=2 (MCK/8), TCCLKS_TIMER_CLOCK3=3 (MCK/32), TCCLKS_TIMER_CLOCK4=4 (MCK/128), TCCLKS_TIMER_CLOCK5=5 (SLCK), TCCLKS_XC0=6 (XC0), TCCLKS_XC1=7 (XC1), TCCLKS_XC2=8 (XC2), NUM_INTERRUPT_LINES=3, TIMER_WIDTH=16
TC2 at 0x40014000 (TC)
  pins: TCLK6 PC07/B; TCLK7 PC10/B; TCLK8 PC14/B; TIOA6 PC05/B; TIOA7 PC08/B; TIOA8 PC11/B; TIOB6 PC06/B; TIOB7 PC09/B; TIOB8 PC12/B
  parameters: DMAC_ID_RX=42, INSTANCE_ID_CHANNEL0=47, INSTANCE_ID_CHANNEL1=48, INSTANCE_ID_CHANNEL2=49, CLOCK_ID_CHANNEL0=47, CLOCK_ID_CHANNEL1=48, CLOCK_ID_CHANNEL2=49, TCCLKS_=0 (MCK), TCCLKS_TIMER_CLOCK1=1 (PCK6), TCCLKS_TIMER_CLOCK2=2 (MCK/8), TCCLKS_TIMER_CLOCK3=3 (MCK/32), TCCLKS_TIMER_CLOCK4=4 (MCK/128), TCCLKS_TIMER_CLOCK5=5 (SLCK), TCCLKS_XC0=6 (XC0), TCCLKS_XC1=7 (XC1), TCCLKS_XC2=8 (XC2), NUM_INTERRUPT_LINES=3, TIMER_WIDTH=16
TC3 at 0x40054000 (TC)
  pins: TCLK9 PE02/B; TCLK10 PE05/B; TCLK11 PD24/C; TIOA9 PE00/B; TIOA10 PE03/B; TIOA11 PD21/C; TIOB9 PE01/B; TIOB10 PE04/B; TIOB11 PD22/C
  parameters: DMAC_ID_RX=43, INSTANCE_ID_CHANNEL0=50, INSTANCE_ID_CHANNEL1=51, INSTANCE_ID_CHANNEL2=52, CLOCK_ID_CHANNEL0=50, CLOCK_ID_CHANNEL1=51, CLOCK_ID_CHANNEL2=52, TCCLKS_=0 (MCK), TCCLKS_TIMER_CLOCK1=1 (PCK6), TCCLKS_TIMER_CLOCK2=2 (MCK/8), TCCLKS_TIMER_CLOCK3=3 (MCK/32), TCCLKS_TIMER_CLOCK4=4 (MCK/128), TCCLKS_TIMER_CLOCK5=5 (SLCK), TCCLKS_XC0=6 (XC0), TCCLKS_XC1=7 (XC1), TCCLKS_XC2=8 (XC2), NUM_INTERRUPT_LINES=3, TIMER_WIDTH=16
TRNG at 0x40070000
  parameters: INSTANCE_ID=57, CLOCK_ID=57
TWIHS0 at 0x40018000 (TWIHS)
  pins: TWCK0 PA04/A; TWD0 PA03/A
  parameters: DMAC_ID_RX=15, DMAC_ID_TX=14, INSTANCE_ID=19, CLOCK_ID=19
TWIHS1 at 0x4001C000 (TWIHS)
  pins: TWCK1 PB05/A; TWD1 PB04/A
  parameters: DMAC_ID_RX=17, DMAC_ID_TX=16, INSTANCE_ID=20, CLOCK_ID=20
TWIHS2 at 0x40060000 (TWIHS)
  pins: TWCK2 PD28/C; TWD2 PD27/C
  parameters: DMAC_ID_RX=19, DMAC_ID_TX=18, INSTANCE_ID=41, CLOCK_ID=41
UART0 at 0x400E0800 (UART)
  pins: URXD0 PA09/A; UTXD0 PA10/A
  parameters: DMAC_ID_RX=21, DMAC_ID_TX=20, INSTANCE_ID=7, CLOCK_ID=7, BRSRCCK_PERIPH_CLK=0 (MCK), BRSRCCK_PMC_PCK=0 (PCK4)
UART1 at 0x400E0A00 (UART)
  pins: URXD1 PA05/C; UTXD1 PA04/C or PA06/C or PD26/D
  parameters: DMAC_ID_RX=23, DMAC_ID_TX=22, INSTANCE_ID=8, CLOCK_ID=8, BRSRCCK_PERIPH_CLK=0 (MCK), BRSRCCK_PMC_PCK=0 (PCK4)
UART2 at 0x400E1A00 (UART)
  pins: URXD2 PD25/C; UTXD2 PD26/C
  parameters: DMAC_ID_RX=25, DMAC_ID_TX=24, INSTANCE_ID=44, CLOCK_ID=44, BRSRCCK_PERIPH_CLK=0 (MCK), BRSRCCK_PMC_PCK=0 (PCK4)
UART3 at 0x400E1C00 (UART)
  pins: URXD3 PD28/A; UTXD3 PD30/A or PD31/B
  parameters: DMAC_ID_RX=27, DMAC_ID_TX=26, INSTANCE_ID=45, CLOCK_ID=45, BRSRCCK_PERIPH_CLK=0 (MCK), BRSRCCK_PMC_PCK=0 (PCK4)
UART4 at 0x400E1E00 (UART)
  pins: URXD4 PD18/C; UTXD4 PD03/C or PD19/C
  parameters: DMAC_ID_RX=29, DMAC_ID_TX=28, INSTANCE_ID=46, CLOCK_ID=46, BRSRCCK_PERIPH_CLK=0 (MCK), BRSRCCK_PMC_PCK=0 (PCK4)
USART0 at 0x40024000 (USART)
  pins: CTS0 PB02/C; DCD0 PD00/D; DSR0 PD02/D; DTR0 PD01/D; RI0 PD03/D; RTS0 PB03/C; RXD0 PB00/C; SCK0 PB13/C; TXD0 PB01/C
  parameters: DMAC_ID_RX=8, DMAC_ID_TX=7, INSTANCE_ID=13, CLOCK_ID=13, USCLKS_MCK=0 (MCK), USCLKS_DIV=1 (MCK/8), USCLKS_PCK=2 (PCK4), USCLKS_SCK=3 (SCK)
USART1 at 0x40028000 (USART)
  pins: CTS1 PA25/A; DCD1 PA26/A; DSR1 PA28/A; DTR1 PA27/A; LONCOL1 PA03/B; RI1 PA29/A; RTS1 PA24/A; RXD1 PA21/A; SCK1 PA23/A; TXD1 PB04/D
  parameters: DMAC_ID_RX=10, DMAC_ID_TX=9, INSTANCE_ID=14, CLOCK_ID=14, USCLKS_MCK=0 (MCK), USCLKS_DIV=1 (MCK/8), USCLKS_PCK=2 (PCK4), USCLKS_SCK=3 (SCK)
USART2 at 0x4002C000 (USART)
  pins: CTS2 PD19/B; DCD2 PD04/D; DSR2 PD06/D; DTR2 PD05/D; RI2 PD07/D; RTS2 PD18/B; RXD2 PD15/B; SCK2 PD17/B; TXD2 PD16/B
  parameters: DMAC_ID_RX=12, DMAC_ID_TX=11, INSTANCE_ID=15, CLOCK_ID=15, USCLKS_MCK=0 (MCK), USCLKS_DIV=1 (MCK/8), USCLKS_PCK=2 (PCK4), USCLKS_SCK=3 (SCK)
USBHS at 0x40038000
  parameters: INSTANCE_ID=34, CLOCK_ID=34
UTMI at 0x400E0400
WDT at 0x400E1850
  parameters: INSTANCE_ID=4
XDMAC at 0x40078000
  parameters: INSTANCE_ID=58, CLOCK_ID=58
FUSES at GPNVMBITS 0 in fuses
LOCKBIT at 0 in lockbits
SCnSCB at 0xE000E000
SCB at 0xE000ED00
SysTick at 0xE000E010
NVIC at 0xE000E100
MPU at 0xE000ED90
FPU at 0xE000EF30
ITM at 0xE0000000
DWT at 0xE0001000
FPB at 0xE0002000
  parameters: __BKPT_NUM=8 (Number of FPB breakpoint comparators)
CoreDebug at 0xE000EDF0
ETM at 0xE0041000
ICE
  pins: TDI PB04/X1; TDO PB05/X1; TRACESWO PB05/X1; TMS PB06/X1; SWDIO PB06/X1; TCK PB07/X1; SWDCLK PB07/X1
TPIU at 0xE0040000
  pins: TRACECLK PD08/D; TRACED0 PD04/C; TRACED1 PD05/C; TRACED2 PD06/C; TRACED3 PD07/C

## Interrupts
-15 Reset — Reset Vector, invoked on Power up and warm reset
-14 NonMaskableInt — Non maskable Interrupt, cannot be stopped or preempted
-13 HardFault — Hard Fault, all classes of Fault
-12 MemoryManagement — Memory Management, MPU mismatch, including Access Violation and No Match
-11 BusFault — Bus Fault, Pre-Fetch-, Memory Access Fault, other address/memory related Fault
-10 UsageFault — Usage Fault, i.e. Undef Instruction, Illegal State Transition
-5 SVCall — System Service Call via SVC instruction
-4 DebugMonitor
-2 PendSV — Pendable request for system service
-1 SysTick — System Tick Timer
0 SUPC — Supply Controller
1 RSTC — Reset Controller
2 RTC — Real Time Clock
3 RTT — Real Time Timer
4 WDT — Watchdog Timer
5 PMC — Power Management Controller
6 EFC — Enhanced Embedded Flash Controller
7 UART0
8 UART1
10 PIOA — Parallel I/O Controller A
11 PIOB — Parallel I/O Controller B
12 PIOC — Parallel I/O Controller C
13 USART0
14 USART1
15 USART2
16 PIOD — Parallel I/O Controller D
17 PIOE — Parallel I/O Controller E
18 HSMCI — Multimedia Card Interface
19 TWIHS0 — Two Wire Interface 0 HS
20 TWIHS1 — Two Wire Interface 1 HS
21 SPI0 — Serial Peripheral Interface 0
22 SSC — Synchronous Serial Controller
23 TC0 — Timer/Counter 0
24 TC1 (TC0) — Timer/Counter 1
25 TC2 (TC0) — Timer/Counter 2
26 TC3 (TC1) — Timer/Counter 3
27 TC4 (TC1) — Timer/Counter 4
28 TC5 (TC1) — Timer/Counter 5
29 AFEC0 — Analog Front End 0
30 DACC — Digital To Analog Converter
31 PWM0 — Pulse Width Modulation 0
32 ICM — Integrity Check Monitor
33 ACC — Analog Comparator
34 USBHS — USB Host / Device Controller
35 MCAN0_INT0 (MCAN0) — MCAN Controller 0 Interrupt 0
36 MCAN0_INT1 (MCAN0) — MCAN Controller 0 Interrupt 1
37 MCAN1_INT0 (MCAN1) — MCAN Controller 1 Interrupt 0
38 MCAN1_INT1 (MCAN1) — MCAN Controller 1 Interrupt 1
39 GMAC — Ethernet MAC
40 AFEC1 — Analog Front End 1
41 TWIHS2 — Two Wire Interface 2 HS
42 SPI1 — Serial Peripheral Interface 1
43 QSPI — Quad I/O Serial Peripheral Interface
44 UART2
45 UART3
46 UART4
47 TC6 (TC2) — Timer/Counter 6
48 TC7 (TC2) — Timer/Counter 7
49 TC8 (TC2) — Timer/Counter 8
50 TC9 (TC3) — Timer/Counter 9
51 TC10 (TC3) — Timer/Counter 10
52 TC11 (TC3) — Timer/Counter 11
53 MLB — MediaLB
56 AES
57 TRNG — True Random Generator
58 XDMAC — DMA
59 ISI — Camera Interface
60 PWM1 — Pulse Width Modulation 1
61 FPU — Floating Point Unit
63 RSWDT — Reinforced Secure Watchdog Timer
64 CCW (SCB) — Cache ECC Warning
65 CCF (SCB) — Cache ECC Fault
66 GMAC_Q1 (GMAC) — GMAC Queue 1
67 GMAC_Q2 (GMAC) — GMAC Queue 2
68 IXC (FPU) — Floating Point Unit IXC
69 I2SC0 — Inter-IC Sound controller 0
70 I2SC1 — Inter-IC Sound controller 1
71 GMAC_Q3 (GMAC) — GMAC Queue 3
72 GMAC_Q4 (GMAC) — GMAC Queue 4
73 GMAC_Q5 (GMAC) — GMAC Queue 5

## Properties
SIGNATURES: JTAGID=0x05B3D03F, CHIPID_CIDR=0xA1AF0E00, CHIPID_EXID=0x00000002
LEGACY_INSTANCE_IDS: ID_TC0=TC0_INSTANCE_ID_CHANNEL0, ID_TC1=TC0_INSTANCE_ID_CHANNEL1, ID_TC2=TC0_INSTANCE_ID_CHANNEL2, ID_TC3=TC1_INSTANCE_ID_CHANNEL0, ID_TC4=TC1_INSTANCE_ID_CHANNEL1, ID_TC5=TC1_INSTANCE_ID_CHANNEL2, ID_TC6=TC2_INSTANCE_ID_CHANNEL0, ID_TC7=TC2_INSTANCE_ID_CHANNEL1, ID_TC8=TC2_INSTANCE_ID_CHANNEL2, ID_TC9=TC3_INSTANCE_ID_CHANNEL0, ID_TC10=TC3_INSTANCE_ID_CHANNEL1, ID_TC11=TC3_INSTANCE_ID_CHANNEL2
ELECTRICAL_CHARACTERISTICS: CHIP_FREQ_SLCK_RC_MIN=20000, CHIP_FREQ_SLCK_RC=32000 (Typical Slow Clock Internal RC frequency), CHIP_FREQ_SLCK_RC_MAX=44000, CHIP_FREQ_MAINCK_RC_4MHZ=4000000, CHIP_FREQ_MAINCK_RC_8MHZ=8000000, CHIP_FREQ_MAINCK_RC_12MHZ=12000000, CHIP_FREQ_CPU_MAX=300000000, CHIP_FREQ_XTAL_32K=32768, CHIP_FREQ_XTAL_12M=12000000, CHIP_FREQ_FWS_0=23000000 (Maximum operating frequency when FWS is 0), CHIP_FREQ_FWS_1=46000000 (Maximum operating frequency when FWS is 1), CHIP_FREQ_FWS_2=69000000 (Maximum operating frequency when FWS is 2), CHIP_FREQ_FWS_3=92000000 (Maximum operating frequency when FWS is 3), CHIP_FREQ_FWS_4=115000000 (Maximum operating frequency when FWS is 4), CHIP_FREQ_FWS_5=138000000 (Maximum operating frequency when FWS is 5), CHIP_FREQ_FWS_6=150000000 (Maximum operating frequency when FWS is 6), CHIP_FREQ_FWS_NUMBER=7 (Number of FWS ranges)

## Pinouts (pin number, pad)
PIC32CZCA144B4B: A1 PE01, A2 PB09, A3 PB08, A4 HSDP, A5 PD02, A6 PA29, A7 PC21, A8 PD06, A9 PC20, A10 PA30, A11 PD15, A12 PB04, B1 PE02, B2 PB13, B3 VDDUTMIC, B4 HSDM, B5 PD01, B6 PC24, B7 PD03, B8 PD07, B9 PA06, B10 PC18, B11 JTAGSEL, B12 PC17, C1 VDDIN, C2 PE00, C3 VDDOUT, C4 VBG, C5 PC25, C6 PC23, C7 PC22, C8 PA31, C9 PA28, C10 PB05, C11 PA00, C12 PD10, D1 ADVREFP, D2 ADVREFN, D3 PD31, D4 PD00, D5 GNDANA, D6 PD04, D7 PD05, D8 PC19, D9 PD09, D10 PD29, D11 PC16, D12 PA01, E1 PC31, E2 PC27, E3 PE03, E4 PC00, E5 GNDUTMI, E6 GNDPLLUSB, E7 VDDUTMII, E8 VDDCORE, E9 PD08, E10 PC14, E11 PD11, E12 PA02, F1 PC30, F2 PC26, F3 PC29, F4 PC12, F5 GND, F6 GND, F7 GNDPLL, F8 VDDPLLUSB, F9 PB07, F10 PC10, F11 PC11, F12 PA03, G1 PC15, G2 PC13, G3 PB01, G4 GND, G5 GND, G6 GND, G7 GND, G8 VDDIO, G9 PD13, G10 PD12, G11 PC09, G12 PB12, H1 PA19, H2 PA18, H3 PA20, H4 PB00, H5 VDDCORE, H6 VDDIO, H7 VDDIO, H8 VDDCORE, H9 PD21, H10 PD14, H11 TST, H12 NRST, J1 PA17, J2 PB02, J3 PB03, J4 PC01, J5 PC04, J6 PD27, J7 VDDPLL, J8 PA26, J9 PA11, J10 PA27, J11 PB06, J12 PC08, K1 PE04, K2 PA21, K3 PA22, K4 PC02, K5 PA16, K6 PA14, K7 PC06, K8 PA25, K9 PD20, K10 PD28, K11 PD16, K12 PA04, L1 PE05, L2 PA07, L3 PC03, L4 PA23, L5 PA15, L6 PD26, L7 PA24, L8 PC05, L9 PA10, L10 PA12, L11 PD17, L12 PC28, M1 PD30, M2 PA08, M3 PA13, M4 PC07, M5 PD25, M6 PD24, M7 PD23, M8 PD22, M9 PD19, M10 PD18, M11 PA05, M12 PA09
PIC32CZCA144Z8X, PIC32CZCA144XFB: 102 PA00, 99 PA01, 93 PA02, 91 PA03, 77 PA04, 73 PA05, 114 PA06, 35 PA07, 36 PA08, 75 PA09, 66 PA10, 64 PA11, 68 PA12, 42 PA13, 51 PA14, 49 PA15, 45 PA16, 25 PA17, 24 PA18, 23 PA19, 22 PA20, 32 PA21, 37 PA22, 46 PA23, 56 PA24, 59 PA25, 62 PA26, 70 PA27, 112 PA28, 129 PA29, 116 PA30, 118 PA31, 21 PB00, 20 PB01, 26 PB02, 31 PB03, 105 PB04, 109 PB05, 79 PB06, 89 PB07, 141 PB08, 142 PB09, 87 PB12, 144 PB13, 11 PC00, 38 PC01, 39 PC02, 40 PC03, 41 PC04, 58 PC05, 54 PC06, 48 PC07, 82 PC08, 86 PC09, 90 PC10, 94 PC11, 17 PC12, 19 PC13, 97 PC14, 18 PC15, 100 PC16, 103 PC17, 111 PC18, 117 PC19, 120 PC20, 122 PC21, 124 PC22, 127 PC23, 130 PC24, 133 PC25, 13 PC26, 12 PC27, 76 PC28, 16 PC29, 15 PC30, 14 PC31, 1 PD00, 132 PD01, 131 PD02, 128 PD03, 126 PD04, 125 PD05, 121 PD06, 119 PD07, 113 PD08, 110 PD09, 101 PD10, 98 PD11, 92 PD12, 88 PD13, 84 PD14, 106 PD15, 78 PD16, 74 PD17, 69 PD18, 67 PD19, 65 PD20, 63 PD21, 60 PD22, 57 PD23, 55 PD24, 52 PD25, 53 PD26, 47 PD27, 71 PD28, 108 PD29, 34 PD30, 2 PD31, 4 PE00, 6 PE01, 7 PE02, 10 PE03, 27 PE04, 28 PE05, 3 VDDOUT, 5 VDDIN, 8 VREFN, 9 VREFP, 83 NRST, 85 TST, 30 VDDIO, 43 VDDIO, 72 VDDIO, 80 VDDIO, 96 VDDIO, 104 JTAGSEL, 29 VDDCORE, 33 VDDCORE, 50 VDDCORE, 81 VDDCORE, 107 VDDCORE, 123 VDDPLL, 134 VDDUTMII, 136 HSDM, 137 HSDP, 44 GND, 61 GND, 95 GND, 115 GND, 135 GND, 138 GND, 139 VDDUTMIC, 140 VBG, 143 VDDPLLUSB

## Notices in the file
Copyright (c) 2017 Microchip Technology Inc.
SPDX-License-Identifier: Apache-2.0
Licensed under the Apache License, Version 2.0 (the "License");
you may not use this file except in compliance with the License.
You may obtain a copy of the License at
http://www.apache.org/licenses/LICENSE-2.0
Unless required by applicable law or agreed to in writing, software
distributed under the License is distributed on an "AS IS" BASIS,
WITHOUT WARRANTIES OR CONDITIONS OF ANY KIND, either express or implied.
See the License for the specific language governing permissions and
limitations under the License..
