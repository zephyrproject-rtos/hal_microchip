# PIC32CZ4010CA91208 device description
Architecture: CORTEX-M7; Family: PIC32C; Series: PIC32CZCA91

## Peripheral instances (address, pins/pin function, parameters) (continued)
SERCOM0 at 0x46000000 (SERCOM)
  pins: PAD0 PC00/D; PAD1 PC01/D; PAD2 PC02/D; PAD3 PC03/D
  parameters: CLK_REDUCTION=1 (Reduce clock options to pin 1 for SPI and USART), DMA=1 (DMA support implemented?), DMAC_ID_RX=5 (Index of DMA RX trigger), DMAC_ID_TX=6 (Index of DMA TX trigger), FIFO_IMPLEMENTED=1 (FIFO Rx/Tx implemented?), FIFO_SIZE=16 (Rx-Tx FIFO size in bytes), FSYNC_IMPLEMENTED=1 (SPI Frame Synch mode implemented?), GCLK_ID_CORE=21, GCLK_ID_SLOW=18, SPI=1 (SPI mode implemented?), TWIM=1 (TWI Master mode implemented?), TWIS=1 (TWI Slave mode implemented?), TWI_HSMODE=1 (TWI HighSpeed mode implemented?), ULTRA_IMPLEMENTATION=0 (ULTRA platform compatibility?), USART=1 (USART mode implemented?), USART_AUTOBAUD=1 (USART autobaud implemented?), USART_IRDA=1 (USART IrDA implemented?), USART_ISO7816=1 (USART ISO7816 mode implemented?), USART_LIN_MASTER=1 (USART LIN Master mode implemented?), USART_RS485=1 (USART RS485 mode implemented?), INSTANCE_ID=23 (Instance index for SERCOM0), MCLK_ID_APB=31 (Index for SERCOM0 APB clock), PAC_ID=23 (Index for SERCOM0 registers write protection), USART_ERROR_INT_SRC=55 (USART/SPI/I2C Error), USART_TX_READY_INT_SRC=57 (USART-SPI Data Register Empty/ I2C Stop Received), USART_TX_COMPLETE_INT_SRC=58 (USART-SPI Transmit Complete/ I2C Address Match), USART_RX_INT_SRC=59 (USART-SPI Receive Complete/ I2C Data Ready), SPI_TX_READY_INT_SRC=57 (USART-SPI Data Register Empty/ I2C Stop Received), SPI_TX_COMPLETE_INT_SRC=58 (USART-SPI Transmit Complete/ I2C Address Match), SPI_RX_INT_SRC=59 (USART-SPI Receive Complete/ I2C Data Ready), I2C_0_INT_SRC=55 (USART/SPI/I2C Error), I2C_1_INT_SRC=59 (USART-SPI Receive Complete/ I2C Data Ready), I2C_2_INT_SRC=60 (USART Receive Start/ SPI Slave Select Low/ I2C TX FIFO Empty), I2C_3_INT_SRC=61 (USART Clear To Send Input Change/ I2C RX FIFO Full)
SERCOM1 at 0x46002000 (SERCOM)
  pins: PAD0 PC04/D set 1 or PC20/D set 2; PAD1 PC05/D set 1 or PC19/D set 2; PAD2 PC06/D set 1 or PC18/D set 2; PAD3 PC07/D set 1 or PC17/D set 2
  parameters: CLK_REDUCTION=1 (Reduce clock options to pin 1 for SPI and USART), DMA=1 (DMA support implemented?), DMAC_ID_RX=7 (Index of DMA RX trigger), DMAC_ID_TX=8 (Index of DMA TX trigger), FIFO_IMPLEMENTED=1 (FIFO Rx/Tx implemented?), FIFO_SIZE=16 (Rx-Tx FIFO size in bytes), FSYNC_IMPLEMENTED=1 (SPI Frame Synch mode implemented?), GCLK_ID_CORE=22, GCLK_ID_SLOW=18, SPI=1 (SPI mode implemented?), TWIM=1 (TWI Master mode implemented?), TWIS=1 (TWI Slave mode implemented?), TWI_HSMODE=1 (TWI HighSpeed mode implemented?), ULTRA_IMPLEMENTATION=0 (ULTRA platform compatibility?), USART=1 (USART mode implemented?), USART_AUTOBAUD=1 (USART autobaud implemented?), USART_IRDA=1 (USART IrDA implemented?), USART_ISO7816=1 (USART ISO7816 mode implemented?), USART_LIN_MASTER=1 (USART LIN Master mode implemented?), USART_RS485=1 (USART RS485 mode implemented?), INSTANCE_ID=24 (Instance index for SERCOM1), MCLK_ID_APB=32 (Index for SERCOM1 APB clock), PAC_ID=24 (Index for SERCOM1 registers write protection), USART_ERROR_INT_SRC=62 (USART/SPI/I2C Error), USART_TX_READY_INT_SRC=64 (USART-SPI Data Register Empty/ I2C Stop Received), USART_TX_COMPLETE_INT_SRC=65 (USART-SPI Transmit Complete/ I2C Address Match), USART_RX_INT_SRC=66 (USART-SPI Receive Complete/ I2C Data Ready), SPI_TX_READY_INT_SRC=64 (USART-SPI Data Register Empty/ I2C Stop Received), SPI_TX_COMPLETE_INT_SRC=65 (USART-SPI Transmit Complete/ I2C Address Match), SPI_RX_INT_SRC=66 (USART-SPI Receive Complete/ I2C Data Ready), I2C_0_INT_SRC=62 (USART/SPI/I2C Error), I2C_1_INT_SRC=66 (USART-SPI Receive Complete/ I2C Data Ready), I2C_2_INT_SRC=67 (USART Receive Start/ SPI Slave Select Low/ I2C TX FIFO Empty), I2C_3_INT_SRC=68 (USART Clear To Send Input Change/ I2C RX FIFO Full)
SERCOM2 at 0x45800000 (SERCOM)
  pins: PAD0 PC08/D set 1 or PD11/D set 2; PAD1 PC09/D set 1 or PD12/D set 2; PAD2 PC10/D set 1 or PA04/D set 2; PAD3 PC11/D set 1 or PA03/D set 2
  parameters: CLK_REDUCTION=1 (Reduce clock options to pin 1 for SPI and USART), DMA=1 (DMA support implemented?), DMAC_ID_RX=9 (Index of DMA RX trigger), DMAC_ID_TX=10 (Index of DMA TX trigger), FIFO_IMPLEMENTED=1 (FIFO Rx/Tx implemented?), FIFO_SIZE=16 (Rx-Tx FIFO size in bytes), FSYNC_IMPLEMENTED=1 (SPI Frame Synch mode implemented?), GCLK_ID_CORE=23, GCLK_ID_SLOW=19, SPI=1 (SPI mode implemented?), TWIM=1 (TWI Master mode implemented?), TWIS=1 (TWI Slave mode implemented?), TWI_HSMODE=1 (TWI HighSpeed mode implemented?), ULTRA_IMPLEMENTATION=0 (ULTRA platform compatibility?), USART=1 (USART mode implemented?), USART_AUTOBAUD=1 (USART autobaud implemented?), USART_IRDA=1 (USART IrDA implemented?), USART_ISO7816=1 (USART ISO7816 mode implemented?), USART_LIN_MASTER=1 (USART LIN Master mode implemented?), USART_RS485=1 (USART RS485 mode implemented?), INSTANCE_ID=25 (Instance index for SERCOM2), MCLK_ID_APB=33 (Index for SERCOM2 APB clock), PAC_ID=25 (Index for SERCOM2 registers write protection), USART_ERROR_INT_SRC=69 (USART/SPI/I2C Error), USART_TX_READY_INT_SRC=71 (USART-SPI Data Register Empty/ I2C Stop Received), USART_TX_COMPLETE_INT_SRC=72 (USART-SPI Transmit Complete/ I2C Address Match), USART_RX_INT_SRC=73 (USART-SPI Receive Complete/ I2C Data Ready), SPI_TX_READY_INT_SRC=71 (USART-SPI Data Register Empty/ I2C Stop Received), SPI_TX_COMPLETE_INT_SRC=72 (USART-SPI Transmit Complete/ I2C Address Match), SPI_RX_INT_SRC=73 (USART-SPI Receive Complete/ I2C Data Ready), I2C_0_INT_SRC=69 (USART/SPI/I2C Error), I2C_1_INT_SRC=73 (USART-SPI Receive Complete/ I2C Data Ready), I2C_2_INT_SRC=74 (USART Receive Start/ SPI Slave Select Low/ I2C TX FIFO Empty), I2C_3_INT_SRC=75 (USART Clear To Send Input Change/ I2C RX FIFO Full)
SERCOM3 at 0x45802000 (SERCOM)
  pins: PAD0 PC12/D set 1 or PD03/D set 2; PAD1 PC13/D set 1 or PD04/D set 2; PAD2 PC14/D set 1 or PD05/D set 2; PAD3 PC15/D set 1 or PD06/D set 2
  parameters: CLK_REDUCTION=1 (Reduce clock options to pin 1 for SPI and USART), DMA=1 (DMA support implemented?), DMAC_ID_RX=11 (Index of DMA RX trigger), DMAC_ID_TX=12 (Index of DMA TX trigger), FIFO_IMPLEMENTED=1 (FIFO Rx/Tx implemented?), FIFO_SIZE=16 (Rx-Tx FIFO size in bytes), FSYNC_IMPLEMENTED=1 (SPI Frame Synch mode implemented?), GCLK_ID_CORE=24, GCLK_ID_SLOW=19, SPI=1 (SPI mode implemented?), TWIM=1 (TWI Master mode implemented?), TWIS=1 (TWI Slave mode implemented?), TWI_HSMODE=1 (TWI HighSpeed mode implemented?), ULTRA_IMPLEMENTATION=0 (ULTRA platform compatibility?), USART=1 (USART mode implemented?), USART_AUTOBAUD=1 (USART autobaud implemented?), USART_IRDA=1 (USART IrDA implemented?), USART_ISO7816=1 (USART ISO7816 mode implemented?), USART_LIN_MASTER=1 (USART LIN Master mode implemented?), USART_RS485=1 (USART RS485 mode implemented?), INSTANCE_ID=26 (Instance index for SERCOM3), MCLK_ID_APB=34 (Index for SERCOM3 APB clock), PAC_ID=26 (Index for SERCOM3 registers write protection), USART_ERROR_INT_SRC=76 (USART/SPI/I2C Error), USART_TX_READY_INT_SRC=78 (USART-SPI Data Register Empty/ I2C Stop Received), USART_TX_COMPLETE_INT_SRC=79 (USART-SPI Transmit Complete/ I2C Address Match), USART_RX_INT_SRC=80 (USART-SPI Receive Complete/ I2C Data Ready), SPI_TX_READY_INT_SRC=78 (USART-SPI Data Register Empty/ I2C Stop Received), SPI_TX_COMPLETE_INT_SRC=79 (USART-SPI Transmit Complete/ I2C Address Match), SPI_RX_INT_SRC=80 (USART-SPI Receive Complete/ I2C Data Ready), I2C_0_INT_SRC=76 (USART/SPI/I2C Error), I2C_1_INT_SRC=80 (USART-SPI Receive Complete/ I2C Data Ready), I2C_2_INT_SRC=81 (USART Receive Start/ SPI Slave Select Low/ I2C TX FIFO Empty), I2C_3_INT_SRC=82 (USART Clear To Send Input Change/ I2C RX FIFO Full)
SERCOM4 at 0x46004000 (SERCOM)
  pins: PAD0 PC21/D; PAD1 PC22/D; PAD2 PC23/D; PAD3 PC24/D
  parameters: CLK_REDUCTION=1 (Reduce clock options to pin 1 for SPI and USART), DMA=1 (DMA support implemented?), DMAC_ID_RX=13 (Index of DMA RX trigger), DMAC_ID_TX=14 (Index of DMA TX trigger), FIFO_IMPLEMENTED=1 (FIFO Rx/Tx implemented?), FIFO_SIZE=16 (Rx-Tx FIFO size in bytes), FSYNC_IMPLEMENTED=1 (SPI Frame Synch mode implemented?), GCLK_ID_CORE=25, GCLK_ID_SLOW=18, SPI=1 (SPI mode implemented?), TWIM=1 (TWI Master mode implemented?), TWIS=1 (TWI Slave mode implemented?), TWI_HSMODE=1 (TWI HighSpeed mode implemented?), ULTRA_IMPLEMENTATION=0 (ULTRA platform compatibility?), USART=1 (USART mode implemented?), USART_AUTOBAUD=1 (USART autobaud implemented?), USART_IRDA=1 (USART IrDA implemented?), USART_ISO7816=1 (USART ISO7816 mode implemented?), USART_LIN_MASTER=1 (USART LIN Master mode implemented?), USART_RS485=1 (USART RS485 mode implemented?), INSTANCE_ID=27 (Instance index for SERCOM4), MCLK_ID_APB=35 (Index for SERCOM4 APB clock), PAC_ID=27 (Index for SERCOM4 registers write protection), USART_ERROR_INT_SRC=83 (USART/SPI/I2C Error), USART_TX_READY_INT_SRC=85 (USART-SPI Data Register Empty/ I2C Stop Received), USART_TX_COMPLETE_INT_SRC=76 (USART-SPI Transmit Complete/ I2C Address Match), USART_RX_INT_SRC=87 (USART-SPI Receive Complete/ I2C Data Ready), SPI_TX_READY_INT_SRC=85 (USART-SPI Data Register Empty/ I2C Stop Received), SPI_TX_COMPLETE_INT_SRC=86 (USART-SPI Transmit Complete/ I2C Address Match), SPI_RX_INT_SRC=87 (USART-SPI Receive Complete/ I2C Data Ready), I2C_0_INT_SRC=83 (USART/SPI/I2C Error), I2C_1_INT_SRC=87 (USART-SPI Receive Complete/ I2C Data Ready), I2C_2_INT_SRC=88 (USART Receive Start/ SPI Slave Select Low/ I2C TX FIFO Empty), I2C_3_INT_SRC=89 (USART Clear To Send Input Change/ I2C RX FIFO Full)
SERCOM5 at 0x45804000 (SERCOM)
  pins: PAD0 PC25/D; PAD1 PC26/D; PAD2 PC27/D; PAD3 PC28/D
  parameters: CLK_REDUCTION=1 (Reduce clock options to pin 1 for SPI and USART), DMA=1 (DMA support implemented?), DMAC_ID_RX=15 (Index of DMA RX trigger), DMAC_ID_TX=16 (Index of DMA TX trigger), FIFO_IMPLEMENTED=1 (FIFO Rx/Tx implemented?), FIFO_SIZE=16 (Rx-Tx FIFO size in bytes), FSYNC_IMPLEMENTED=1 (SPI Frame Synch mode implemented?), GCLK_ID_CORE=26, GCLK_ID_SLOW=19, SPI=1 (SPI mode implemented?), TWIM=1 (TWI Master mode implemented?), TWIS=1 (TWI Slave mode implemented?), TWI_HSMODE=1 (TWI HighSpeed mode implemented?), ULTRA_IMPLEMENTATION=0 (ULTRA platform compatibility?), USART=1 (USART mode implemented?), USART_AUTOBAUD=1 (USART autobaud implemented?), USART_IRDA=1 (USART IrDA implemented?), USART_ISO7816=1 (USART ISO7816 mode implemented?), USART_LIN_MASTER=1 (USART LIN Master mode implemented?), USART_RS485=1 (USART RS485 mode implemented?), INSTANCE_ID=28 (Instance index for SERCOM5), MCLK_ID_APB=36 (Index for SERCOM5 APB clock), PAC_ID=28 (Index for SERCOM5 registers write protection), USART_ERROR_INT_SRC=90 (USART/SPI/I2C Error), USART_TX_READY_INT_SRC=92 (USART-SPI Data Register Empty/ I2C Stop Received), USART_TX_COMPLETE_INT_SRC=93 (USART-SPI Transmit Complete/ I2C Address Match), USART_RX_INT_SRC=94 (USART-SPI Receive Complete/ I2C Data Ready), SPI_TX_READY_INT_SRC=92 (USART-SPI Data Register Empty/ I2C Stop Received), SPI_TX_COMPLETE_INT_SRC=93 (USART-SPI Transmit Complete/ I2C Address Match), SPI_RX_INT_SRC=94 (USART-SPI Receive Complete/ I2C Data Ready), I2C_0_INT_SRC=90 (USART/SPI/I2C Error), I2C_1_INT_SRC=94 (USART-SPI Receive Complete/ I2C Data Ready), I2C_2_INT_SRC=95 (USART Receive Start/ SPI Slave Select Low/ I2C TX FIFO Empty), I2C_3_INT_SRC=96 (USART Clear To Send Input Change/ I2C RX FIFO Full)
SERCOM6 at 0x45806000 (SERCOM)
  pins: PAD0 PC30/D; PAD1 PC31/D; PAD2 PG00/D; PAD3 PG01/D
  parameters: CLK_REDUCTION=1 (Reduce clock options to pin 1 for SPI and USART), DMA=1 (DMA support implemented?), DMAC_ID_RX=17 (Index of DMA RX trigger), DMAC_ID_TX=18 (Index of DMA TX trigger), FIFO_IMPLEMENTED=1 (FIFO Rx/Tx implemented?), FIFO_SIZE=16 (Rx-Tx FIFO size in bytes), FSYNC_IMPLEMENTED=1 (SPI Frame Synch mode implemented?), GCLK_ID_CORE=27, GCLK_ID_SLOW=19, SPI=1 (SPI mode implemented?), TWIM=1 (TWI Master mode implemented?), TWIS=1 (TWI Slave mode implemented?), TWI_HSMODE=1 (TWI HighSpeed mode implemented?), ULTRA_IMPLEMENTATION=0 (ULTRA platform compatibility?), USART=1 (USART mode implemented?), USART_AUTOBAUD=1 (USART autobaud implemented?), USART_IRDA=1 (USART IrDA implemented?), USART_ISO7816=1 (USART ISO7816 mode implemented?), USART_LIN_MASTER=1 (USART LIN Master mode implemented?), USART_RS485=1 (USART RS485 mode implemented?), INSTANCE_ID=29 (Instance index for SERCOM6), MCLK_ID_APB=37 (Index for SERCOM6 APB clock), PAC_ID=29 (Index for SERCOM6 registers write protection), USART_ERROR_INT_SRC=97 (USART/SPI/I2C Error), USART_TX_READY_INT_SRC=99 (USART-SPI Data Register Empty/ I2C Stop Received), USART_TX_COMPLETE_INT_SRC=100 (USART-SPI Transmit Complete/ I2C Address Match), USART_RX_INT_SRC=101 (USART-SPI Receive Complete/ I2C Data Ready), SPI_TX_READY_INT_SRC=99 (USART-SPI Data Register Empty/ I2C Stop Received), SPI_TX_COMPLETE_INT_SRC=100 (USART-SPI Transmit Complete/ I2C Address Match), SPI_RX_INT_SRC=101 (USART-SPI Receive Complete/ I2C Data Ready), I2C_0_INT_SRC=97 (USART/SPI/I2C Error), I2C_1_INT_SRC=101 (USART-SPI Receive Complete/ I2C Data Ready), I2C_2_INT_SRC=102 (USART Receive Start/ SPI Slave Select Low/ I2C TX FIFO Empty), I2C_3_INT_SRC=103 (USART Clear To Send Input Change/ I2C RX FIFO Full)
SERCOM7 at 0x45000000 (SERCOM)
  pins: PAD0 PD14/D; PAD1 PD15/D; PAD2 PD16/D; PAD3 PD17/D
  parameters: CLK_REDUCTION=1 (Reduce clock options to pin 1 for SPI and USART), DMA=1 (DMA support implemented?), DMAC_ID_RX=19 (Index of DMA RX trigger), DMAC_ID_TX=20 (Index of DMA TX trigger), FIFO_IMPLEMENTED=1 (FIFO Rx/Tx implemented?), FIFO_SIZE=16 (Rx-Tx FIFO size in bytes), FSYNC_IMPLEMENTED=1 (SPI Frame Synch mode implemented?), GCLK_ID_CORE=28, GCLK_ID_SLOW=20, SPI=1 (SPI mode implemented?), TWIM=1 (TWI Master mode implemented?), TWIS=1 (TWI Slave mode implemented?), TWI_HSMODE=1 (TWI HighSpeed mode implemented?), ULTRA_IMPLEMENTATION=0 (ULTRA platform compatibility?), USART=1 (USART mode implemented?), USART_AUTOBAUD=1 (USART autobaud implemented?), USART_IRDA=1 (USART IrDA implemented?), USART_ISO7816=1 (USART ISO7816 mode implemented?), USART_LIN_MASTER=1 (USART LIN Master mode implemented?), USART_RS485=1 (USART RS485 mode implemented?), INSTANCE_ID=30 (Instance index for SERCOM7), MCLK_ID_APB=38 (Index for SERCOM7 APB clock), PAC_ID=30 (Index for SERCOM7 registers write protection), USART_ERROR_INT_SRC=104 (USART/SPI/I2C Error), USART_TX_READY_INT_SRC=106 (USART-SPI Data Register Empty/ I2C Stop Received), USART_TX_COMPLETE_INT_SRC=107 (USART-SPI Transmit Complete/ I2C Address Match), USART_RX_INT_SRC=108 (USART-SPI Receive Complete/ I2C Data Ready), SPI_TX_READY_INT_SRC=106 (USART-SPI Data Register Empty/ I2C Stop Received), SPI_TX_COMPLETE_INT_SRC=107 (USART-SPI Transmit Complete/ I2C Address Match), SPI_RX_INT_SRC=108 (USART-SPI Receive Complete/ I2C Data Ready), I2C_0_INT_SRC=104 (USART/SPI/I2C Error), I2C_1_INT_SRC=108 (USART-SPI Receive Complete/ I2C Data Ready), I2C_2_INT_SRC=109 (USART Receive Start/ SPI Slave Select Low/ I2C TX FIFO Empty), I2C_3_INT_SRC=110 (USART Clear To Send Input Change/ I2C RX FIFO Full)
SERCOM8 at 0x45002000 (SERCOM)
  pins: PAD0 PD24/D; PAD1 PD25/D; PAD2 PD26/D; PAD3 PD27/D
  parameters: CLK_REDUCTION=1 (Reduce clock options to pin 1 for SPI and USART), DMA=1 (DMA support implemented?), DMAC_ID_RX=21 (Index of DMA RX trigger), DMAC_ID_TX=22 (Index of DMA TX trigger), FIFO_IMPLEMENTED=1 (FIFO Rx/Tx implemented?), FIFO_SIZE=16 (Rx-Tx FIFO size in bytes), FSYNC_IMPLEMENTED=1 (SPI Frame Synch mode implemented?), GCLK_ID_CORE=29, GCLK_ID_SLOW=20, SPI=1 (SPI mode implemented?), TWIM=1 (TWI Master mode implemented?), TWIS=1 (TWI Slave mode implemented?), TWI_HSMODE=1 (TWI HighSpeed mode implemented?), ULTRA_IMPLEMENTATION=0 (ULTRA platform compatibility?), USART=1 (USART mode implemented?), USART_AUTOBAUD=1 (USART autobaud implemented?), USART_IRDA=1 (USART IrDA implemented?), USART_ISO7816=1 (USART ISO7816 mode implemented?), USART_LIN_MASTER=1 (USART LIN Master mode implemented?), USART_RS485=1 (USART RS485 mode implemented?), INSTANCE_ID=31 (Instance index for SERCOM8), MCLK_ID_APB=39 (Index for SERCOM8 APB clock), PAC_ID=31 (Index for SERCOM8 registers write protection), USART_ERROR_INT_SRC=111 (USART/SPI/I2C Error), USART_TX_READY_INT_SRC=113 (USART-SPI Data Register Empty/ I2C Stop Received), USART_TX_COMPLETE_INT_SRC=114 (USART-SPI Transmit Complete/ I2C Address Match), USART_RX_INT_SRC=115 (USART-SPI Receive Complete/ I2C Data Ready), SPI_TX_READY_INT_SRC=113 (USART-SPI Data Register Empty/ I2C Stop Received), SPI_TX_COMPLETE_INT_SRC=114 (USART-SPI Transmit Complete/ I2C Address Match), SPI_RX_INT_SRC=115 (USART-SPI Receive Complete/ I2C Data Ready), I2C_0_INT_SRC=111 (USART/SPI/I2C Error), I2C_1_INT_SRC=115 (USART-SPI Receive Complete/ I2C Data Ready), I2C_2_INT_SRC=116 (USART Receive Start/ SPI Slave Select Low/ I2C TX FIFO Empty), I2C_3_INT_SRC=117 (USART Clear To Send Input Change/ I2C RX FIFO Full)
SERCOM9 at 0x45004000 (SERCOM)
  pins: PAD0 PD28/D; PAD1 PD29/D; PAD2 PE04/D; PAD3 PE05/D
  parameters: CLK_REDUCTION=1 (Reduce clock options to pin 1 for SPI and USART), DMA=1 (DMA support implemented?), DMAC_ID_RX=23 (Index of DMA RX trigger), DMAC_ID_TX=24 (Index of DMA TX trigger), FIFO_IMPLEMENTED=1 (FIFO Rx/Tx implemented?), FIFO_SIZE=16 (Rx-Tx FIFO size in bytes), FSYNC_IMPLEMENTED=1 (SPI Frame Synch mode implemented?), GCLK_ID_CORE=30, GCLK_ID_SLOW=20, SPI=1 (SPI mode implemented?), TWIM=1 (TWI Master mode implemented?), TWIS=1 (TWI Slave mode implemented?), TWI_HSMODE=1 (TWI HighSpeed mode implemented?), ULTRA_IMPLEMENTATION=0 (ULTRA platform compatibility?), USART=1 (USART mode implemented?), USART_AUTOBAUD=1 (USART autobaud implemented?), USART_IRDA=1 (USART IrDA implemented?), USART_ISO7816=1 (USART ISO7816 mode implemented?), USART_LIN_MASTER=1 (USART LIN Master mode implemented?), USART_RS485=1 (USART RS485 mode implemented?), INSTANCE_ID=32 (Instance index for SERCOM9), MCLK_ID_APB=40 (Index for SERCOM9 APB clock), PAC_ID=32 (Index for SERCOM9 registers write protection), USART_ERROR_INT_SRC=118 (USART/SPI/I2C Error), USART_TX_READY_INT_SRC=120 (USART-SPI Data Register Empty/ I2C Stop Received), USART_TX_COMPLETE_INT_SRC=121 (USART-SPI Transmit Complete/ I2C Address Match), USART_RX_INT_SRC=122 (USART-SPI Receive Complete/ I2C Data Ready), SPI_TX_READY_INT_SRC=120 (USART-SPI Data Register Empty/ I2C Stop Received), SPI_TX_COMPLETE_INT_SRC=121 (USART-SPI Transmit Complete/ I2C Address Match), SPI_RX_INT_SRC=122 (USART-SPI Receive Complete/ I2C Data Ready), I2C_0_INT_SRC=118 (USART/SPI/I2C Error), I2C_1_INT_SRC=122 (USART-SPI Receive Complete/ I2C Data Ready), I2C_2_INT_SRC=123 (USART Receive Start/ SPI Slave Select Low/ I2C TX FIFO Empty), I2C_3_INT_SRC=124 (USART Clear To Send Input Change/ I2C RX FIFO Full)
SPI_IXS0 at 0x46030000 (SPI_IXS)
  pins: FSYNC PC00/J set 1 or PD02/J set 2; SCK PC01/J set 1 or PD04/J set 2; SDI PC02/J set 1 or PD03/J set 2; SDO PC03/J set 1 or PD05/J set 2; MCLK PC04/J or PD06/J
  parameters: DMAC_ID_RX=79, DMAC_ID_TX=80, GCLK_ID=44 (Index of Generic Clock), TPD_MASTER=0 (Indicates a master or slave number for TPD mode( 1=master,0=slave)), INSTANCE_ID=46 (Instance index for SPI_IXS0), MCLK_ID_APB=54 (Index for SPI_IXS0 APB clock), PAC_ID=46 (Index for SPI_IXS0 registers write protection)
SPI_IXS1 at 0x45030000 (SPI_IXS)
  pins: FSYNC PA30/J; SCK PE01/J; SDI PE02/J; SDO PE00/J; MCLK PA31/J
  parameters: DMAC_ID_RX=81, DMAC_ID_TX=82, GCLK_ID=45 (Index of Generic Clock), TPD_MASTER=0 (Indicates a master or slave number for TPD mode( 1=master,0=slave)), INSTANCE_ID=47 (Instance index for SPI_IXS1), MCLK_ID_APB=55 (Index for SPI_IXS1 APB clock), PAC_ID=47 (Index for SPI_IXS1 registers write protection)
SQI0 at 0x4F008000 (SQI)
  pins: CLK PC08/H; CS0 PC13/H; CS1 PC15/H; DATA0 PC09/H; DATA1 PC10/H; DATA2 PC11/H; DATA3 PC12/H
  parameters: CBUF_DEPTH=3, GCLK_ID=56 (Index of Generic Clock), SFR_ADDRESS=0x4f008000, TRXBUF_DEPTH=8, XIP_ADDRESS=0x80, XIP_CS_MSB=1, XIP_HSEL=0, INSTANCE_ID=57 (Instance index for SQI0), MCLK_ID_AHB=66 (Index for SQI0 AHB clock), PAC_ID=57 (Index for SQI0 registers write protection)
SQI1 at 0x4F009000 (SQI)
  pins: CLK PC30/H; CS0 PG03/H; CS1 PC28/H; DATA0 PC31/H; DATA1 PG00/H; DATA2 PG01/H; DATA3 PG02/H
  parameters: CBUF_DEPTH=3, GCLK_ID=57 (Index of Generic Clock), SFR_ADDRESS=0x4f009000, TRXBUF_DEPTH=8, XIP_ADDRESS=0x90, XIP_CS_MSB=1, XIP_HSEL=0, INSTANCE_ID=58 (Instance index for SQI1), MCLK_ID_AHB=67 (Index for SQI1 AHB clock), PAC_ID=58 (Index for SQI1 registers write protection)
SUPC at 0x44020000
  parameters: ADDVREG_NUM=3 (Number of additional capless regulators for USB, PLL, ...), ADDVREG_PLL_NUM=1 (Number of additional capless regulators dedicated to PLL(s) (between 0 and ADDVREG_NUM)), ADDVREG_PLL_START_INDEX=2 (Index of the first additional capless regulator dedicated to a PLL within [ADDVREG_NUM-1:0] range. Must be equal to 1 if ADDVREG_PLL_NUM=0.), BKOUT_NUM=2 (Number of BKOUT output pin), BORVDDUSB_NUM=2 (Number of BOR_USB), CHRG_PUMP_NUM=3 (Number of Charge Pump), IOB_IMPLEMENTED=0 (one if IOB feature is implemented), USER_LDO_IMPLEMENTED=0 (one if USER_LDO feature is implemented), VBAT_IMPLEMENTED=0 (one if VBAT feature (battery backup feature) is implemented.), VREGSW_NUM=4 (Number of main voltage regulator (100mA). Example: 1 for Unicorn, 4 for Riverside.), INSTANCE_ID=4 (Instance index for SUPC), MCLK_ID_APB=7 (Index for SUPC APB clock), PAC_ID=4 (Index for SUPC registers write protection)
SysTick at 0xE000E010
SystemControl at 0xE000E000
TCC0 at 0x45010000 (TCC)
  pins: WO{n} PC{n:02}/F (n=0..7)
  parameters: CC_NUM=8 (Number of Compare/Capture units), DITHERING=1 (Dithering feature implemented), DMAC_ID_MC_{n}={n+26} (Indexes of DMA Match/Compare triggers {n}) (n=0..7), DMAC_ID_OVF=25 (DMA overflow/underflow/retrigger trigger), DTI=1 (Dead-Time-Insertion feature implemented), GCLK_ID=31 (Index of Generic Clock), MASTER_SLAVE_MODE=0 (TCC type 0 : NA, 1 : Master, 2 : Slave), OTMX=1 (Output Matrix feature implemented), OW_NUM=8 (Number of Output Waveforms), PG=1 (Pattern Generation feature implemented), SIZE=32, SWAP=1 (DTI outputs swap feature implemented), INSTANCE_ID=33 (Instance index for TCC0), MCLK_ID_APB=41 (Index for TCC0 APB clock), PAC_ID=33 (Index for TCC0 registers write protection)
TCC1 at 0x45012000 (TCC)
  pins: WO{n} PB{n+10}/F (n=0..7)
  parameters: CC_NUM=8 (Number of Compare/Capture units), DITHERING=1 (Dithering feature implemented), DMAC_ID_MC_{n}={n+35} (Indexes of DMA Match/Compare triggers {n}) (n=0..7), DMAC_ID_OVF=34 (DMA overflow/underflow/retrigger trigger), DTI=1 (Dead-Time-Insertion feature implemented), GCLK_ID=32 (Index of Generic Clock), MASTER_SLAVE_MODE=0 (TCC type 0 : NA, 1 : Master, 2 : Slave), OTMX=1 (Output Matrix feature implemented), OW_NUM=8 (Number of Output Waveforms), PG=1 (Pattern Generation feature implemented), SIZE=32, SWAP=1 (DTI outputs swap feature implemented), INSTANCE_ID=34 (Instance index for TCC1), MCLK_ID_APB=42 (Index for TCC1 APB clock), PAC_ID=34 (Index for TCC1 registers write protection)
TCC2 at 0x45014000 (TCC)
  pins: WO0 PD10/F set 1 or PD26/F set 2; WO1 PD11/F set 1 or PD27/F set 2; WO2 PD12/F set 1 or PD28/F set 2; WO3 PA04/F set 1 or PD29/F set 2; WO4 PA03/F set 1 or PE04/F set 2; WO5 PA02/F set 1 or PE05/F set 2
  parameters: CC_NUM=6 (Number of Compare/Capture units), DITHERING=1 (Dithering feature implemented), DMAC_ID_MC_{n}={n+44} (Indexes of DMA Match/Compare triggers {n}) (n=0..5), DMAC_ID_OVF=43 (DMA overflow/underflow/retrigger trigger), DTI=1 (Dead-Time-Insertion feature implemented), GCLK_ID=33 (Index of Generic Clock), MASTER_SLAVE_MODE=0 (TCC type 0 : NA, 1 : Master, 2 : Slave), OTMX=1 (Output Matrix feature implemented), OW_NUM=6 (Number of Output Waveforms), PG=1 (Pattern Generation feature implemented), SIZE=32, SWAP=1 (DTI outputs swap feature implemented), INSTANCE_ID=35 (Instance index for TCC2), MCLK_ID_APB=43 (Index for TCC2 APB clock), PAC_ID=35 (Index for TCC2 registers write protection)
TCC3 at 0x45810000 (TCC)
  pins: WO0 PA05/F; WO1 PA06/F
  parameters: CC_NUM=2 (Number of Compare/Capture units), DITHERING=1 (Dithering feature implemented), DMAC_ID_MC_0=51 (Indexes of DMA Match/Compare triggers 0), DMAC_ID_MC_1=52 (Indexes of DMA Match/Compare triggers 1), DMAC_ID_OVF=50 (DMA overflow/underflow/retrigger trigger), DTI=1 (Dead-Time-Insertion feature implemented), GCLK_ID=34 (Index of Generic Clock), MASTER_SLAVE_MODE=0 (TCC type 0 : NA, 1 : Master, 2 : Slave), OTMX=1 (Output Matrix feature implemented), OW_NUM=2 (Number of Output Waveforms), PG=1 (Pattern Generation feature implemented), SIZE=32, SWAP=1 (DTI outputs swap feature implemented), INSTANCE_ID=36 (Instance index for TCC3), MCLK_ID_APB=44 (Index for TCC3 APB clock), PAC_ID=36 (Index for TCC3 registers write protection)
TCC4 at 0x45812000 (TCC)
  pins: WO0 PC12/F set 1 or PC29/F set 2; WO1 PC13/F set 1 or PD13/F set 2
  parameters: CC_NUM=2 (Number of Compare/Capture units), DITHERING=1 (Dithering feature implemented), DMAC_ID_MC_0=54 (Indexes of DMA Match/Compare triggers 0), DMAC_ID_MC_1=55 (Indexes of DMA Match/Compare triggers 1), DMAC_ID_OVF=53 (DMA overflow/underflow/retrigger trigger), DTI=1 (Dead-Time-Insertion feature implemented), GCLK_ID=35 (Index of Generic Clock), MASTER_SLAVE_MODE=0 (TCC type 0 : NA, 1 : Master, 2 : Slave), OTMX=1 (Output Matrix feature implemented), OW_NUM=2 (Number of Output Waveforms), PG=1 (Pattern Generation feature implemented), SIZE=32, SWAP=1 (DTI outputs swap feature implemented), INSTANCE_ID=37 (Instance index for TCC4), MCLK_ID_APB=45 (Index for TCC4 APB clock), PAC_ID=37 (Index for TCC4 registers write protection)
TCC5 at 0x46010000 (TCC)
  pins: WO0 PC08/F set 1 or PC23/F set 2; WO1 PC09/F set 1 or PC24/F set 2
  parameters: CC_NUM=2 (Number of Compare/Capture units), DITHERING=1 (Dithering feature implemented), DMAC_ID_MC_0=57 (Indexes of DMA Match/Compare triggers 0), DMAC_ID_MC_1=58 (Indexes of DMA Match/Compare triggers 1), DMAC_ID_OVF=56 (DMA overflow/underflow/retrigger trigger), DTI=1 (Dead-Time-Insertion feature implemented), GCLK_ID=36 (Index of Generic Clock), MASTER_SLAVE_MODE=0 (TCC type 0 : NA, 1 : Master, 2 : Slave), OTMX=1 (Output Matrix feature implemented), OW_NUM=2 (Number of Output Waveforms), PG=1 (Pattern Generation feature implemented), SIZE=32, SWAP=1 (DTI outputs swap feature implemented), INSTANCE_ID=38 (Instance index for TCC5), MCLK_ID_APB=46 (Index for TCC5 APB clock), PAC_ID=38 (Index for TCC5 registers write protection)
TCC6 at 0x46012000 (TCC)
  pins: WO0 PC10/F set 1 or PC21/F set 2; WO1 PC11/F set 1 or PC22/F set 2
  parameters: CC_NUM=2 (Number of Compare/Capture units), DITHERING=1 (Dithering feature implemented), DMAC_ID_MC_0=60 (Indexes of DMA Match/Compare triggers 0), DMAC_ID_MC_1=61 (Indexes of DMA Match/Compare triggers 1), DMAC_ID_OVF=59 (DMA overflow/underflow/retrigger trigger), DTI=1 (Dead-Time-Insertion feature implemented), GCLK_ID=37 (Index of Generic Clock), MASTER_SLAVE_MODE=0 (TCC type 0 : NA, 1 : Master, 2 : Slave), OTMX=0 (Output Matrix feature implemented), OW_NUM=2 (Number of Output Waveforms), PG=0 (Pattern Generation feature implemented), SIZE=32, SWAP=1 (DTI outputs swap feature implemented), INSTANCE_ID=39 (Instance index for TCC6), MCLK_ID_APB=47 (Index for TCC6 APB clock), PAC_ID=39 (Index for TCC6 registers write protection)
TCC7 at 0x46810000 (TCC)
  pins: WO0 PA22/F set 1 or PD08/F set 2; WO1 PA23/F set 1 or PD07/F set 2
  parameters: CC_NUM=2 (Number of Compare/Capture units), DITHERING=1 (Dithering feature implemented), DMAC_ID_MC_0=63 (Indexes of DMA Match/Compare triggers 0), DMAC_ID_MC_1=64 (Indexes of DMA Match/Compare triggers 1), DMAC_ID_OVF=62 (DMA overflow/underflow/retrigger trigger), DTI=1 (Dead-Time-Insertion feature implemented), GCLK_ID=38 (Index of Generic Clock), MASTER_SLAVE_MODE=0 (TCC type 0 : NA, 1 : Master, 2 : Slave), OTMX=0 (Output Matrix feature implemented), OW_NUM=2 (Number of Output Waveforms), PG=0 (Pattern Generation feature implemented), SIZE=32, SWAP=1 (DTI outputs swap feature implemented), INSTANCE_ID=40 (Instance index for TCC7), MCLK_ID_APB=48 (Index for TCC7 APB clock), PAC_ID=40 (Index for TCC7 registers write protection)
TCC8 at 0x46812000 (TCC)
  pins: WO0 PA21/F set 1 or PC14/F set 2; WO1 PC15/F set 1 or PD23/F set 2
  parameters: CC_NUM=2 (Number of Compare/Capture units), DITHERING=1 (Dithering feature implemented), DMAC_ID_MC_0=66 (Indexes of DMA Match/Compare triggers 0), DMAC_ID_MC_1=67 (Indexes of DMA Match/Compare triggers 1), DMAC_ID_OVF=65 (DMA overflow/underflow/retrigger trigger), DTI=1 (Dead-Time-Insertion feature implemented), GCLK_ID=39 (Index of Generic Clock), MASTER_SLAVE_MODE=0 (TCC type 0 : NA, 1 : Master, 2 : Slave), OTMX=0 (Output Matrix feature implemented), OW_NUM=2 (Number of Output Waveforms), PG=0 (Pattern Generation feature implemented), SIZE=32, SWAP=1 (DTI outputs swap feature implemented), INSTANCE_ID=41 (Instance index for TCC8), MCLK_ID_APB=49 (Index for TCC8 APB clock), PAC_ID=41 (Index for TCC8 registers write protection)
TCC9 at 0x46814000 (TCC)
  pins: WO0 PD04/F set 1 or PG05/F set 2; WO1 PD05/F set 1 or PG06/F set 2; WO2 PD06/F set 1 or PG07/F set 2; WO3 PD03/F set 1 or PG09/F set 2; WO4 PD02/F set 1 or PG10/F set 2; WO5 PC20/F set 1 or PG11/F set 2
  parameters: CC_NUM=6 (Number of Compare/Capture units), DITHERING=1 (Dithering feature implemented), DMAC_ID_MC_{n}={n+69} (Indexes of DMA Match/Compare triggers {n}) (n=0..5), DMAC_ID_OVF=68 (DMA overflow/underflow/retrigger trigger), DTI=1 (Dead-Time-Insertion feature implemented), GCLK_ID=40 (Index of Generic Clock), MASTER_SLAVE_MODE=0 (TCC type 0 : NA, 1 : Master, 2 : Slave), OTMX=1 (Output Matrix feature implemented), OW_NUM=6 (Number of Output Waveforms), PG=1 (Pattern Generation feature implemented), SIZE=32, SWAP=1 (DTI outputs swap feature implemented), INSTANCE_ID=42 (Instance index for TCC9), MCLK_ID_APB=50 (Index for TCC9 APB clock), PAC_ID=42 (Index for TCC9 registers write protection)
TPI at 0xE0040000
TRAM at 0x44824000
  parameters: ADDR_MSB=10 (Value of the MSB bit of physical RAM address), INSTANCE_ID=17 (Instance index for TRAM), MCLK_ID_APB=21 (Index for TRAM APB clock), PAC_ID=17 (Index for TRAM registers write protection)
TRNG at 0x44870000
  parameters: INSTANCE_ID=59 (Instance index for TRNG), MCLK_ID_APB=68 (Index for TRNG APB clock), PAC_ID=59 (Index for TRNG registers write protection)
USBHS0 at 0x4F010000 (USBHS)
  pins: USB0ID USBID0; USB0PN USBDM0; USB0PP USBDP0; USBRBIAS USBRBIAS0; VBUS VBUS0
  parameters: MCLK_ID_AHB=73 (Index for USBHS0 AHB clock)
USBHS1 at 0x4F012000 (USBHS)
  pins: USB0ID USBID1; USB0PN USBDM1; USB0PP USBDP1; USBRBIAS USBRBIAS1; VBUS VBUS1
  parameters: MCLK_ID_AHB=74 (Index for USBHS1 AHB clock)
WDT at 0x44070000
  parameters: FUSES_UPDATE_SUPPORT=0 (WDT Fuse Update Support), INSTANCE_ID=11 (Instance index for WDT), MCLK_ID_APB=14 (Index for WDT APB clock), PAC_ID=11 (Index for WDT registers write protection)

## Interrupts
-15 Reset — Reset Vector, invoked on Power up and warm reset
-14 NonMaskableInt — Non maskable Interrupt, cannot be stopped or preempted
-13 HardFault — Hard Fault, all classes of Fault
-12 MemoryManagement — Memory Management, MPU mismatch, including Access Violation and No Match
-11 BusFault — Bus Fault, Pre-Fetch-, Memory Access Fault, other address/memory related Fault
-10 UsageFault — Usage Fault, i.e. Undef Instruction, Illegal State Transition
-5 SVCall — System Service Call via SVC instruction
-4 DebugMonitor
-2 PendSV — Pendable request for system service
-1 SysTick — System Tick Timer
0 FCW — Flash Write Controller Interrupt
1 FCR_ECCERR (FCR) — Flash Read Controller ECC Error
2 FCR_CRC_FAULT (FCR) — Flash Read Controller CRC Fault
3 PM — Power Manager
4 SUPC — Supply Controller
5 OSCCTRL_FAIL (OSCCTRL) — External Oscillator Fail
6 OSCCTRL_XOSCRDY (OSCCTRL) — External Oscillator Ready
7 OSCCTRL_DFLLRDY (OSCCTRL) — DFLL Ready
8 OSCCTRL_OTHER (OSCCTRL) — DFLL Other Interrupt
9 OSCCTRL_LOCK (OSCCTRL) — PLL Lock
10 OSC32KCTRL_FAIL (OSC32KCTRL) — 32K Oscillator Fail
11 OSC32KCTRL_RDY (OSC32KCTRL) — 32K Oscillator Ready
12 MCLK — Main Clock
13 FREQM — Frequency Meter
14 WDT — Watchdog Timer
15 RTC_TAMPER (RTC)
16 RTC_OVF (RTC) — RTC Overflow
17 RTC_PERIOD (RTC)
18 RTC_COMPARE (RTC)
{n+19} EIC_EXTINT_{n} (EIC) (n=0..15) — External Interrupt {n}
35 PAC — Peripheral Access Controller
36 DRMTCM — TCM RAM ECC Interrupt
37 MCRAMC — Multi-Channel RAM Controller
38 TRAM — Trust RAM Interrupt
39 DMA_PRI3 (DMA) — DMA Priority 3 Interrupt
40 DMA_PRI2 (DMA) — DMA Priority 2 Interrupt
41 DMA_PRI1 (DMA) — DMA Priority 1 Interrupt
42 DMA_PRI0 (DMA) — DMA Priority 0 Interrupt
43 EVSYS_0 (EVSYS) — Event System InterruptChannel 0
{n+43} EVSYS_{n} (EVSYS) (n=1..11) — Event System Channel {n}
{7n+55} SERCOM{n}_6 (SERCOM{n}) (n=0..9) — USART/SPI/I2C Error
{7n+56} SERCOM{n}_5 (SERCOM{n}) (n=0..9) — USART Receive Break
{7n+57} SERCOM{n}_0 (SERCOM{n}) (n=0..9) — USART-SPI Data Register Empty/ I2C Stop Received
{7n+58} SERCOM{n}_1 (SERCOM{n}) (n=0..9) — USART-SPI Transmit Complete/ I2C Address Match
{7n+59} SERCOM{n}_2 (SERCOM{n}) (n=0..9) — USART-SPI Receive Complete/ I2C Data Ready
{7n+60} SERCOM{n}_3 (SERCOM{n}) (n=0..9) — USART Receive Start/ SPI Slave Select Low/ I2C TX FIFO Empty
{7n+61} SERCOM{n}_4 (SERCOM{n}) (n=0..9) — USART Clear To Send Input Change/ I2C RX FIFO Full
125 TCC0_OTHER (TCC0) — Error/Overflow/Underflow/Fault Interrupt
126 TCC0_CNT_TRIG (TCC0) — Counter/Re-Trigger Interrupt
{n+127} TCC0_MC{n} (TCC0) (n=0..7) — TCC Match/Compare {n}
135 TCC1_OTHER (TCC1) — Error/Overflow/Underflow/Fault Interrupt
136 TCC1_CNT_TRIG (TCC1) — Counter/Re-Trigger Interrupt
{n+137} TCC1_MC{n} (TCC1) (n=0..7) — TCC Match/Compare {n}
145 TCC2_OTHER (TCC2) — Error/Overflow/Underflow/Fault Interrupt
146 TCC2_CNT_TRIG (TCC2) — Counter/Re-Trigger Interrupt
147 TCC2_MC0 (TCC2) — TCC Match/Compare 0
148 TCC2_MC1 (TCC2) — TCC Match/Compare 1
149 TCC2_MC2 (TCC2) — TCC Match/Compare 2
150 TCC2_MC3 (TCC2) — TCC Match/Compare 3
151 TCC2_MC4 (TCC2) — TCC Match/Compare 4
152 TCC2_MC5 (TCC2) — TCC Match/Compare 5
153 TCC3_OTHER (TCC3) — Error/Overflow/Underflow/Fault Interrupt
154 TCC3_CNT_TRIG (TCC3) — Counter/Re-Trigger Interrupt
155 TCC3_MC0 (TCC3) — TCC Match/Compare 0
156 TCC3_MC1 (TCC3) — TCC Match/Compare 1
157 TCC4_OTHER (TCC4) — Error/Overflow/Underflow/Fault Interrupt
158 TCC4_CNT_TRIG (TCC4) — Counter/Re-Trigger Interrupt
159 TCC4_MC0 (TCC4) — TCC Match/Compare 0
160 TCC4_MC1 (TCC4) — TCC Match/Compare 1
161 TCC5_OTHER (TCC5) — Error/Overflow/Underflow/Fault Interrupt
162 TCC5_CNT_TRIG (TCC5) — Counter/Re-Trigger Interrupt
163 TCC5_MC0 (TCC5) — TCC Match/Compare 0
164 TCC5_MC1 (TCC5) — TCC Match/Compare 1
165 TCC6_OTHER (TCC6) — Error/Overflow/Underflow/Fault Interrupt
166 TCC6_CNT_TRIG (TCC6) — Counter/Re-Trigger Interrupt
167 TCC6_MC0 (TCC6) — TCC Match/Compare 0
168 TCC6_MC1 (TCC6) — TCC Match/Compare 1
169 TCC7_OTHER (TCC7) — Error/Overflow/Underflow/Fault Interrupt
170 TCC7_CNT_TRIG (TCC7) — Counter/Re-Trigger Interrupt
171 TCC7_MC0 (TCC7) — TCC Match/Compare 0
172 TCC7_MC1 (TCC7) — TCC Match/Compare 1
173 TCC8_OTHER (TCC8) — Error/Overflow/Underflow/Fault Interrupt
174 TCC8_CNT_TRIG (TCC8) — Counter/Re-Trigger Interrupt
175 TCC8_MC0 (TCC8) — TCC Match/Compare 0
176 TCC8_MC1 (TCC8) — TCC Match/Compare 1
177 TCC9_OTHER (TCC9) — Error/Overflow/Underflow/Fault Interrupt
178 TCC9_CNT_TRIG (TCC9) — Counter/Re-Trigger Interrupt
179 TCC9_MC0 (TCC9) — TCC Match/Compare 0
180 TCC9_MC1 (TCC9) — TCC Match/Compare 1
181 TCC9_MC2 (TCC9) — TCC Match/Compare 2
182 TCC9_MC3 (TCC9) — TCC Match/Compare 3
183 TCC9_MC4 (TCC9) — TCC Match/Compare 4
184 TCC9_MC5 (TCC9) — TCC Match/Compare 5
185 ADC_GLOBAL (ADC) — ADC Global Interrupt
186 ADC_CORE1 (ADC) — ADC Core 1 Interrupt
187 ADC_CORE2 (ADC) — ADC Core 2 Interrupt
188 ADC_CORE3 (ADC) — ADC Core 3 Interrupt
189 ADC_CORE4 (ADC) — ADC Core 4 Interrupt
190 AC — Analog Comparator Interrupt
191 PTC — Peripheral Touch Controller
192 SPI_IXS0 — Audio SPI Interrupt 0
193 SPI_IXS1 — Audio SPI Interrupt 1
194 CAN0 — Controller Area Network 0
195 CAN1 — Controller Area Network 1
196 CAN2 — Controller Area Network 2
197 CAN3 — Controller Area Network 3
198 CAN4 — Controller Area Network 4
199 CAN5 — Controller Area Network 5
202 ETH_PRI_Q_0 (ETH) — Ethernet MAC Interrupt
203 ETH_PRI_Q_1 (ETH) — Ethernet MAC Queue 1 Interrupt
204 ETH_PRI_Q_2 (ETH) — Ethernet MAC Queue 2 Interrupt
205 ETH_PRI_Q_3 (ETH) — Ethernet MAC Queue 3 Interrupt
206 ETH_PRI_Q_4 (ETH) — Ethernet MAC Queue 4 Interrupt
207 ETH_PRI_Q_5 (ETH) — Ethernet MAC Queue 5 Interrupt
208 SQI0 — Quad SPI Interrupt 0
209 SQI1 — Quad SPI Interrupt 1
210 TRNG — True Random Generator
211 SDMMC0 — SD/MMC Host Controller Interrupt 0
212 SDMMC1 — SD/MMC Host Controller Interrupt 1
213 USBHS0 — High Speed USB Interrupt 0
214 USBHS1 — High Speed USB Interrupt 1
215 HSM_TAMPER (HSM) — Hardware Security Module Tamper Interrupt
216 HSM_TXINT (HSM) — Hardware Security Module Transmit Interrupt
217 HSM_RXINT (HSM) — Hardware Security Module Receive Interrupt
218 MLB_GENERAL (MLB) — Media Local Bus General Interrupt
219 MLB_BUSREQ (MLB) — Media Local Bus Request Interrupt
220 CM7H_CTIIRQ_0 (CM7H) — Cross Trigger Interface Interrupt 0
221 CM7H_CTIIRQ_1 (CM7H) — Cross Trigger Interface Interrupt 1

## Event generators
1 SUPC_LVDET, 2 OSCCTRL_XOSC_FAIL, 3 OSC32KCTRL_XOSC32K_FAIL, 4 FREQM_DONE, 5 FREQM_WINMON, {n+6} RTC_PER_{n} (n=0..7), {n+14} RTC_CMP_{n} (n=0..3), 18 RTC_TAMPER, 19 RTC_OVF, 20 RTC_PERD, {n+21} EIC_EXTINT_{n} (n=0..15), 37 PAC_ACCERR, {n+38} DMA_CH_{n} (n=0..15), {11n+54} TCC{n}_OVF (n=0..2), {11n+55} TCC{n}_TRG (n=0..2), {11n+56} TCC{n}_CNT (n=0..2), {11n+57} TCC{n}_MC_0 (n=0..2), {11n+58} TCC{n}_MC_1 (n=0..2), {11n+59} TCC{n}_MC_2 (n=0..2), {11n+60} TCC{n}_MC_3 (n=0..2), {11n+61} TCC{n}_MC_4 (n=0..2), {11n+62} TCC{n}_MC_5 (n=0..2), 63 TCC0_MC_6, 64 TCC0_MC_7, 74 TCC1_MC_6, 75 TCC1_MC_7, {5n+70} TCC{n}_OVF (n=3..9), {5n+71} TCC{n}_TRG (n=3..9), {5n+72} TCC{n}_CNT (n=3..9), {5n+73} TCC{n}_MC_0 (n=3..9), {5n+74} TCC{n}_MC_1 (n=3..9), 120 TCC9_MC_2, 121 TCC9_MC_3, 122 TCC9_MC_4, 123 TCC9_MC_5, {n+124} ADC_CHRDYC_{n} (n=0..3), {n+128} ADC_CMP_{n} (n=0..3), 132 AC_COMP_0, 133 AC_COMP_1, 134 AC_WIN_0, 135 PTC_EOC, 136 PTC_WCOMP, 137 ETH_TSU_CMP, 138 TRNG_READY

## Event users
0 FREQM_START, 1 RTC_TAMPER, {n+2} PORT_EV_{n} (n=0..3), {n+6} DMA_CHSTRT_{n} (n=0..15), {n+22} DMA_CHAUX_{n} (n=0..15), {10n+38} TCC{n}_EV_0 (n=0..2), {10n+39} TCC{n}_EV_1 (n=0..2), {10n+40} TCC{n}_MC_0 (n=0..2), {10n+41} TCC{n}_MC_1 (n=0..2), {10n+42} TCC{n}_MC_2 (n=0..2), {10n+43} TCC{n}_MC_3 (n=0..2), {10n+44} TCC{n}_MC_4 (n=0..2), {10n+45} TCC{n}_MC_5 (n=0..2), 46 TCC0_MC_6, 47 TCC0_MC_7, 56 TCC1_MC_6, 57 TCC1_MC_7, {4n+54} TCC{n}_EV_0 (n=3..9), {4n+55} TCC{n}_EV_1 (n=3..9), {4n+56} TCC{n}_MC_0 (n=3..9), {4n+57} TCC{n}_MC_1 (n=3..9), 94 TCC9_MC_2, 95 TCC9_MC_3, 96 TCC9_MC_4, 97 TCC9_MC_5, {n+98} ADC_TRIGGERS_{n} (n=0..10), 109 AC_SOC_0, 110 AC_SOC_1, 111 PTC_DSEQR, 112 PTC_STCONV, {n+113} HSM_TAMPER_{n} (n=0..3)

## Properties
SIGNATURES: DSU_DID=0x19218053

## Pinouts (pin number, pad)
PIC32CZCA2088MX: A2 PD10, A3 PD08, A4 PD06, A5 PD19, A6 PD04, A7 PD16, A8 PD27, A9 PD03, A10 PD14, A11 PD01, A12 PD00, A13 VSS, A14 D1+, A15 USBRBIAS0, A16 VSS, A17 USBID0, B1 PD12, B2 PD11, B3 PD09, B4 PD20, B5 PD05, B6 PD18, B7 PD17, B8 PD28, B9 PD26, B10 PD02, B11 PD13, B12 USBRBIAS1, B13 VUSB3V3_1, B14 D1-, B15 VBUS0, B16 VUSB3V3_0, B17 D0+, B18 D0-, C1 PA02, C2 PA01, C17 PC19, C18 PC18, D1 PA04, D2 PA03, D5 PD25, D6 PD21, D7 VDDREG, D8 PD15, D9 PD29, D10 PD23, D11 PD24, D12 USBID1, D13 VDDREG, D14 PC20, D17 PC17, D18 RESET, E1 PA06, E2 PA05, E4 PA00, E15 VSS, E17 PC14, E18 PC29, F1 PA21, F2 PA30, F4 PE04, F7 PD07, F12 VBUS1, F15 VDDIO, F17 PC13, F18 PC12, G1 PA23, G2 PA31, G4 PA22, G6 PE05, G7 VDDIO, G8 VSS, G9 VDDIO, G10 VDDIO, G11 PG11, G12 PC15, G13 PG10, G15 PC27, G17 PG03, G18 PC28, H1 PE00, H2 PE01, H4 PE06, H7 VDDIO, H8 VSS, H9 VDDIO, H10 VSS, H11 VDDIO, H12 VSS, H15 PC11, H17 PC10, H18 PG02, J1 PE02, J2 PE07, J4 PE08, J7 VSS, J8 VSS, J9 VDDIO, J10 VSS, J11 VDDIO, J12 VSS, J15 PG01, J17 PG05, J18 PG00, K1 PA07, K2 PA08, K4 PE09, K7 VDDIO, K8 VSS, K9 VSS, K10 VDDIO, K11 VSS, K12 PG09, K15 PC30, K17 PC25, K18 PC26, L1 PA09, L2 PA10, L4 PE10, L7 VDDIO, L8 VSS, L9 VSS, L10 VDDIO, L11 VSS, L12 PG07, L15 PG06, L17 PG08, L18 PC31, M1 PA24, M2 PA25, M4 PE03, M6 PE11, M7 PB00, M8 VDDIO, M9 VSS, M10 VDDIO, M11 PF07, M12 PF08, M13 PC08, M15 PC23, M17 PC24, M18 PC09, N1 PA26, N2 PA27, N4 PA19, N7 PB01, N12 PB17, N15 PC05, N17 PC06, N18 PC07, P1 PA11, P2 PA12, P4 PA20, P15 PC00, P17 PC21, P18 PC22, R1 PA13, R2 PA14, R5 PB02, R6 AVSS, R7 AVDD, R8 PF01, R9 PF02, R10 PF06, R11 PB26, R12 VDDREG, R13 PB12, R14 PG04, R17 PC03, R18 PC04, T1 PA28, T2 PA29, T17 PC01, T18 PC02, U1 PA15, U2 PA16, U3 PA18, U4 PB03, U5 PB19, U6 PB04, U7 PF00, U8 PB23, U9 PB08, U10 PF04, U11 PB28, U12 PB09, U13 PB29, U14 PB30, U15 PB24, U16 PB13, U17 PB15, U18 PB16, V2 PB18, V3 PA17, V4 PB20, V5 PB05, V6 PB21, V7 PB06, V8 PB22, V9 PB07, V10 PB27, V11 PF03, V12 PF05, V13 PB10, V14 PB11, V15 PB31, V16 PB25, V17 PB14
