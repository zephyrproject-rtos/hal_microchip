# PIC32CZ4010CA91208 device description
Architecture: CORTEX-M7; Family: PIC32C; Series: PIC32CZCA91
Parameters: GCLK_ID_TRACE=63 (Index of Generic Clock), NUM_IRQ=222 (Number of Interrupt Requests), __CM7_REV=0x0101 (Cortex-M7 Revision), __DCACHE_PRESENT=1 (DCACHE present or not), __DEBUG_LVL=1 (Debug Level), __DTCM_PRESENT=1 (DTCM present or not), __ETM_LVL=1 (Extended Trace Level), __FPU_DP=1 (FPU double-precision or not), __FPU_PRESENT=1 (FPU present or not), __ICACHE_PRESENT=1 (ICACHE present or not), __ITCM_PRESENT=1 (ITCM present or not), __MPU_PRESENT=1 (MPU present or not), __MPU_REGIONS=8 (Number of MPU regions), __NVIC_PRIO_BITS=3 (Number of NVIC Priority bits), __TRACE_LVL=1 (Trace Level), __VTOR_PRESENT=1 (VTOR present or not), __Vendor_SysTickConfig=0 (Set to 1 if different SysTick Config is used), POWER_DOMAIN=PD_CORE_SW, __ARCH_ARM=1, __ARCH_ARM_CORTEX_M=1
Programming and debug interfaces: JTAG, SWD
Registers are 32-bit, read-write, reset 0x0 unless marked. A register's access mark holds for its fields unless they carry their own. Offsets are from the block's base; lines under a group give offsets from that group; [hi:lo] are bit positions; {n}, {i} and the like mark numbered series; 'fields as' and 'values as' point back to an identical list; <NAME> marks a mode.

## Ordering variants
PIC32CZ4010CA91208-I/8MX: BGA208, pinout PIC32CZCA2088MX, up to 300 MHz, -40 to 85 C, 1.66 to 3.66 V
PIC32CZ4010CA91208-V/8MX: BGA208, pinout PIC32CZCA2088MX, up to 300 MHz, -40 to 105 C, 1.66 to 3.66 V
PIC32CZ4010CA91208-E/8MX: BGA208, pinout PIC32CZCA2088MX, up to 200 MHz, -40 to 125 C, 1.66 to 3.66 V

## Memory
base space: start 0 size 0x100000000, little endian
  0x00000000 ITCM size 0x20000 ram, rw, executable
  0x4000000 PRM_ROM size 0x8000 rom, ro, executable
  0x8000000 FCR_BFM size 0x20000 flash, rw, executable, page 4096
  0xA000000 FCR_CFM_USERCFG1 size 0x1000 flash, rw, page 4096
  0xA001000 FCR_CFM_USEROTP1 size 0x1000 user_signatures, rw, page 4096
  0xA002000 FCR_CFM_BOOTCFG1 size 0x1000 flash, rw, page 4096
  0xA004000 FCR_CFM_DALCFG size 0x1000 flash, rw, page 4096
  0xA007000 FCR_CFM_CALOTP size 0x1000 other, ro, page 4096
  0xA008000 FCR_CFM_USERCFG2 size 0x1000 flash, rw, page 4096
  0xA009000 FCR_CFM_USEROTP2 size 0x1000 user_signatures, rw, page 4096
  0xA00A000 FCR_CFM_BOOTCFG2 size 0x1000 flash, rw, page 4096
  0x0A00C000 FCR_CFM_HSMCFG0 size 0x1000 flash, rw, page 4096
  0x0A00D000 FCR_CFM_HSMCFG1 size 0x1000 flash, rw, page 4096
  0x0A00E000 FCR_CFM_HSMCFG2 size 0x1000 flash, rw, page 4096
  0x0A00F000 FCR_CFM_HSMCFG3 size 0x1000 flash, rw, page 4096
  0xC000000 FCR_PFM size 0x400000 flash, rw, executable, page 4096
  0x20000000 DTCM size 0x20000 ram, rw, executable
  0x20020000 FLEXRAM size 0x100000 ram, rw, executable
  0x44000000 APBA size 0x800000 io, rw
  0x44800000 APBB size 0x800000 io, rw
  0x45000000 APBC size 0x800000 io, rw
  0x45800000 APBD size 0x800000 io, rw
  0x46000000 APBE size 0x800000 io, rw
  0x46800000 APBF size 0x800000 io, rw
  0x4F008000 SQI0_SFR size 0x1000 io, rw
  0x4F009000 SQI1_SFR size 0x1000 io, rw
  0x4F010000 USBHS0_SFR size 0x2000 io, rw
  0x4F012000 USBHS1_SFR size 0x2000 io, rw
  0x4F018000 HSM_SFR size 0x400 io, rw
  0x60000000 EBI_CS0 size 0x01000000 ram, rw, executable, external
  0x61000000 EBI_CS1 size 0x01000000 ram, rw, executable, external
  0x62000000 EBI_CS2 size 0x01000000 ram, rw, executable, external
  0x63000000 EBI_CS3 size 0x01000000 ram, rw, executable, external
  0x80000000 SQI0_XIP size 0x10000000 ram, rw, executable, external
  0x90000000 SQI1_XIP size 0x10000000 ram, rw, executable, external
  0xE0000000 PPB size 0x20000000 io, rw
  0xE00FE000 CM7H_ROM_TABLE size 0x100 rom, ro, executable

## Peripheral instances (address, pins/pin function, parameters)
AC at 0x46822000
  pins: AIN0 PB01/B; AIN1 PB00/B; AIN2 PA20/B; AIN3 PA19/B; CMP0 PC07/B; CMP1 PC06/B
  parameters: ATEST_IMPLEMENTED=1 (Defines if the ATEST register is implemented), ATEST_SIZE=2 (Defines the number of effective bits in ATEST register), DACVALUE_BIT=7 (Defines the number of bits in DACCTRLn.VALUE), GCLK_ID=42 (Index of Generic Clock), IO_INPUTS=4 (Defines the number of AC pair inputs connected to IO pins), PAIRS=1 (Defines the number of AC pairs), INSTANCE_ID=44 (Instance index for AC), MCLK_ID_APB=52 (Index for AC APB clock), PAC_ID=44 (Index for AC registers write protection), NUM_CMP=2 (Number of comparators), LOAD_CALIB=0 (Defines if calibration is required)
ADC0 at 0x46820000 (ADC)
  pins: AIN0 PB03/B; AIN1 PB02/B; AIN2 PB01/B; AIN3 PB00/B; AIN4 PA20/B; AIN5 PA19/B; AIN6 PB18/B; AIN7 PB19/B; AIN8 PB20/B; AIN9 PE03/B; AIN10 PE06/B; AIN11 PE07/B; AIN12 PE08/B; AIN13 PE09/B; AIN14 PE10/B; AIN15 PE11/B
  parameters: APB_FIFO_DEPTH=16 (Number of Words in APB FIFO), CHNSAR_NMBR1=16 (Number of Channels on SARCORE number 1), CHNSAR_NMBR2=7 (Number of Channels on SARCORE number 2), CHNSAR_NMBR3=7 (Number of Channels on SARCORE number 3), CHNSAR_NMBR4=7 (Number of Channels on SARCORE number 4), DCMP_NMBR=4 (Number of Digital Comparators Max=4), DMAC_ID_PFFRDY=75, EARLY_INTR_PRESENT=1 (Early Interrupts Present), FLTR_NMBR=4 (Number of Digital Filters, Max=0), GCLK_ID=41 (Index of Generic Clock), OCP_ADDR_WIDTH=16 (OCP Address Width), OCP_FIFO_DEPTH=16 (Number of Words in OCP DMA FIFO), OCP_PORT_PRESENT=0 (OCP DMA Bus Master Present), SARCORE_NMBR=4 (Number of SARCOREs. Max=4, Min-1), TRGS_NMBR=16 (Number of Trigger Sources, Max=16), VREF_STARTUP_TIME=50 (Number of Control Clock cycles for VREF to stabalize), INSTANCE_ID=43 (Instance index for ADC), MCLK_ID_APB=51 (Index for ADC APB clock), PAC_ID=43 (Index for ADC registers write protection)
ADC1 at 0x46820000 (ADC)
  pins: AIN0 PA18/B; AIN1 PA17/B; AIN2 PA16/B; AIN3 PA15/B; AIN4 PA29/B; AIN5 PA28/B
  parameters: APB_FIFO_DEPTH=16 (Number of Words in APB FIFO), CHNSAR_NMBR1=16 (Number of Channels on SARCORE number 1), CHNSAR_NMBR2=7 (Number of Channels on SARCORE number 2), CHNSAR_NMBR3=7 (Number of Channels on SARCORE number 3), CHNSAR_NMBR4=7 (Number of Channels on SARCORE number 4), DCMP_NMBR=4 (Number of Digital Comparators Max=4), DMAC_ID_PFFRDY=75, EARLY_INTR_PRESENT=1 (Early Interrupts Present), FLTR_NMBR=4 (Number of Digital Filters, Max=0), GCLK_ID=41 (Index of Generic Clock), OCP_ADDR_WIDTH=16 (OCP Address Width), OCP_FIFO_DEPTH=16 (Number of Words in OCP DMA FIFO), OCP_PORT_PRESENT=0 (OCP DMA Bus Master Present), SARCORE_NMBR=4 (Number of SARCOREs. Max=4, Min-1), TRGS_NMBR=16 (Number of Trigger Sources, Max=16), VREF_STARTUP_TIME=50 (Number of Control Clock cycles for VREF to stabalize), INSTANCE_ID=43 (Instance index for ADC), MCLK_ID_APB=51 (Index for ADC APB clock), PAC_ID=43 (Index for ADC registers write protection)
ADC2 at 0x46820000 (ADC)
  pins: AIN0 PA14/B; AIN1 PA13/B; AIN2 PA12/B; AIN3 PA11/B; AIN4 PA27/B; AIN5 PA26/B
  parameters: APB_FIFO_DEPTH=16 (Number of Words in APB FIFO), CHNSAR_NMBR1=16 (Number of Channels on SARCORE number 1), CHNSAR_NMBR2=7 (Number of Channels on SARCORE number 2), CHNSAR_NMBR3=7 (Number of Channels on SARCORE number 3), CHNSAR_NMBR4=7 (Number of Channels on SARCORE number 4), DCMP_NMBR=4 (Number of Digital Comparators Max=4), DMAC_ID_PFFRDY=75, EARLY_INTR_PRESENT=1 (Early Interrupts Present), FLTR_NMBR=4 (Number of Digital Filters, Max=0), GCLK_ID=41 (Index of Generic Clock), OCP_ADDR_WIDTH=16 (OCP Address Width), OCP_FIFO_DEPTH=16 (Number of Words in OCP DMA FIFO), OCP_PORT_PRESENT=0 (OCP DMA Bus Master Present), SARCORE_NMBR=4 (Number of SARCOREs. Max=4, Min-1), TRGS_NMBR=16 (Number of Trigger Sources, Max=16), VREF_STARTUP_TIME=50 (Number of Control Clock cycles for VREF to stabalize), INSTANCE_ID=43 (Instance index for ADC), MCLK_ID_APB=51 (Index for ADC APB clock), PAC_ID=43 (Index for ADC registers write protection)
ADC3 at 0x46820000 (ADC)
  pins: AIN0 PA10/B; AIN1 PA09/B; AIN2 PA08/B; AIN3 PA07/B; AIN4 PA25/B; AIN5 PA24/B
  parameters: APB_FIFO_DEPTH=16 (Number of Words in APB FIFO), CHNSAR_NMBR1=16 (Number of Channels on SARCORE number 1), CHNSAR_NMBR2=7 (Number of Channels on SARCORE number 2), CHNSAR_NMBR3=7 (Number of Channels on SARCORE number 3), CHNSAR_NMBR4=7 (Number of Channels on SARCORE number 4), DCMP_NMBR=4 (Number of Digital Comparators Max=4), DMAC_ID_PFFRDY=75, EARLY_INTR_PRESENT=1 (Early Interrupts Present), FLTR_NMBR=4 (Number of Digital Filters, Max=0), GCLK_ID=41 (Index of Generic Clock), OCP_ADDR_WIDTH=16 (OCP Address Width), OCP_FIFO_DEPTH=16 (Number of Words in OCP DMA FIFO), OCP_PORT_PRESENT=0 (OCP DMA Bus Master Present), SARCORE_NMBR=4 (Number of SARCOREs. Max=4, Min-1), TRGS_NMBR=16 (Number of Trigger Sources, Max=16), VREF_STARTUP_TIME=50 (Number of Control Clock cycles for VREF to stabalize), INSTANCE_ID=43 (Instance index for ADC), MCLK_ID_APB=51 (Index for ADC APB clock), PAC_ID=43 (Index for ADC registers write protection)
BSDAP
  pins: TCK_SWCLK PC20/G set 1; TDI PC17/G set 1; TDO PC19/G set 1; TMS_SWDIO PC18/G set 1
  parameters: MCLK_ID_DAP=80 (Index for BSDAP DAP clock)
CAN0 at 0x45060000 (CAN)
  pins: RX PC04/H set 1 or PC19/H set 2; TX PC05/H set 1 or PC20/H set 2
  parameters: DMAC_ID_DEBUG=83 (DMA CAN Debug Req), ECC_BERR_IMPLEMENTED=0 (ECC error), EXT_TSTAMP_IMPLEMENTED=0 (External time stamp), GCLK_ID=46 (Index of Generic Clock), MSG_RAM_ADDR=0x20 (8-bits MSB), RXD_SYNC_METHOD=0 (RXD Synchronization Method), INSTANCE_ID=48 (Instance index for CAN0), MCLK_ID_AHB=56 (Index for CAN0 AHB clock), PAC_ID=48 (Index for CAN0 registers write protection)
CAN1 at 0x46060000 (CAN)
  pins: RX PC06/H set 1 or PD08/H set 2; TX PC07/H set 1 or PD09/H set 2
  parameters: DMAC_ID_DEBUG=84 (DMA CAN Debug Req), ECC_BERR_IMPLEMENTED=0 (ECC error), EXT_TSTAMP_IMPLEMENTED=0 (External time stamp), GCLK_ID=47 (Index of Generic Clock), MSG_RAM_ADDR=0x20 (8-bits MSB), RXD_SYNC_METHOD=0 (RXD Synchronization Method), INSTANCE_ID=49 (Instance index for CAN1), MCLK_ID_AHB=57 (Index for CAN1 AHB clock), PAC_ID=49 (Index for CAN1 registers write protection)
CAN2 at 0x46062000 (CAN)
  pins: RX PC25/H; TX PC26/H
  parameters: DMAC_ID_DEBUG=85 (DMA CAN Debug Req), ECC_BERR_IMPLEMENTED=0 (ECC error), EXT_TSTAMP_IMPLEMENTED=0 (External time stamp), GCLK_ID=48 (Index of Generic Clock), MSG_RAM_ADDR=0x20 (8-bits MSB), RXD_SYNC_METHOD=0 (RXD Synchronization Method), INSTANCE_ID=50 (Instance index for CAN2), MCLK_ID_AHB=58 (Index for CAN2 AHB clock), PAC_ID=50 (Index for CAN2 registers write protection)
CAN3 at 0x45860000 (CAN)
  pins: RX PC29/H; TX PD13/H
  parameters: DMAC_ID_DEBUG=86 (DMA CAN Debug Req), ECC_BERR_IMPLEMENTED=0 (ECC error), EXT_TSTAMP_IMPLEMENTED=0 (External time stamp), GCLK_ID=49 (Index of Generic Clock), MSG_RAM_ADDR=0x20 (8-bits MSB), RXD_SYNC_METHOD=0 (RXD Synchronization Method), INSTANCE_ID=51 (Instance index for CAN3), MCLK_ID_AHB=59 (Index for CAN3 AHB clock), PAC_ID=51 (Index for CAN3 registers write protection)
CAN4 at 0x45062000 (CAN)
  pins: RX PA30/H; TX PA31/H
  parameters: DMAC_ID_DEBUG=87 (DMA CAN Debug Req), ECC_BERR_IMPLEMENTED=0 (ECC error), EXT_TSTAMP_IMPLEMENTED=0 (External time stamp), GCLK_ID=50 (Index of Generic Clock), MSG_RAM_ADDR=0x20 (8-bits MSB), RXD_SYNC_METHOD=0 (RXD Synchronization Method), INSTANCE_ID=52 (Instance index for CAN4), MCLK_ID_AHB=60 (Index for CAN4 AHB clock), PAC_ID=52 (Index for CAN4 registers write protection)
CAN5 at 0x46860000 (CAN)
  pins: RX PD23/H; TX PA21/H
  parameters: DMAC_ID_DEBUG=88 (DMA CAN Debug Req), ECC_BERR_IMPLEMENTED=0 (ECC error), EXT_TSTAMP_IMPLEMENTED=0 (External time stamp), GCLK_ID=51 (Index of Generic Clock), MSG_RAM_ADDR=0x20 (8-bits MSB), RXD_SYNC_METHOD=0 (RXD Synchronization Method), INSTANCE_ID=53 (Instance index for CAN5), MCLK_ID_AHB=61 (Index for CAN5 AHB clock), PAC_ID=53 (Index for CAN5 registers write protection)
CoreDebug at 0xE000ED00
DMA at 0x44850000
  parameters: DMAC_ID_EVSYS=1 (Events trigger index), DMAC_ID_SWTRG=0 (Software trigger index), INSTANCE_ID=19 (Instance index for DMA), MCLK_ID_APB=25 (Index for DMA APB clock), MCLK_ID_AXI=24 (Index for DMA AXI clock), PAC_ID=19 (Index for DMA registers write protection)
DRMTCM at 0x44820000
  parameters: DPTRMSB=5, DTCMADDR_MSB=16, DTCMPAR=7, IPTRMSB=6, ITCMADDR_MSB=16, ITCMPAR=8, NO_ECC=0, INSTANCE_ID=15 (Instance index for DRMTCM), MCLK_ID_APB=19 (Index for DRMTCM APB clock), PAC_ID=15 (Index for DRMTCM registers write protection)
DSU at 0x44000000
  pins: PMSA0 PA14/dsu_pmsa0; PMSA1 PA12/dsu_pmsa0; PMSA2 PA11/dsu_pmsa0; PMSA3 PA09/dsu_pmsa0; PMSA4 PA07/dsu_pmsa0; PMSA5 PA06/dsu_pmsa0; PMSA6 PA04/dsu_pmsa0; PMSA7 PA02/dsu_pmsa0
  parameters: BMX_ERROR_SUPPORT=1 (Defines whether DSU APB errors are reported as 2-cycles bus errors to the AHB AP0 master), DAL1_IMPLEMENTED=0 (Debug Access Level 1 (Non-Secure) Implemented? for TZ devices only), DMAC_ID_DCC0=2 (DMAC ID for DCC0 register), DMAC_ID_DCC1=3 (DMAC ID for DCC1 register), INSTANCE_ID=0 (Instance index for DSU), MCLK_ID_AHB=0 (Index for DSU AHB clock), MCLK_ID_APB=1 (Index for DSU APB clock), PAC_ID=0 (Index for DSU registers write protection)
DWT at 0xE0001000
EBI at 0x458B0000
  pins: A1 PC20/E; A2 PC19/E; A3 PC18/E; A4 PC17/E; A5 PC15/E; A6 PC14/E; A7 PC29/E; A8 PC13/E; A9 PC12/E; A10 PC28/E; A11 PG03/E; A12 PC27/E; A13 PC11/E; A14 PC10/E; A15 PG02/E; A16 PG01/E; A17 PG00/E; A18 PC26/E; A19 PC31/E; A20 PC30/E; A21 PC25/E; A22 PC09/E; A23 PC24/E; D0 PD13/E; D1 PD23/E; D2 PD14/E; D3 PD02/E; D4 PD15/E; D5 PD03/E; D6 PD16/E; D7 PD17/E; D8 PD04/E; D9 PD18/E; D10 PD19/E; D11 PD05/E; D12 PD06/E; D13 PD20/E; D14 PD21/E; D15 PD07/E; NBS0_A0 PC23/E; NBS1_NWR1 PC06/E; A PC20/E; NCS0 PC08/E; NCS1 PC07/E; NCS2 PC22/E; NCS3 PC21/E; NRD PC05/E; NWAIT PD08/E; NWE_NWR0 PC04/E or PG04/E
  parameters: ACTIVE_BS=0 (NBS signal porlarity), ACTIVE_CS=0 (NCS signal polarity), ACTIVE_RD=0 (NRD signal polarity), ACTIVE_WR=0 (NWR signal polarity), DATA_PATH_NBR_XOR_LAYERS=2 (Number of XOR layers in datapath), DIFF_CHIP_ID=0x554E (2 ASCII characters to differentiate chips (0x554E <--> "UN")), EMC_DELAY_REGISTER=0 (Electro Magnetic Compatibility control registers embedded ?), EX_WAIT=0 (External Wait signal polarity), MEM_ADDR_SIZE=22 (Memory Interface size (aligned 32 bits)), NB_CS=4 (Number of Chip Select), NB_PAD_NOE=16 (Number of Pad Control), OCMS_INTERFACE=0 (Off Chip Memory Scrambling implemented ?), OVERLOADED=1 (Overloaded Mode implemented ?), MCLK_ID_AHB=75 (Index for EBI AHB clock), MCLK_ID_APB=76 (Index for EBI APB clock)
EIC at 0x44800000
  pins: EXTINT0 PA00/A or PA16/A or PB00/A or PB16/A or PC00/A or PD00/A or PD15/A or PE00/A or PG00/A; EXTINT1 PA01/A or PA17/A or PB01/A or PB17/A or PC01/A or PC02/A or PC17/A or PD01/A or PD16/A or PE01/A or PF00/A or PF01/A or PG01/A; EXTINT2 PA02/A or PA18/A or PB02/A or PB18/A or PC18/A or PD02/A or PD17/A or PE02/A or PF02/A or PG02/A; EXTINT3 PA03/A or PA19/A or PB03/A or PB19/A or PC03/A or PC19/A or PD03/A or PD18/A or PE03/A or PF03/A or PG03/A; EXTINT4 PA04/A or PA05/A or PA20/A or PB04/A or PB20/A or PC04/A or PD04/A or PD19/A or PE04/A or PF04/A or PG04/A; EXTINT5 PA21/A or PB05/A or PB21/A or PC05/A or PC21/A or PD05/A or PD20/A or PE05/A or PF05/A or PG05/A; EXTINT6 PA06/A or PA22/A or PB06/A or PB22/A or PC06/A or PC22/A or PD06/A or PD21/A or PE06/A or PF06/A or PG06/A; EXTINT7 PA07/A or PA23/A or PB07/A or PB23/A or PC07/A or PC23/A or PD07/A or PD23/A or PE07/A or PF07/A or PG07/A; EXTINT8 PA08/A or PA24/A or PB08/A or PB24/A or PC08/A or PC24/A or PD08/A or PD24/A or PE08/A or PF08/A or PG08/A; EXTINT9 PA09/A or PA25/A or PB09/A or PB25/A or PC09/A or PC25/A or PD09/A or PD25/A or PE09/A or PG09/A; EXTINT10 PA10/A or PA26/A or PB10/A or PB26/A or PC10/A or PC26/A or PD10/A or PD26/A or PE10/A or PG10/A; EXTINT11 PA11/A or PA27/A or PB11/A or PB27/A or PC11/A or PC27/A or PD11/A or PD27/A or PE11/A or PG11/A; EXTINT12 PA12/A or PA28/A or PB12/A or PB28/A or PC12/A or PC28/A or PD12/A or PD28/A; EXTINT13 PA13/A or PA29/A or PB13/A or PB29/A or PC13/A or PC29/A or PD29/A; EXTINT14 PA14/A or PA30/A or PB14/A or PB30/A or PC14/A or PC30/A or PD13/A; EXTINT15 PA15/A or PA31/A or PB15/A or PB31/A or PC15/A or PC31/A or PD14/A; NMI PC20/A
  parameters: EXTINT_NUM=16 (Number of external interrupts), GCLK_ID=5 (Generic Clock index), NUMBER_OF_CONFIG_REGS=2 (Number of CONFIG registers), NUMBER_OF_INTERRUPTS=16 (Number of external interrupts (obsolete)), SECURE_IMPLEMENTED=0 (Security Configuration implemented?), INSTANCE_ID=13 (Instance index for EIC), MCLK_ID_APB=16 (Index for EIC APB clock), PAC_ID=13 (Index for EIC registers write protection)
ETH at 0x45070000
  pins: GCOL PD08/K; GCRS PD09/K; GTXCK PD05/L; GMDC PA03/K; GMDIO PA04/K; GREFCK PD12/K or PD12/L; GRX0 PD11/K; GRX1 PD10/K; GRX2 PD07/K; GRX3 PD06/K; GRX4 PD20/K; GRX5 PD21/K; GRX6 PD19/K; GRX7 PD18/K; GRXDV PA05/K; GRXER PA06/K; TSUCOMP PA22/K or PC05/K or PC17/K; GTX0 PA01/K; GTX1 PA00/K; GTX2 PD04/K; GTX3 PD03/K; GTX4 PD17/K; GTX5 PD16/K; GTX6 PD15/K; GTX7 PD14/K; GTXEN PA02/K; GTXER PD02/K; TXCK PA21/K or PD05/K
  parameters: GCLK_ID_TSU=55 (1588 External Clock), GCLK_ID_TX=54 (GIGE/Loopback clock), MEM_MARGINADJ_MSB=9 (Number of Memory Margin Adjust bits), NUM_INT=6 (Number of Interrupts), INSTANCE_ID=56 (Instance index for ETH), MCLK_ID_AXI=64 (Index for ETH AXI clock), MCLK_ID_APB=65 (Index for ETH APB clock), PAC_ID=56 (Index for ETH registers write protection)
ETM at 0xE0041000
EVSYS at 0x44860000
  parameters: ASYNCHRONOUS_CHANNELS=0xFFFFF000 (Mask of Only Asynchronous Channels), CHANNELS=32 (Total Number of Channels), CHANNELS_BITS=5 (Number of bits to select Channel), GCLK_ID_{n}={n+6} (Index of Generic Clocks for Synchronous Channels {n}) (n=0..11), GENERATORS=138 (Total Number of Event Generators), GENERATORS_BITS=8 (Number of bits to select Event Generator), SECURE_IMPLEMENTED=0 (Security Configuration implemented?), SPLIT_IRQ_NUM=12 (Number of channels with dedicated interrupt line request), SYNCH_NUM=12 (Number of Synchronous Channels), SYNCH_NUM_BITS=4 (Number of bits to select Synchronous Channels), USERS=117 (Total Number of Event Users), USERS_BITS=7 (Number of bits to select Event User), USERS_GROUPS=4 (Number of 32-user Groups), INSTANCE_ID=22 (Instance index for EVSYS), MCLK_ID_APB=30 (Index for EVSYS APB clock), PAC_ID=22 (Index for EVSYS registers write protection)
FCR at 0x44004000
  parameters: BFM_PNL_ADDR_MSB=15 (Flash Memory Parameters), BFM_SYS_ADDR_MSB=16 (Flash Memory Parameters), CFM_ADDR_BASE=0x07000000 (Flash Read Controller Parameters), CFM_PNL_ADDR_MSB=14 (Flash Memory Parameters), CFM_SYS_ADDR_MSB=15 (Flash Memory Parameters), FCR_AHB_PORTS_NB=4 (Flash Read Controller Parameters), FCR_BFM_ADDR_BASE=0x06000000 (Flash Read Controller Parameters), FCR_CAL_ADDR=6000000 (Flash Read Controller Parameters), FCR_CAL_NUM_READS=4 (Flash Read Controller Parameters), FCR_CRC_PRESENT=1 (Flash Read Controller Parameters), FCR_DAL_ADDR=1 (Flash Read Controller Parameters), FCR_ECC_PRESENT=1 (Flash Read Controller Parameters), FCR_FFF_ADDR=1 (Flash Read Controller Parameters), FCR_FLT_PRESENT=0 (Flash Read Controller Parameters), FCR_FUSES_DATA_CYCLES=4 (Flash Read Controller Parameters), FCR_FUSES_READY_CYCLES=1 (Flash Read Controller Parameters), FCR_F1RR_ADDR=1 (Flash Read Controller Parameters), FCR_F2RR_ADDR=1 (Flash Read Controller Parameters), FCR_HDATA_SIZE=64 (Flash Read Controller Parameters), FCR_HSM_CFG0_BASE=64 (Flash Read Controller Parameters), FCR_HSM_CFG1_BASE=64 (Flash Read Controller Parameters), FCR_HSM_CFG2_BASE=64 (Flash Read Controller Parameters), FCR_HSM_CFG3_BASE=64 (Flash Read Controller Parameters), FCR_HSM_PRESENT=1 (Flash Read Controller Parameters), FCR_NOT_FFF_VALUE=0xA5A5A5A5 (Flash Read Controller Parameters), FCR_NO_ECC_BUS_ERROR=0 (Flash Read Controller Parameters), FCR_OTPLOCK_ADDR=0 (Flash Read Controller Parameters), FCR_PADDR_MSB=15 (Flash Read Controller Parameters), FCR_PERIOD_MIN=75 (Flash Read Controller Parameters), FCR_PERIOD_NOM=116 (Flash Read Controller Parameters), FCR_PFM_ADDR_BASE=0x08000000 (Flash Read Controller Parameters), FCR_RR_NUM_READS=1 (Flash Read Controller Parameters), FCR_TCALH_NS=10000 (Flash Read Controller Parameters), FUSES_DATA_MSB=127 (Flash Read Controller Parameters), FUSES_RDY_MSB=8 (Flash Read Controller Parameters), NVR_NUM_PAGES=24 (Flash Memory Parameters), PFM_ACC_HT_NS=30 (Flash Read Controller Parameters), PFM_ACC_NS=25 (Flash Read Controller Parameters), PFM_ACC_RECALL_NS=70 (Flash Read Controller Parameters), PFM_DATA_MSB=255 (Flash Memory Parameters), PFM_NUM_PANELS=2 (Flash Memory Parameters), PFM_NUM_RR=8 (Flash Memory Parameters), PFM_PAGE_ADDR_MSB=11 (Flash Memory Parameters), PFM_PNL_ADDR_MSB=21 (Flash Memory Parameters), PFM_PNL_DATA_MSB=271 (Flash Memory Parameters), PFM_ROW_ADDR_MSB=9 (Flash Memory Parameters), PFM_SRHT_PRESENT=1 (Flash Read Controller Parameters), PFM_SYS_ADDR_MSB=22 (Flash Memory Parameters), PFM_TDPDH_NS=5000 (Flash Read Controller Parameters), PFM_TDPDS_NS=100 (Flash Read Controller Parameters), PFM_TLKCFG_NS=1000 (Flash Read Controller Parameters), PFM_TMH_NS=100 (Flash Read Controller Parameters), PFM_TMS_NS=5000 (Flash Read Controller Parameters), PFM_TONWAIT_NS=6000 (Flash Read Controller Parameters), PFM_TRHR_NS=1000 (Flash Read Controller Parameters), PFM_TRT_NS=500 (Flash Read Controller Parameters), INSTANCE_ID=2 (Instance index for FCR), MCLK_ID_AHB=4 (Index for FCR AHB clock), MCLK_ID_APB=5 (Index for FCR APB clock), PAC_ID=2 (Index for FCR registers write protection)
FCW at 0x44002000
  parameters: BFM_PNL_ADDR_MSB=15 (Flash Memory Parameters), BFM_SYS_ADDR_MSB=16 (Flash Memory Parameters), CFM_PNL_ADDR_MSB=14 (Flash Memory Parameters), CFM_SYS_ADDR_MSB=15 (Flash Memory Parameters), FCW_BFM_ADDR_BASE=0x06000000 (Flash System Address (byte addresses)), FCW_CFM_ADDR_BASE=0x07000000 (Flash System Address (byte addresses)), FCW_CPUS_PRESENT=3 (Flash System Address (byte addresses)), FCW_DAL0_VALUE=0x81 (Flash System Address (byte addresses)), FCW_DAL1_VALUE=0x99 (Flash System Address (byte addresses)), FCW_DAL2_VALUE=0xDB (Flash System Address (byte addresses)), FCW_HSM_PRESENT=1 (Flash System Address (byte addresses)), FCW_PADDR_MSB=10 (Flash System Address (byte addresses)), FCW_PERIOD_MIN=75 (Flash System Address (byte addresses)), FCW_PERIOD_NOM=116 (Flash System Address (byte addresses)), FCW_PFM_ADDR_BASE=0x08000000 (Flash System Address (byte addresses)), PFM_NUM_PAGES=1024 (No of PFM Pages Per panel), PFM_NUM_RR=8 (Flash Memory Parameters), PFM_PAGE_ADDR_MSB=11 (Flash Page Size MSB), PFM_PAGE_SIZE=4096, PFM_PNL_ADDR_MSB=21 (Single flash panel read address MSbit (using byte addressing)), PFM_PNL_DATA_MSB=271 (Flash Memory Parameters), PFM_ROW_ADDR_MSB=9 (Flash Memory Parameters), PFM_SIZE=10 (Flash Memory Parameters), PFM_SYS_ADDR_MSB=22 (The MS bit of the system byte address needed to address the entire PFM region (both panels Main)), FLASH_SIZE=4194304, PAGES=1024, PAGES_PR_REGION=64, INSTANCE_ID=1 (Instance index for FCW), MCLK_ID_AHB=2 (Index for FCW AHB clock), MCLK_ID_APB=3 (Index for FCW APB clock), PAC_ID=1 (Index for FCW registers write protection)
FPB at 0xE0002000
  parameters: __BKPT_NUM=8 (Number of FPB breakpoint comparators)
FPU at 0xE000EF30
  parameters: __FPU_DP=1 (FPU double precision or not)
FREQM at 0x44060000
  parameters: GCLK_ID_MSR=3 (Index of measure generic clock), GCLK_ID_REF=4 (Index of reference generic clock), MSRCLK_NB=2 (Number of measured clock sources), INSTANCE_ID=10 (Instance index for FREQM), MCLK_ID_APB=13 (Index for FREQM APB clock), PAC_ID=10 (Index for FREQM registers write protection)
FUSES at FUSES_BOOTCFG1 0x0A002000, FUSES_BOOTCFG2 0x0A00A000 (FUSES_BOOTCFG1), FUSES_CALOTP 0x0A007000, FUSES_DALCFG 0x0A004000, FUSES_USERCFG1 0x0A000000, FUSES_USERCFG2 0x0A008000 (FUSES_USERCFG1)
GCLK at 0x44050000
  pins: IO0 PC20/M; IO1 PC19/M; IO2 PD00/M; IO3 PD01/M; IO4 PC00/M or PD18/M; IO5 PC01/M or PD19/M; IO6 PC02/M or PD20/M; IO7 PC03/M or PD21/M
  parameters: GEN_BITS=4, GEN_NUM=16 (Number of Generic Clock Generators), GEN_NUM_MSB=15 (Number of Generic Clock Generators - 1), GEN_SOURCE_NUM_MSB=13 (Number of Generic Clock Sources - 1), IO_NUM=8 (Number of Generic Clock I/Os), NUM=64 (Number of Generic Clock Users), SOURCE_BITS=4, SOURCE_NUM=14 (Number of Generic Clock Sources), INSTANCE_ID=8 (Instance index for GCLK), MCLK_ID_APB=11 (Index for GCLK APB clock), PAC_ID=8 (Index for GCLK registers write protection)
HSM at 0x4F018000
  parameters: g_ClkGating=1, MCLK_ID_AHB=77 (Index for HSM AHB clock)
ITM at 0xE0041000
MCLK at 0x44052000
  parameters: DIV_CLK_NUM=2, INSTANCE_ID=9 (Instance index for MCLK), MCLK_ID_APB=12 (Index for MCLK APB clock), PAC_ID=9 (Index for MCLK registers write protection)
MCRAMC at 0x44822000
  parameters: AHB_CLOCK_ENABLE=1 (MCRAMC CLOCK GATER), AHB_ECC=1 (ECC LOGIC), AHB_PORTS_NB=1 (NUMBER OF AHB PORTS), AHB_READ_PREBUFFERING=1, AHB_REQUEST_ISOLATION_REGISTER=1 (AHB REQUEST TIMING PATHS ISOLATION), ARBITRATION_TYPE=2 (ARBITRATION SCHEME, FIXED_PRIORITY = 0, HIGHLIGHT = 1, HOPSCOTCH = 2), BIT_STROBE_RAM=0 (Set this parameter to TRUE if the ram_wem_bundle outputs are connected to ram bit-strobe write masks), CHANNELS_NB=1 (NUMBER OF RAM CHANNELS), ECC_SYNDROM_REGISTER=1 (ECC TIMING PATH BALANCING), HADDR_READ_ISOLATION_REGISTER=0 (Set to IMPLEMENTED to add 1 wait-state max (0 min) per memory new line read access for each of the AHB timing path isolations), HRDATA_ISOLATION_REGISTER=1 (AHB REQUEST TIMING PATHS ISOLATION), MCRAMC_CLK_GATER=1 (MCRAMC CLOCK GATER), MCRAMC_PADDR_SIZE=8 (APB USER INTERFACE), MEMORY_AUTO_CORRECTION=1 (Perform an automatic write-back of the corrected ram word after read), MEMORY_ENABLE_POLARITY=0 (POSITIVE if Memory is selected when ram_me is 1'b1), MW_CLOCK_ENABLE=0 (MCRAMC CLOCK GATER), MW_DATA_SIZE=32 (MW DATA BUS SIZE), MW_PORT_SLICES_NB=0 (NUMBER OF PORT SLICES FOR THE WAITED SRAM INTERFACE), M0_CLOCK_ENABLE=0 (MCRAMC CLOCK GATER), M0_DATA_SIZE=32 (M0 DATA BUS SIZE), M0_HYBRID_READ_WRITE_ACCESS=0 (M0 HYBRID SIMULTANEOUS READ + WRITE ACCESS), M0_PORT_SLICES_NB=0 (NUMBER OF PORT SLICES FOR THE 0 WS SRAM INTERFACE), RAM_ADD_SIZE=14 (NUMBER OF ADDRESS BITS FOR ONE CHANNEL RAM CELL), RAM_AHB_ADDRESS_OFFSET=0 (RAM BLOCK AHB ADDRESS OFFSET), STORE_BYTE_STROBE=0 (AHB byte strobes can be stored and read back through the M0 interface), ULTRA=1 (ULTRA USER INTERFACE), WRITE_ENABLE_POLARITY=0 (POSITIVE if Memory is written when ram_we is 1'b1), WRITE_ENABLE_USED=0 (TRUE if the Memory makes use of a global per channel ram_we write enable), WRITE_MASK_POLARITY=0 (POSITIVE if Memory is written when ram_wem is 1'b1), INSTANCE_ID=16 (Instance index for MCRAMC), MCLK_ID_APB=20 (Index for MCRAMC APB clock), PAC_ID=16 (Index for MCRAMC registers write protection)
MLB at 0x458C0000
  pins: MLBC PD07/G; MLBD PD09/G; MLBS PD08/G
  parameters: GCLK_ID=62 (Index of Generic Clock), MLB_MEM_MARGINADJ_MSB=4 (MBIST input margin adjustment control), INSTANCE_ID=66 (Instance index for MLB), MCLK_ID_AHB=78 (Index for MLB AHB clock), MCLK_ID_APB=79 (Index for MLB APB clock), PAC_ID=66 (Index for MLB registers write protection)
MPU at 0xE000ED90
  parameters: __MPU_REGIONS=8 (Number of MPU regions)
NVIC at 0xE000E000
  parameters: NUM_IRQ=222 (Number of interrupt requests), __NVIC_PRIO_BITS=3 (Number of NVIC interrupt priority bits)
OSC32KCTRL at 0x44042000
  pins: XIN32 PB05/XIN32; XOUT32 PB04/XOUT32
  parameters: INSTANCE_ID=7 (Instance index for OSC32KCTRL), MCLK_ID_APB=10 (Index for OSC32KCTRL APB clock), PAC_ID=7 (Index for OSC32KCTRL registers write protection)
OSCCTRL at 0x44040000
  pins: XIN PD01/XIN0; XOUT PD00/XOUT0
  parameters: DFLL48M_ATEST_IMPLEMENTED=1 (DFLL48M ATEST register implemented), DFLL48M_ATEST_SIZE=8 (number of effective bits in DFLL48M ATEST register), DFLL48M_IS_STARTUP_OSCILLATOR=1, DFLL48M_RC48MCAL0_PORVAL=0x0 (Defines the RC48MCAL0 register reset value after POR.), DIV_8MHZ_NUM=8, FRACDIVS_NUM=2 (Number of FRACDIVs), FRACDIV_DIVIDER_RESET_VAL=32 (Fracdiv Divider reset value), FRACDIV_PLLSRC=1 (Indice of the PLL that is source of the FRACDIV), GCLK_ID_DFLL48M=0 (Index of Generic Clock for DFLL48), GCLK_ID_PLL_0=1 (Index of Generic Clock for PLL 0), GCLK_ID_PLL_1=2 (Index of Generic Clock for PLL 1), PLLS_NUM=2 (Number of PLLs), PLL0_OUTPUTS_NUM=4 (number of clock outputs for PLL0), PLL1_OUTPUTS_NUM=4 (number of clock outputs for PLL1), USBHS_NUM=2 (Number of usbhs clock requests), XOSC_ATEST_IMPLEMENTED=1 (XOSC ATEST register implemented), XOSC_ATEST_SIZE=4 (number of effective bits in XOSC ATEST register), XOSC_CFD_CLK_SELECT_SIZE=4 (Clock fail prescaler size), XOSC_CFD_HAS_RETENTION=0 (Clock fail detected for xosc is in tetention domain), INSTANCE_ID=6 (Instance index for OSCCTRL), MCLK_ID_APB=9 (Index for OSCCTRL APB clock), PAC_ID=6 (Index for OSCCTRL registers write protection)
PAC at 0x44810000
  parameters: HMATRIX1_IMPLEMENTED=0, HPB_NUM=3 (Number of bridges AHB/APB), SECURE_IMPLEMENTED=0 (Security Configuration implemented?), INSTANCE_ID=14 (Instance index for PAC), MCLK_ID_AHB=17 (Index for PAC AHB clock), MCLK_ID_APB=18 (Index for PAC APB clock), PAC_ID=14 (Index for PAC registers write protection)
PM at 0x44010000
  pins: RESET_N RESET_N
  parameters: BACKUP_IMPLEMENTED=1 (Backup domain is implemented), PD_NUM=0 (Number of switchable Power Domains), INSTANCE_ID=3 (Instance index for PM), MCLK_ID_APB=6 (Index for PM APB clock), PAC_ID=3 (Index for PM registers write protection)
PORT at PORT_AHB 0x40000000, 0x44840000
  pins: P{n} PA{n:02} (n=0..31); P{n} PB{n-32:02} (n=32..63); P{n} PC{n-64:02} (n=64..79); P{n} PC{n-64} (n=81..95); P{n} PD{n-96:02} (n=96..117); P119 PD23; P120 PD24; P121 PD25; P122 PD26; P123 PD27; P124 PD28; P125 PD29; P{n} PE{n-128:02} (n=128..139); P{n} PF{n-160:02} (n=160..168); P{n} PG{n-192:02} (n=192..203)
  parameters: AHB_IMPLEMENTED=1, BITS=204, DRVSTR=0 (Number of DRVSTR bits (0/1/2)), EV_NUM=4, GROUPS=4, HADDR_MSB=25 (AHB bus address MSB), IOBUS_IMPLEMENTED=0, MSB=203, ODRAIN=1 (ODRAIN supported?), PPP_IMPLEMENTED=0 (IOBUS2 implemented?), SECURE_IMPLEMENTED=0 (Secure I/Os supported?), SLEWLIM=2 (Number of SLEWLIM bits (0/1/2)), INSTANCE_ID=18 (Instance index for PORT), MCLK_ID_AHB=22 (Index for PORT AHB clock), MCLK_ID_APB=23 (Index for PORT APB clock), PAC_ID=18 (Index for PORT registers write protection)
PRM at 0x44080000
  parameters: PRMWS_DEFAULT=0 (Default value of PRMWS register field), ROM_KEN=0 (Value driven on to ROM's KEN input), ROM_SPLIT=0x0e00 (Address defining first restricted address), INSTANCE_ID=21 (Instance index for PRM), MCLK_ID_AHB=28 (Index for PRM AHB clock), MCLK_ID_APB=29 (Index for PRM APB clock), PAC_ID=21 (Index for PRM registers write protection)
PTC at 0x46828000
  pins: DRV0 PB17/P; DRV1 PB16/P; DRV2 PB15/P; DRV3 PB14/P; DRV4 PB13/P; DRV5 PB12/P; DRV6 PB11/P; DRV7 PB10/P; DRV8 PB09/P; DRV9 PB08/P; DRV10 PB07/P; DRV11 PB06/P; DRV12 PB26/P; DRV13 PB25/P; DRV14 PB24/P; DRV15 PB23/P; DRV16 PB22/P; DRV17 PB21/P; DRV18 PB31/P; DRV19 PB30/P; DRV20 PB29/P; DRV21 PF05/P; DRV22 PB28/P; DRV23 PB27/P; DRV24 PF08/P; DRV25 PF07/P; DRV26 PF06/P; DRV27 PF04/P; DRV28 PF03/P; DRV29 PF02/P; DRV30 PF00/P; DRV31 PF01/P; ECI0 PC02/P; ECI1 PC03/P
  parameters: DMAC_ID_EOC=78 (Index of DMA EOC trigger), DMAC_ID_SEQ=76 (Index of DMA SEQ trigger), DMAC_ID_WCOMP=77 (Index of DMA WCOMP trigger), GCLK_ID=43 (Index of Generic Clock), LINES_NUM=32 (Number of PTC lines), INSTANCE_ID=45 (Instance index for PTC), MCLK_ID_APB=53 (Index for PTC APB clock), PAC_ID=45 (Index for PTC registers write protection)
RSTC at 0x44030000
  parameters: BACKUP_IMPLEMENTED=1, CM_DBGRESET_STRETCHED=12 (Reset stretcher size for Cortex CPU related to DBGRESET.), CM_HRESET_N_STRETCHED=12 (Reset stretcher size for Cortex CPU related to HRESETn.), CM_PORESET_STRETCHED=12 (Reset stretcher size for Cortex CPU related to PORESET.), HIB_IMPLEMENTED=1, VBAT_IMPLEMENTED=0 (One if VBAT (Battery backup mode) is supported), INSTANCE_ID=5 (Instance index for RSTC), MCLK_ID_APB=8 (Index for RSTC APB clock), PAC_ID=5 (Index for RSTC registers write protection)
RTC at 0x44072000
  pins: IN0 PB09/RTC_IN; IN1 PB08/RTC_IN; IN2 PB10/RTC_IN; IN3 PB11/RTC_IN; IN4 PB01/RTC_IN; IN5 PB19/RTC_IN; IN6 PB22/RTC_IN; IN7 PB24/RTC_IN; OUT0 PB07/RTC_OUT; OUT1 PB00/RTC_OUT; OUT2 PB02/RTC_OUT; OUT3 PB03/RTC_OUT; OUT4 PB26/RTC_OUT; OUT5 PB18/RTC_OUT; OUT6 PB21/RTC_OUT; OUT7 PB23/RTC_OUT
  parameters: DMAC_ID_TIMESTAMP=4 (DMA RTC timestamp trigger), NUM_OF_ALARMS=2 (Number of Alarms), NUM_OF_BKREGS=0 (Number of Backup Registers), NUM_OF_COMP16=4 (Number of 16-bit Comparators), NUM_OF_TAMPERS=8 (Number of Tamper Inputs), INSTANCE_ID=12 (Instance index for RTC), MCLK_ID_APB=15 (Index for RTC APB clock), PAC_ID=12 (Index for RTC registers write protection)
SDMMC0 at 0x458A0000 (SDMMC)
  pins: SDCD PC15/I set 1; SDCK PC08/I set 1; SDCMD PC13/I set 1; SDDAT0 PC09/I set 1; SDDAT1 PC10/I set 1; SDDAT2 PC11/I set 1; SDDAT3 PC12/I set 1; SDWP PC14/I set 1
  parameters: CARD_DATA_SIZE=4, CLOCK_MULTIPLIER=2 (Multiplier between "sd_mult_src_clock" and "sd_src_clock"), DDR50_SUPPORT=0 (SD - UHS DDR50 Support Implemented), DIVBY2_FOR_SDSRCCLK=1 (Div-by-2 Source Clock is Implemented), DLL_NB_OF_PHASES=16, EIGHT_BITS_BUS_WIDTH=0 (Data Bus Width), GCLK_ID=58, GCLK_ID_SLOW=59, GLOBAL_INTERRUPT=1, HSDDR_SUPPORT=0 (e.MMC - HSDDR Support Implemented), HS200_SUPPORT=0 (e.MMC - HS200 Support Implemented), MAX_BLOCK_LENGTH=512 (Maximum Block Length), MULTIPLE_SLOTS=1 (Multiple Slots Support Enabled), MULT_SRC_CLK_GATED=1 (Internal Clock Gater is Implemented), PROGRAMMABLE_CLK_GENERATOR=1 (Programmabe Clock Generator is Implemented), RETUNING_TIMER=0, RETUNING_TIMER_MAX_VALUE=0 (Retuning Timer Counter Max Value), SDCD_DEBOUNCE_PERIOD=328 (Debounce Period Value), SDR12_SUPPORT=0 (SD - UHS SDR12 Support Implemented), SDR25_SUPPORT=0 (SD - UHS SDR25 Support Implemented), SDR50_SUPPORT=0 (SD - UHS SDR50 Support Implemented), SDR104_SUPPORT=0 (SD - UHS SDR104 Support Implemented), SD_SRC_CLOCK_FREQ=0 (Source Clock Frequency (MHz)), SHARED_BUS=0 (Shared Bus Enabled), SLOT_TYPE=0 (Slot Usage), TIMEOUT_CLK_DIVISION=1 (Division of TIMEOUT CLOCK compared to "sd_src_clock"), TIMEOUT_CLK_FREQ=12 (TIMEOUT CLOCK frequency), TIMEOUT_CLK_FREQ_UNIT=1 (TIMEOUT CLOCK frequency unit (0=KHz , 1=MHz)), TUNING_FOR_SDR50=0 (SDR50 Tuning Support Enabled), USER_DEBOUNCE=0 (User Debouncing), INSTANCE_ID=60 (Instance index for SDMMC0), MCLK_ID_AHB=69 (Index for SDMMC0 AHB clock), MCLK_ID_APB=70 (Index for SDMMC0 APB clock), PAC_ID=60 (Index for SDMMC0 registers write protection)
SDMMC1 at 0x460A0000 (SDMMC)
  pins: SDCD PC28/I; SDCK PC30/I set 1; SDCMD PG03/I set 1; SDDAT0 PC31/I set 1; SDDAT1 PG00/I set 1; SDDAT2 PG01/I set 1; SDDAT3 PG02/I set 1; SDWP PC27/I set 1
  parameters: CARD_DATA_SIZE=4, CLOCK_MULTIPLIER=2 (Multiplier between "sd_mult_src_clock" and "sd_src_clock"), DDR50_SUPPORT=0 (SD - UHS DDR50 Support Implemented), DIVBY2_FOR_SDSRCCLK=1 (Div-by-2 Source Clock is Implemented), DLL_NB_OF_PHASES=16, EIGHT_BITS_BUS_WIDTH=0 (Data Bus Width), GCLK_ID=60, GCLK_ID_SLOW=61, GLOBAL_INTERRUPT=1, HSDDR_SUPPORT=0 (e.MMC - HSDDR Support Implemented), HS200_SUPPORT=0 (e.MMC - HS200 Support Implemented), MAX_BLOCK_LENGTH=512 (Maximum Block Length), MULTIPLE_SLOTS=1 (Multiple Slots Support Enabled), MULT_SRC_CLK_GATED=1 (Internal Clock Gater is Implemented), PROGRAMMABLE_CLK_GENERATOR=1 (Programmabe Clock Generator is Implemented), RETUNING_TIMER=0, RETUNING_TIMER_MAX_VALUE=0 (Retuning Timer Counter Max Value), SDCD_DEBOUNCE_PERIOD=328 (Debounce Period Value), SDR12_SUPPORT=0 (SD - UHS SDR12 Support Implemented), SDR25_SUPPORT=0 (SD - UHS SDR25 Support Implemented), SDR50_SUPPORT=0 (SD - UHS SDR50 Support Implemented), SDR104_SUPPORT=0 (SD - UHS SDR104 Support Implemented), SD_SRC_CLOCK_FREQ=0 (Source Clock Frequency (MHz)), SHARED_BUS=0 (Shared Bus Enabled), SLOT_TYPE=0 (Slot Usage), TIMEOUT_CLK_DIVISION=1 (Division of TIMEOUT CLOCK compared to "sd_src_clock"), TIMEOUT_CLK_FREQ=12 (TIMEOUT CLOCK frequency), TIMEOUT_CLK_FREQ_UNIT=1 (TIMEOUT CLOCK frequency unit (0=KHz , 1=MHz)), TUNING_FOR_SDR50=0 (SDR50 Tuning Support Enabled), USER_DEBOUNCE=0 (User Debouncing), INSTANCE_ID=61 (Instance index for SDMMC1), MCLK_ID_AHB=71 (Index for SDMMC1 AHB clock), MCLK_ID_APB=72 (Index for SDMMC1 APB clock), PAC_ID=61 (Index for SDMMC1 registers write protection)

## Notices in the file
Copyright (c) 2021 Microchip Technology Inc.
SPDX-License-Identifier: Apache-2.0
Licensed under the Apache License, Version 2.0 (the "License");
you may not use this file except in compliance with the License.
You may obtain a copy of the License at
http://www.apache.org/licenses/LICENSE-2.0
Unless required by applicable law or agreed to in writing, software
distributed under the License is distributed on an "AS IS" BASIS,
WITHOUT WARRANTIES OR CONDITIONS OF ANY KIND, either express or implied.
See the License for the specific language governing permissions and
limitations under the License.
