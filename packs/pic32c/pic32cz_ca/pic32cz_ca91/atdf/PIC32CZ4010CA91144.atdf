# PIC32CZ4010CA91144 device description
Architecture: CORTEX-M7; Family: PIC32C; Series: PIC32CZCA91

## Peripheral instances (address, pins/pin function, parameters) (continued)
RTC at 0x44072000
  pins: IN0 PB09/RTC_IN; IN1 PB08/RTC_IN; IN2 PB10/RTC_IN; IN3 PB11/RTC_IN; IN4 PB01/RTC_IN; IN5 PB19/RTC_IN; IN6 PB22/RTC_IN; IN7 PB24/RTC_IN; OUT0 PB07/RTC_OUT; OUT1 PB00/RTC_OUT; OUT2 PB02/RTC_OUT; OUT3 PB03/RTC_OUT; OUT4 PB26/RTC_OUT; OUT5 PB18/RTC_OUT; OUT6 PB21/RTC_OUT; OUT7 PB23/RTC_OUT
  parameters: DMAC_ID_TIMESTAMP=4 (DMA RTC timestamp trigger), NUM_OF_ALARMS=2 (Number of Alarms), NUM_OF_BKREGS=0 (Number of Backup Registers), NUM_OF_COMP16=4 (Number of 16-bit Comparators), NUM_OF_TAMPERS=8 (Number of Tamper Inputs), INSTANCE_ID=12 (Instance index for RTC), MCLK_ID_APB=15 (Index for RTC APB clock), PAC_ID=12 (Index for RTC registers write protection)
SDMMC0 at 0x458A0000 (SDMMC)
  pins: SDCD PC15/I set 1; SDCK PC08/I set 1; SDCMD PC13/I set 1; SDDAT0 PC09/I set 1; SDDAT1 PC10/I set 1; SDDAT2 PC11/I set 1; SDDAT3 PC12/I set 1; SDWP PC14/I set 1
  parameters: CARD_DATA_SIZE=4, CLOCK_MULTIPLIER=2 (Multiplier between "sd_mult_src_clock" and "sd_src_clock"), DDR50_SUPPORT=0 (SD - UHS DDR50 Support Implemented), DIVBY2_FOR_SDSRCCLK=1 (Div-by-2 Source Clock is Implemented), DLL_NB_OF_PHASES=16, EIGHT_BITS_BUS_WIDTH=0 (Data Bus Width), GCLK_ID=58, GCLK_ID_SLOW=59, GLOBAL_INTERRUPT=1, HSDDR_SUPPORT=0 (e.MMC - HSDDR Support Implemented), HS200_SUPPORT=0 (e.MMC - HS200 Support Implemented), MAX_BLOCK_LENGTH=512 (Maximum Block Length), MULTIPLE_SLOTS=1 (Multiple Slots Support Enabled), MULT_SRC_CLK_GATED=1 (Internal Clock Gater is Implemented), PROGRAMMABLE_CLK_GENERATOR=1 (Programmabe Clock Generator is Implemented), RETUNING_TIMER=0, RETUNING_TIMER_MAX_VALUE=0 (Retuning Timer Counter Max Value), SDCD_DEBOUNCE_PERIOD=328 (Debounce Period Value), SDR12_SUPPORT=0 (SD - UHS SDR12 Support Implemented), SDR25_SUPPORT=0 (SD - UHS SDR25 Support Implemented), SDR50_SUPPORT=0 (SD - UHS SDR50 Support Implemented), SDR104_SUPPORT=0 (SD - UHS SDR104 Support Implemented), SD_SRC_CLOCK_FREQ=0 (Source Clock Frequency (MHz)), SHARED_BUS=0 (Shared Bus Enabled), SLOT_TYPE=0 (Slot Usage), TIMEOUT_CLK_DIVISION=1 (Division of TIMEOUT CLOCK compared to "sd_src_clock"), TIMEOUT_CLK_FREQ=12 (TIMEOUT CLOCK frequency), TIMEOUT_CLK_FREQ_UNIT=1 (TIMEOUT CLOCK frequency unit (0=KHz , 1=MHz)), TUNING_FOR_SDR50=0 (SDR50 Tuning Support Enabled), USER_DEBOUNCE=0 (User Debouncing), INSTANCE_ID=60 (Instance index for SDMMC0), MCLK_ID_AHB=69 (Index for SDMMC0 AHB clock), MCLK_ID_APB=70 (Index for SDMMC0 APB clock), PAC_ID=60 (Index for SDMMC0 registers write protection)
SERCOM0 at 0x46000000 (SERCOM)
  pins: PAD0 PC00/D; PAD1 PC01/D; PAD2 PC02/D; PAD3 PC03/D
  parameters: CLK_REDUCTION=1 (Reduce clock options to pin 1 for SPI and USART), DMA=1 (DMA support implemented?), DMAC_ID_RX=5 (Index of DMA RX trigger), DMAC_ID_TX=6 (Index of DMA TX trigger), FIFO_IMPLEMENTED=1 (FIFO Rx/Tx implemented?), FIFO_SIZE=16 (Rx-Tx FIFO size in bytes), FSYNC_IMPLEMENTED=1 (SPI Frame Synch mode implemented?), GCLK_ID_CORE=21, GCLK_ID_SLOW=18, SPI=1 (SPI mode implemented?), TWIM=1 (TWI Master mode implemented?), TWIS=1 (TWI Slave mode implemented?), TWI_HSMODE=1 (TWI HighSpeed mode implemented?), ULTRA_IMPLEMENTATION=0 (ULTRA platform compatibility?), USART=1 (USART mode implemented?), USART_AUTOBAUD=1 (USART autobaud implemented?), USART_IRDA=1 (USART IrDA implemented?), USART_ISO7816=1 (USART ISO7816 mode implemented?), USART_LIN_MASTER=1 (USART LIN Master mode implemented?), USART_RS485=1 (USART RS485 mode implemented?), INSTANCE_ID=23 (Instance index for SERCOM0), MCLK_ID_APB=31 (Index for SERCOM0 APB clock), PAC_ID=23 (Index for SERCOM0 registers write protection), USART_ERROR_INT_SRC=55 (USART/SPI/I2C Error), USART_TX_READY_INT_SRC=57 (USART-SPI Data Register Empty/ I2C Stop Received), USART_TX_COMPLETE_INT_SRC=58 (USART-SPI Transmit Complete/ I2C Address Match), USART_RX_INT_SRC=59 (USART-SPI Receive Complete/ I2C Data Ready), SPI_TX_READY_INT_SRC=57 (USART-SPI Data Register Empty/ I2C Stop Received), SPI_TX_COMPLETE_INT_SRC=58 (USART-SPI Transmit Complete/ I2C Address Match), SPI_RX_INT_SRC=59 (USART-SPI Receive Complete/ I2C Data Ready), I2C_0_INT_SRC=55 (USART/SPI/I2C Error), I2C_1_INT_SRC=59 (USART-SPI Receive Complete/ I2C Data Ready), I2C_2_INT_SRC=60 (USART Receive Start/ SPI Slave Select Low/ I2C TX FIFO Empty), I2C_3_INT_SRC=61 (USART Clear To Send Input Change/ I2C RX FIFO Full)
SERCOM1 at 0x46002000 (SERCOM)
  pins: PAD0 PC04/D set 1 or PC20/D set 2; PAD1 PC05/D set 1 or PC19/D set 2; PAD2 PC06/D set 1 or PC18/D set 2; PAD3 PC07/D set 1 or PC17/D set 2
  parameters: CLK_REDUCTION=1 (Reduce clock options to pin 1 for SPI and USART), DMA=1 (DMA support implemented?), DMAC_ID_RX=7 (Index of DMA RX trigger), DMAC_ID_TX=8 (Index of DMA TX trigger), FIFO_IMPLEMENTED=1 (FIFO Rx/Tx implemented?), FIFO_SIZE=16 (Rx-Tx FIFO size in bytes), FSYNC_IMPLEMENTED=1 (SPI Frame Synch mode implemented?), GCLK_ID_CORE=22, GCLK_ID_SLOW=18, SPI=1 (SPI mode implemented?), TWIM=1 (TWI Master mode implemented?), TWIS=1 (TWI Slave mode implemented?), TWI_HSMODE=1 (TWI HighSpeed mode implemented?), ULTRA_IMPLEMENTATION=0 (ULTRA platform compatibility?), USART=1 (USART mode implemented?), USART_AUTOBAUD=1 (USART autobaud implemented?), USART_IRDA=1 (USART IrDA implemented?), USART_ISO7816=1 (USART ISO7816 mode implemented?), USART_LIN_MASTER=1 (USART LIN Master mode implemented?), USART_RS485=1 (USART RS485 mode implemented?), INSTANCE_ID=24 (Instance index for SERCOM1), MCLK_ID_APB=32 (Index for SERCOM1 APB clock), PAC_ID=24 (Index for SERCOM1 registers write protection), USART_ERROR_INT_SRC=62 (USART/SPI/I2C Error), USART_TX_READY_INT_SRC=64 (USART-SPI Data Register Empty/ I2C Stop Received), USART_TX_COMPLETE_INT_SRC=65 (USART-SPI Transmit Complete/ I2C Address Match), USART_RX_INT_SRC=66 (USART-SPI Receive Complete/ I2C Data Ready), SPI_TX_READY_INT_SRC=64 (USART-SPI Data Register Empty/ I2C Stop Received), SPI_TX_COMPLETE_INT_SRC=65 (USART-SPI Transmit Complete/ I2C Address Match), SPI_RX_INT_SRC=66 (USART-SPI Receive Complete/ I2C Data Ready), I2C_0_INT_SRC=62 (USART/SPI/I2C Error), I2C_1_INT_SRC=66 (USART-SPI Receive Complete/ I2C Data Ready), I2C_2_INT_SRC=67 (USART Receive Start/ SPI Slave Select Low/ I2C TX FIFO Empty), I2C_3_INT_SRC=68 (USART Clear To Send Input Change/ I2C RX FIFO Full)
SERCOM2 at 0x45800000 (SERCOM)
  pins: PAD0 PC08/D set 1 or PD11/D set 2; PAD1 PC09/D set 1 or PD12/D set 2; PAD2 PC10/D set 1 or PA04/D set 2; PAD3 PC11/D set 1 or PA03/D set 2
  parameters: CLK_REDUCTION=1 (Reduce clock options to pin 1 for SPI and USART), DMA=1 (DMA support implemented?), DMAC_ID_RX=9 (Index of DMA RX trigger), DMAC_ID_TX=10 (Index of DMA TX trigger), FIFO_IMPLEMENTED=1 (FIFO Rx/Tx implemented?), FIFO_SIZE=16 (Rx-Tx FIFO size in bytes), FSYNC_IMPLEMENTED=1 (SPI Frame Synch mode implemented?), GCLK_ID_CORE=23, GCLK_ID_SLOW=19, SPI=1 (SPI mode implemented?), TWIM=1 (TWI Master mode implemented?), TWIS=1 (TWI Slave mode implemented?), TWI_HSMODE=1 (TWI HighSpeed mode implemented?), ULTRA_IMPLEMENTATION=0 (ULTRA platform compatibility?), USART=1 (USART mode implemented?), USART_AUTOBAUD=1 (USART autobaud implemented?), USART_IRDA=1 (USART IrDA implemented?), USART_ISO7816=1 (USART ISO7816 mode implemented?), USART_LIN_MASTER=1 (USART LIN Master mode implemented?), USART_RS485=1 (USART RS485 mode implemented?), INSTANCE_ID=25 (Instance index for SERCOM2), MCLK_ID_APB=33 (Index for SERCOM2 APB clock), PAC_ID=25 (Index for SERCOM2 registers write protection), USART_ERROR_INT_SRC=69 (USART/SPI/I2C Error), USART_TX_READY_INT_SRC=71 (USART-SPI Data Register Empty/ I2C Stop Received), USART_TX_COMPLETE_INT_SRC=72 (USART-SPI Transmit Complete/ I2C Address Match), USART_RX_INT_SRC=73 (USART-SPI Receive Complete/ I2C Data Ready), SPI_TX_READY_INT_SRC=71 (USART-SPI Data Register Empty/ I2C Stop Received), SPI_TX_COMPLETE_INT_SRC=72 (USART-SPI Transmit Complete/ I2C Address Match), SPI_RX_INT_SRC=73 (USART-SPI Receive Complete/ I2C Data Ready), I2C_0_INT_SRC=69 (USART/SPI/I2C Error), I2C_1_INT_SRC=73 (USART-SPI Receive Complete/ I2C Data Ready), I2C_2_INT_SRC=74 (USART Receive Start/ SPI Slave Select Low/ I2C TX FIFO Empty), I2C_3_INT_SRC=75 (USART Clear To Send Input Change/ I2C RX FIFO Full)
SERCOM3 at 0x45802000 (SERCOM)
  pins: PAD0 PC12/D set 1 or PD03/D set 2; PAD1 PC13/D set 1 or PD04/D set 2; PAD2 PC14/D set 1 or PD05/D set 2; PAD3 PC15/D set 1 or PD06/D set 2
  parameters: CLK_REDUCTION=1 (Reduce clock options to pin 1 for SPI and USART), DMA=1 (DMA support implemented?), DMAC_ID_RX=11 (Index of DMA RX trigger), DMAC_ID_TX=12 (Index of DMA TX trigger), FIFO_IMPLEMENTED=1 (FIFO Rx/Tx implemented?), FIFO_SIZE=16 (Rx-Tx FIFO size in bytes), FSYNC_IMPLEMENTED=1 (SPI Frame Synch mode implemented?), GCLK_ID_CORE=24, GCLK_ID_SLOW=19, SPI=1 (SPI mode implemented?), TWIM=1 (TWI Master mode implemented?), TWIS=1 (TWI Slave mode implemented?), TWI_HSMODE=1 (TWI HighSpeed mode implemented?), ULTRA_IMPLEMENTATION=0 (ULTRA platform compatibility?), USART=1 (USART mode implemented?), USART_AUTOBAUD=1 (USART autobaud implemented?), USART_IRDA=1 (USART IrDA implemented?), USART_ISO7816=1 (USART ISO7816 mode implemented?), USART_LIN_MASTER=1 (USART LIN Master mode implemented?), USART_RS485=1 (USART RS485 mode implemented?), INSTANCE_ID=26 (Instance index for SERCOM3), MCLK_ID_APB=34 (Index for SERCOM3 APB clock), PAC_ID=26 (Index for SERCOM3 registers write protection), USART_ERROR_INT_SRC=76 (USART/SPI/I2C Error), USART_TX_READY_INT_SRC=78 (USART-SPI Data Register Empty/ I2C Stop Received), USART_TX_COMPLETE_INT_SRC=79 (USART-SPI Transmit Complete/ I2C Address Match), USART_RX_INT_SRC=80 (USART-SPI Receive Complete/ I2C Data Ready), SPI_TX_READY_INT_SRC=78 (USART-SPI Data Register Empty/ I2C Stop Received), SPI_TX_COMPLETE_INT_SRC=79 (USART-SPI Transmit Complete/ I2C Address Match), SPI_RX_INT_SRC=80 (USART-SPI Receive Complete/ I2C Data Ready), I2C_0_INT_SRC=76 (USART/SPI/I2C Error), I2C_1_INT_SRC=80 (USART-SPI Receive Complete/ I2C Data Ready), I2C_2_INT_SRC=81 (USART Receive Start/ SPI Slave Select Low/ I2C TX FIFO Empty), I2C_3_INT_SRC=82 (USART Clear To Send Input Change/ I2C RX FIFO Full)
SERCOM4 at 0x46004000 (SERCOM)
  pins: PAD0 PC21/D; PAD1 PC22/D; PAD2 PC23/D; PAD3 PC24/D
  parameters: CLK_REDUCTION=1 (Reduce clock options to pin 1 for SPI and USART), DMA=1 (DMA support implemented?), DMAC_ID_RX=13 (Index of DMA RX trigger), DMAC_ID_TX=14 (Index of DMA TX trigger), FIFO_IMPLEMENTED=1 (FIFO Rx/Tx implemented?), FIFO_SIZE=16 (Rx-Tx FIFO size in bytes), FSYNC_IMPLEMENTED=1 (SPI Frame Synch mode implemented?), GCLK_ID_CORE=25, GCLK_ID_SLOW=18, SPI=1 (SPI mode implemented?), TWIM=1 (TWI Master mode implemented?), TWIS=1 (TWI Slave mode implemented?), TWI_HSMODE=1 (TWI HighSpeed mode implemented?), ULTRA_IMPLEMENTATION=0 (ULTRA platform compatibility?), USART=1 (USART mode implemented?), USART_AUTOBAUD=1 (USART autobaud implemented?), USART_IRDA=1 (USART IrDA implemented?), USART_ISO7816=1 (USART ISO7816 mode implemented?), USART_LIN_MASTER=1 (USART LIN Master mode implemented?), USART_RS485=1 (USART RS485 mode implemented?), INSTANCE_ID=27 (Instance index for SERCOM4), MCLK_ID_APB=35 (Index for SERCOM4 APB clock), PAC_ID=27 (Index for SERCOM4 registers write protection), USART_ERROR_INT_SRC=83 (USART/SPI/I2C Error), USART_TX_READY_INT_SRC=85 (USART-SPI Data Register Empty/ I2C Stop Received), USART_TX_COMPLETE_INT_SRC=76 (USART-SPI Transmit Complete/ I2C Address Match), USART_RX_INT_SRC=87 (USART-SPI Receive Complete/ I2C Data Ready), SPI_TX_READY_INT_SRC=85 (USART-SPI Data Register Empty/ I2C Stop Received), SPI_TX_COMPLETE_INT_SRC=86 (USART-SPI Transmit Complete/ I2C Address Match), SPI_RX_INT_SRC=87 (USART-SPI Receive Complete/ I2C Data Ready), I2C_0_INT_SRC=83 (USART/SPI/I2C Error), I2C_1_INT_SRC=87 (USART-SPI Receive Complete/ I2C Data Ready), I2C_2_INT_SRC=88 (USART Receive Start/ SPI Slave Select Low/ I2C TX FIFO Empty), I2C_3_INT_SRC=89 (USART Clear To Send Input Change/ I2C RX FIFO Full)
SERCOM5 at 0x45804000 (SERCOM)
  pins: PAD0 PC25/D; PAD1 PC26/D; PAD2 PC27/D; PAD3 PC28/D
  parameters: CLK_REDUCTION=1 (Reduce clock options to pin 1 for SPI and USART), DMA=1 (DMA support implemented?), DMAC_ID_RX=15 (Index of DMA RX trigger), DMAC_ID_TX=16 (Index of DMA TX trigger), FIFO_IMPLEMENTED=1 (FIFO Rx/Tx implemented?), FIFO_SIZE=16 (Rx-Tx FIFO size in bytes), FSYNC_IMPLEMENTED=1 (SPI Frame Synch mode implemented?), GCLK_ID_CORE=26, GCLK_ID_SLOW=19, SPI=1 (SPI mode implemented?), TWIM=1 (TWI Master mode implemented?), TWIS=1 (TWI Slave mode implemented?), TWI_HSMODE=1 (TWI HighSpeed mode implemented?), ULTRA_IMPLEMENTATION=0 (ULTRA platform compatibility?), USART=1 (USART mode implemented?), USART_AUTOBAUD=1 (USART autobaud implemented?), USART_IRDA=1 (USART IrDA implemented?), USART_ISO7816=1 (USART ISO7816 mode implemented?), USART_LIN_MASTER=1 (USART LIN Master mode implemented?), USART_RS485=1 (USART RS485 mode implemented?), INSTANCE_ID=28 (Instance index for SERCOM5), MCLK_ID_APB=36 (Index for SERCOM5 APB clock), PAC_ID=28 (Index for SERCOM5 registers write protection), USART_ERROR_INT_SRC=90 (USART/SPI/I2C Error), USART_TX_READY_INT_SRC=92 (USART-SPI Data Register Empty/ I2C Stop Received), USART_TX_COMPLETE_INT_SRC=93 (USART-SPI Transmit Complete/ I2C Address Match), USART_RX_INT_SRC=94 (USART-SPI Receive Complete/ I2C Data Ready), SPI_TX_READY_INT_SRC=92 (USART-SPI Data Register Empty/ I2C Stop Received), SPI_TX_COMPLETE_INT_SRC=93 (USART-SPI Transmit Complete/ I2C Address Match), SPI_RX_INT_SRC=94 (USART-SPI Receive Complete/ I2C Data Ready), I2C_0_INT_SRC=90 (USART/SPI/I2C Error), I2C_1_INT_SRC=94 (USART-SPI Receive Complete/ I2C Data Ready), I2C_2_INT_SRC=95 (USART Receive Start/ SPI Slave Select Low/ I2C TX FIFO Empty), I2C_3_INT_SRC=96 (USART Clear To Send Input Change/ I2C RX FIFO Full)
SPI_IXS0 at 0x46030000 (SPI_IXS)
  pins: FSYNC PC00/J set 1 or PD02/J set 2; SCK PC01/J set 1 or PD04/J set 2; SDI PC02/J set 1 or PD03/J set 2; SDO PC03/J set 1 or PD05/J set 2; MCLK0 PC04/J or PD06/J
  parameters: DMAC_ID_RX=79, DMAC_ID_TX=80, GCLK_ID=44 (Index of Generic Clock), TPD_MASTER=0 (Indicates a master or slave number for TPD mode( 1=master,0=slave)), INSTANCE_ID=46 (Instance index for SPI_IXS0), MCLK_ID_APB=54 (Index for SPI_IXS0 APB clock), PAC_ID=46 (Index for SPI_IXS0 registers write protection)
SQI0 at 0x4F008000 (SQI)
  pins: CLK PC08/H; CS0 PC13/H; CS1 PC15/H; DATA0 PC09/H; DATA1 PC10/H; DATA2 PC11/H; DATA3 PC12/H
  parameters: CBUF_DEPTH=3, GCLK_ID=56 (Index of Generic Clock), SFR_ADDRESS=0x4f008000, TRXBUF_DEPTH=8, XIP_ADDRESS=0x80, XIP_CS_MSB=1, XIP_HSEL=0, INSTANCE_ID=57 (Instance index for SQI0), MCLK_ID_AHB=66 (Index for SQI0 AHB clock), PAC_ID=57 (Index for SQI0 registers write protection)
SUPC at 0x44020000
  parameters: ADDVREG_NUM=3 (Number of additional capless regulators for USB, PLL, ...), ADDVREG_PLL_NUM=1 (Number of additional capless regulators dedicated to PLL(s) (between 0 and ADDVREG_NUM)), ADDVREG_PLL_START_INDEX=2 (Index of the first additional capless regulator dedicated to a PLL within [ADDVREG_NUM-1:0] range. Must be equal to 1 if ADDVREG_PLL_NUM=0.), BKOUT_NUM=2 (Number of BKOUT output pin), BORVDDUSB_NUM=2 (Number of BOR_USB), CHRG_PUMP_NUM=3 (Number of Charge Pump), IOB_IMPLEMENTED=0 (one if IOB feature is implemented), USER_LDO_IMPLEMENTED=0 (one if USER_LDO feature is implemented), VBAT_IMPLEMENTED=0 (one if VBAT feature (battery backup feature) is implemented.), VREGSW_NUM=4 (Number of main voltage regulator (100mA). Example: 1 for Unicorn, 4 for Riverside.), INSTANCE_ID=4 (Instance index for SUPC), MCLK_ID_APB=7 (Index for SUPC APB clock), PAC_ID=4 (Index for SUPC registers write protection)
SysTick at 0xE000E010
SystemControl at 0xE000E000
TCC0 at 0x45010000 (TCC)
  pins: WO{n} PC{n:02}/F (n=0..7)
  parameters: CC_NUM=8 (Number of Compare/Capture units), DITHERING=1 (Dithering feature implemented), DMAC_ID_MC_{n}={n+26} (Indexes of DMA Match/Compare triggers {n}) (n=0..7), DMAC_ID_OVF=25 (DMA overflow/underflow/retrigger trigger), DTI=1 (Dead-Time-Insertion feature implemented), GCLK_ID=31 (Index of Generic Clock), MASTER_SLAVE_MODE=0 (TCC type 0 : NA, 1 : Master, 2 : Slave), OTMX=1 (Output Matrix feature implemented), OW_NUM=8 (Number of Output Waveforms), PG=1 (Pattern Generation feature implemented), SIZE=32, SWAP=1 (DTI outputs swap feature implemented), INSTANCE_ID=33 (Instance index for TCC0), MCLK_ID_APB=41 (Index for TCC0 APB clock), PAC_ID=33 (Index for TCC0 registers write protection)
TCC1 at 0x45012000 (TCC)
  pins: WO{n} PB{n+10}/F (n=0..7)
  parameters: CC_NUM=8 (Number of Compare/Capture units), DITHERING=1 (Dithering feature implemented), DMAC_ID_MC_{n}={n+35} (Indexes of DMA Match/Compare triggers {n}) (n=0..7), DMAC_ID_OVF=34 (DMA overflow/underflow/retrigger trigger), DTI=1 (Dead-Time-Insertion feature implemented), GCLK_ID=32 (Index of Generic Clock), MASTER_SLAVE_MODE=0 (TCC type 0 : NA, 1 : Master, 2 : Slave), OTMX=1 (Output Matrix feature implemented), OW_NUM=8 (Number of Output Waveforms), PG=1 (Pattern Generation feature implemented), SIZE=32, SWAP=1 (DTI outputs swap feature implemented), INSTANCE_ID=34 (Instance index for TCC1), MCLK_ID_APB=42 (Index for TCC1 APB clock), PAC_ID=34 (Index for TCC1 registers write protection)
TCC2 at 0x45014000 (TCC)
  pins: WO0 PD10/F set 1; WO1 PD11/F set 1; WO2 PD12/F set 1; WO3 PA04/F set 1; WO4 PA03/F set 1; WO5 PA02/F set 1
  parameters: CC_NUM=6 (Number of Compare/Capture units), DITHERING=1 (Dithering feature implemented), DMAC_ID_MC_{n}={n+44} (Indexes of DMA Match/Compare triggers {n}) (n=0..5), DMAC_ID_OVF=43 (DMA overflow/underflow/retrigger trigger), DTI=1 (Dead-Time-Insertion feature implemented), GCLK_ID=33 (Index of Generic Clock), MASTER_SLAVE_MODE=0 (TCC type 0 : NA, 1 : Master, 2 : Slave), OTMX=1 (Output Matrix feature implemented), OW_NUM=6 (Number of Output Waveforms), PG=1 (Pattern Generation feature implemented), SIZE=32, SWAP=1 (DTI outputs swap feature implemented), INSTANCE_ID=35 (Instance index for TCC2), MCLK_ID_APB=43 (Index for TCC2 APB clock), PAC_ID=35 (Index for TCC2 registers write protection)
TCC3 at 0x45810000 (TCC)
  pins: WO0 PA05/F; WO1 PA06/F
  parameters: CC_NUM=2 (Number of Compare/Capture units), DITHERING=1 (Dithering feature implemented), DMAC_ID_MC_0=51 (Indexes of DMA Match/Compare triggers 0), DMAC_ID_MC_1=52 (Indexes of DMA Match/Compare triggers 1), DMAC_ID_OVF=50 (DMA overflow/underflow/retrigger trigger), DTI=1 (Dead-Time-Insertion feature implemented), GCLK_ID=34 (Index of Generic Clock), MASTER_SLAVE_MODE=0 (TCC type 0 : NA, 1 : Master, 2 : Slave), OTMX=1 (Output Matrix feature implemented), OW_NUM=2 (Number of Output Waveforms), PG=1 (Pattern Generation feature implemented), SIZE=32, SWAP=1 (DTI outputs swap feature implemented), INSTANCE_ID=36 (Instance index for TCC3), MCLK_ID_APB=44 (Index for TCC3 APB clock), PAC_ID=36 (Index for TCC3 registers write protection)
TCC4 at 0x45812000 (TCC)
  pins: WO0 PC12/F set 1 or PC29/F set 2; WO1 PC13/F set 1 or PD13/F set 2
  parameters: CC_NUM=2 (Number of Compare/Capture units), DITHERING=1 (Dithering feature implemented), DMAC_ID_MC_0=54 (Indexes of DMA Match/Compare triggers 0), DMAC_ID_MC_1=55 (Indexes of DMA Match/Compare triggers 1), DMAC_ID_OVF=53 (DMA overflow/underflow/retrigger trigger), DTI=1 (Dead-Time-Insertion feature implemented), GCLK_ID=35 (Index of Generic Clock), MASTER_SLAVE_MODE=0 (TCC type 0 : NA, 1 : Master, 2 : Slave), OTMX=1 (Output Matrix feature implemented), OW_NUM=2 (Number of Output Waveforms), PG=1 (Pattern Generation feature implemented), SIZE=32, SWAP=1 (DTI outputs swap feature implemented), INSTANCE_ID=37 (Instance index for TCC4), MCLK_ID_APB=45 (Index for TCC4 APB clock), PAC_ID=37 (Index for TCC4 registers write protection)
TCC5 at 0x46010000 (TCC)
  pins: WO0 PC08/F set 1 or PC23/F set 2; WO1 PC09/F set 1 or PC24/F set 2
  parameters: CC_NUM=2 (Number of Compare/Capture units), DITHERING=1 (Dithering feature implemented), DMAC_ID_MC_0=57 (Indexes of DMA Match/Compare triggers 0), DMAC_ID_MC_1=58 (Indexes of DMA Match/Compare triggers 1), DMAC_ID_OVF=56 (DMA overflow/underflow/retrigger trigger), DTI=1 (Dead-Time-Insertion feature implemented), GCLK_ID=36 (Index of Generic Clock), MASTER_SLAVE_MODE=0 (TCC type 0 : NA, 1 : Master, 2 : Slave), OTMX=1 (Output Matrix feature implemented), OW_NUM=2 (Number of Output Waveforms), PG=1 (Pattern Generation feature implemented), SIZE=32, SWAP=1 (DTI outputs swap feature implemented), INSTANCE_ID=38 (Instance index for TCC5), MCLK_ID_APB=46 (Index for TCC5 APB clock), PAC_ID=38 (Index for TCC5 registers write protection)
TCC6 at 0x46012000 (TCC)
  pins: WO0 PC10/F set 1 or PC21/F set 2; WO1 PC11/F set 1 or PC22/F set 2
  parameters: CC_NUM=2 (Number of Compare/Capture units), DITHERING=1 (Dithering feature implemented), DMAC_ID_MC_0=60 (Indexes of DMA Match/Compare triggers 0), DMAC_ID_MC_1=61 (Indexes of DMA Match/Compare triggers 1), DMAC_ID_OVF=59 (DMA overflow/underflow/retrigger trigger), DTI=1 (Dead-Time-Insertion feature implemented), GCLK_ID=37 (Index of Generic Clock), MASTER_SLAVE_MODE=0 (TCC type 0 : NA, 1 : Master, 2 : Slave), OTMX=0 (Output Matrix feature implemented), OW_NUM=2 (Number of Output Waveforms), PG=0 (Pattern Generation feature implemented), SIZE=32, SWAP=1 (DTI outputs swap feature implemented), INSTANCE_ID=39 (Instance index for TCC6), MCLK_ID_APB=47 (Index for TCC6 APB clock), PAC_ID=39 (Index for TCC6 registers write protection)
TCC7 at 0x46810000 (TCC)
  pins: WO0 PA22/F set 1 or PD08/F set 2; WO1 PA23/F set 1 or PD07/F set 2
  parameters: CC_NUM=2 (Number of Compare/Capture units), DITHERING=1 (Dithering feature implemented), DMAC_ID_MC_0=63 (Indexes of DMA Match/Compare triggers 0), DMAC_ID_MC_1=64 (Indexes of DMA Match/Compare triggers 1), DMAC_ID_OVF=62 (DMA overflow/underflow/retrigger trigger), DTI=1 (Dead-Time-Insertion feature implemented), GCLK_ID=38 (Index of Generic Clock), MASTER_SLAVE_MODE=0 (TCC type 0 : NA, 1 : Master, 2 : Slave), OTMX=0 (Output Matrix feature implemented), OW_NUM=2 (Number of Output Waveforms), PG=0 (Pattern Generation feature implemented), SIZE=32, SWAP=1 (DTI outputs swap feature implemented), INSTANCE_ID=40 (Instance index for TCC7), MCLK_ID_APB=48 (Index for TCC7 APB clock), PAC_ID=40 (Index for TCC7 registers write protection)
TCC8 at 0x46812000 (TCC)
  pins: WO0 PA21/F set 1 or PC14/F set 2; WO1 PC15/F set 1
  parameters: CC_NUM=2 (Number of Compare/Capture units), DITHERING=1 (Dithering feature implemented), DMAC_ID_MC_0=66 (Indexes of DMA Match/Compare triggers 0), DMAC_ID_MC_1=67 (Indexes of DMA Match/Compare triggers 1), DMAC_ID_OVF=65 (DMA overflow/underflow/retrigger trigger), DTI=1 (Dead-Time-Insertion feature implemented), GCLK_ID=39 (Index of Generic Clock), MASTER_SLAVE_MODE=0 (TCC type 0 : NA, 1 : Master, 2 : Slave), OTMX=0 (Output Matrix feature implemented), OW_NUM=2 (Number of Output Waveforms), PG=0 (Pattern Generation feature implemented), SIZE=32, SWAP=1 (DTI outputs swap feature implemented), INSTANCE_ID=41 (Instance index for TCC8), MCLK_ID_APB=49 (Index for TCC8 APB clock), PAC_ID=41 (Index for TCC8 registers write protection)
TCC9 at 0x46814000 (TCC)
  pins: WO0 PD04/F set 1; WO1 PD05/F set 1; WO2 PD06/F set 1; WO3 PD03/F set 1; WO4 PD02/F set 1; WO5 PC20/F set 1
  parameters: CC_NUM=6 (Number of Compare/Capture units), DITHERING=1 (Dithering feature implemented), DMAC_ID_MC_{n}={n+69} (Indexes of DMA Match/Compare triggers {n}) (n=0..5), DMAC_ID_OVF=68 (DMA overflow/underflow/retrigger trigger), DTI=1 (Dead-Time-Insertion feature implemented), GCLK_ID=40 (Index of Generic Clock), MASTER_SLAVE_MODE=0 (TCC type 0 : NA, 1 : Master, 2 : Slave), OTMX=1 (Output Matrix feature implemented), OW_NUM=6 (Number of Output Waveforms), PG=1 (Pattern Generation feature implemented), SIZE=32, SWAP=1 (DTI outputs swap feature implemented), INSTANCE_ID=42 (Instance index for TCC9), MCLK_ID_APB=50 (Index for TCC9 APB clock), PAC_ID=42 (Index for TCC9 registers write protection)
TPI at 0xE0040000
TRAM at 0x44824000
  parameters: ADDR_MSB=10 (Value of the MSB bit of physical RAM address), INSTANCE_ID=17 (Instance index for TRAM), MCLK_ID_APB=21 (Index for TRAM APB clock), PAC_ID=17 (Index for TRAM registers write protection)
TRNG at 0x44870000
  parameters: INSTANCE_ID=59 (Instance index for TRNG), MCLK_ID_APB=68 (Index for TRNG APB clock), PAC_ID=59 (Index for TRNG registers write protection)
USBHS0 at 0x4F010000 (USBHS)
  pins: USB0ID USBID0; USB0PN USBDM0; USB0PP USBDP0; USBRBIAS USBRBIAS0; VBUS VBUS0
  parameters: MCLK_ID_AHB=73 (Index for USBHS0 AHB clock)
WDT at 0x44070000
  parameters: FUSES_UPDATE_SUPPORT=0 (WDT Fuse Update Support), INSTANCE_ID=11 (Instance index for WDT), MCLK_ID_APB=14 (Index for WDT APB clock), PAC_ID=11 (Index for WDT registers write protection)

## Interrupts
-15 Reset — Reset Vector, invoked on Power up and warm reset
-14 NonMaskableInt — Non maskable Interrupt, cannot be stopped or preempted
-13 HardFault — Hard Fault, all classes of Fault
-12 MemoryManagement — Memory Management, MPU mismatch, including Access Violation and No Match
-11 BusFault — Bus Fault, Pre-Fetch-, Memory Access Fault, other address/memory related Fault
-10 UsageFault — Usage Fault, i.e. Undef Instruction, Illegal State Transition
-5 SVCall — System Service Call via SVC instruction
-4 DebugMonitor
-2 PendSV — Pendable request for system service
-1 SysTick — System Tick Timer
0 FCW — Flash Write Controller Interrupt
1 FCR_ECCERR (FCR) — Flash Read Controller ECC Error
2 FCR_CRC_FAULT (FCR) — Flash Read Controller CRC Fault
3 PM — Power Manager
4 SUPC — Supply Controller
5 OSCCTRL_FAIL (OSCCTRL) — External Oscillator Fail
6 OSCCTRL_XOSCRDY (OSCCTRL) — External Oscillator Ready
7 OSCCTRL_DFLLRDY (OSCCTRL) — DFLL Ready
8 OSCCTRL_OTHER (OSCCTRL) — DFLL Other Interrupt
9 OSCCTRL_LOCK (OSCCTRL) — PLL Lock
10 OSC32KCTRL_FAIL (OSC32KCTRL) — 32K Oscillator Fail
11 OSC32KCTRL_RDY (OSC32KCTRL) — 32K Oscillator Ready
12 MCLK — Main Clock
13 FREQM — Frequency Meter
14 WDT — Watchdog Timer
15 RTC_TAMPER (RTC)
16 RTC_OVF (RTC) — RTC Overflow
17 RTC_PERIOD (RTC)
18 RTC_COMPARE (RTC)
{n+19} EIC_EXTINT_{n} (EIC) (n=0..15) — External Interrupt {n}
35 PAC — Peripheral Access Controller
36 DRMTCM — TCM RAM ECC Interrupt
37 MCRAMC — Multi-Channel RAM Controller
38 TRAM — Trust RAM Interrupt
39 DMA_PRI3 (DMA) — DMA Priority 3 Interrupt
40 DMA_PRI2 (DMA) — DMA Priority 2 Interrupt
41 DMA_PRI1 (DMA) — DMA Priority 1 Interrupt
42 DMA_PRI0 (DMA) — DMA Priority 0 Interrupt
43 EVSYS_0 (EVSYS) — Event System InterruptChannel 0
{n+43} EVSYS_{n} (EVSYS) (n=1..11) — Event System Channel {n}
55 SERCOM0_6 (SERCOM0) — USART/SPI/I2C Error
56 SERCOM0_5 (SERCOM0) — USART Receive Break
57 SERCOM0_0 (SERCOM0) — USART-SPI Data Register Empty/ I2C Stop Received
58 SERCOM0_1 (SERCOM0) — USART-SPI Transmit Complete/ I2C Address Match
59 SERCOM0_2 (SERCOM0) — USART-SPI Receive Complete/ I2C Data Ready
60 SERCOM0_3 (SERCOM0) — USART Receive Start/ SPI Slave Select Low/ I2C TX FIFO Empty
61 SERCOM0_4 (SERCOM0) — USART Clear To Send Input Change/ I2C RX FIFO Full
62 SERCOM1_6 (SERCOM1) — USART/SPI/I2C Error
63 SERCOM1_5 (SERCOM1) — USART Receive Break
64 SERCOM1_0 (SERCOM1) — USART-SPI Data Register Empty/ I2C Stop Received
65 SERCOM1_1 (SERCOM1) — USART-SPI Transmit Complete/ I2C Address Match
66 SERCOM1_2 (SERCOM1) — USART-SPI Receive Complete/ I2C Data Ready
67 SERCOM1_3 (SERCOM1) — USART Receive Start/ SPI Slave Select Low/ I2C TX FIFO Empty
68 SERCOM1_4 (SERCOM1) — USART Clear To Send Input Change/ I2C RX FIFO Full
69 SERCOM2_6 (SERCOM2) — USART/SPI/I2C Error
70 SERCOM2_5 (SERCOM2) — USART Receive Break
71 SERCOM2_0 (SERCOM2) — USART-SPI Data Register Empty/ I2C Stop Received
72 SERCOM2_1 (SERCOM2) — USART-SPI Transmit Complete/ I2C Address Match
73 SERCOM2_2 (SERCOM2) — USART-SPI Receive Complete/ I2C Data Ready
74 SERCOM2_3 (SERCOM2) — USART Receive Start/ SPI Slave Select Low/ I2C TX FIFO Empty
75 SERCOM2_4 (SERCOM2) — USART Clear To Send Input Change/ I2C RX FIFO Full
76 SERCOM3_6 (SERCOM3) — USART/SPI/I2C Error
77 SERCOM3_5 (SERCOM3) — USART Receive Break
78 SERCOM3_0 (SERCOM3) — USART-SPI Data Register Empty/ I2C Stop Received
79 SERCOM3_1 (SERCOM3) — USART-SPI Transmit Complete/ I2C Address Match
80 SERCOM3_2 (SERCOM3) — USART-SPI Receive Complete/ I2C Data Ready
81 SERCOM3_3 (SERCOM3) — USART Receive Start/ SPI Slave Select Low/ I2C TX FIFO Empty
82 SERCOM3_4 (SERCOM3) — USART Clear To Send Input Change/ I2C RX FIFO Full
83 SERCOM4_6 (SERCOM4) — USART/SPI/I2C Error
84 SERCOM4_5 (SERCOM4) — USART Receive Break
85 SERCOM4_0 (SERCOM4) — USART-SPI Data Register Empty/ I2C Stop Received
86 SERCOM4_1 (SERCOM4) — USART-SPI Transmit Complete/ I2C Address Match
87 SERCOM4_2 (SERCOM4) — USART-SPI Receive Complete/ I2C Data Ready
88 SERCOM4_3 (SERCOM4) — USART Receive Start/ SPI Slave Select Low/ I2C TX FIFO Empty
89 SERCOM4_4 (SERCOM4) — USART Clear To Send Input Change/ I2C RX FIFO Full
90 SERCOM5_6 (SERCOM5) — USART/SPI/I2C Error
91 SERCOM5_5 (SERCOM5) — USART Receive Break
92 SERCOM5_0 (SERCOM5) — USART-SPI Data Register Empty/ I2C Stop Received
93 SERCOM5_1 (SERCOM5) — USART-SPI Transmit Complete/ I2C Address Match
94 SERCOM5_2 (SERCOM5) — USART-SPI Receive Complete/ I2C Data Ready
95 SERCOM5_3 (SERCOM5) — USART Receive Start/ SPI Slave Select Low/ I2C TX FIFO Empty
96 SERCOM5_4 (SERCOM5) — USART Clear To Send Input Change/ I2C RX FIFO Full
125 TCC0_OTHER (TCC0) — Error/Overflow/Underflow/Fault Interrupt
126 TCC0_CNT_TRIG (TCC0) — Counter/Re-Trigger Interrupt
{n+127} TCC0_MC{n} (TCC0) (n=0..7) — TCC Match/Compare {n}
135 TCC1_OTHER (TCC1) — Error/Overflow/Underflow/Fault Interrupt
136 TCC1_CNT_TRIG (TCC1) — Counter/Re-Trigger Interrupt
{n+137} TCC1_MC{n} (TCC1) (n=0..7) — TCC Match/Compare {n}
145 TCC2_OTHER (TCC2) — Error/Overflow/Underflow/Fault Interrupt
146 TCC2_CNT_TRIG (TCC2) — Counter/Re-Trigger Interrupt
147 TCC2_MC0 (TCC2) — TCC Match/Compare 0
148 TCC2_MC1 (TCC2) — TCC Match/Compare 1
149 TCC2_MC2 (TCC2) — TCC Match/Compare 2
150 TCC2_MC3 (TCC2) — TCC Match/Compare 3
151 TCC2_MC4 (TCC2) — TCC Match/Compare 4
152 TCC2_MC5 (TCC2) — TCC Match/Compare 5
153 TCC3_OTHER (TCC3) — Error/Overflow/Underflow/Fault Interrupt
154 TCC3_CNT_TRIG (TCC3) — Counter/Re-Trigger Interrupt
155 TCC3_MC0 (TCC3) — TCC Match/Compare 0
156 TCC3_MC1 (TCC3) — TCC Match/Compare 1
157 TCC4_OTHER (TCC4) — Error/Overflow/Underflow/Fault Interrupt
158 TCC4_CNT_TRIG (TCC4) — Counter/Re-Trigger Interrupt
159 TCC4_MC0 (TCC4) — TCC Match/Compare 0
160 TCC4_MC1 (TCC4) — TCC Match/Compare 1
161 TCC5_OTHER (TCC5) — Error/Overflow/Underflow/Fault Interrupt
162 TCC5_CNT_TRIG (TCC5) — Counter/Re-Trigger Interrupt
163 TCC5_MC0 (TCC5) — TCC Match/Compare 0
164 TCC5_MC1 (TCC5) — TCC Match/Compare 1
165 TCC6_OTHER (TCC6) — Error/Overflow/Underflow/Fault Interrupt
166 TCC6_CNT_TRIG (TCC6) — Counter/Re-Trigger Interrupt
167 TCC6_MC0 (TCC6) — TCC Match/Compare 0
168 TCC6_MC1 (TCC6) — TCC Match/Compare 1
169 TCC7_OTHER (TCC7) — Error/Overflow/Underflow/Fault Interrupt
170 TCC7_CNT_TRIG (TCC7) — Counter/Re-Trigger Interrupt
171 TCC7_MC0 (TCC7) — TCC Match/Compare 0
172 TCC7_MC1 (TCC7) — TCC Match/Compare 1
173 TCC8_OTHER (TCC8) — Error/Overflow/Underflow/Fault Interrupt
174 TCC8_CNT_TRIG (TCC8) — Counter/Re-Trigger Interrupt
175 TCC8_MC0 (TCC8) — TCC Match/Compare 0
176 TCC8_MC1 (TCC8) — TCC Match/Compare 1
177 TCC9_OTHER (TCC9) — Error/Overflow/Underflow/Fault Interrupt
178 TCC9_CNT_TRIG (TCC9) — Counter/Re-Trigger Interrupt
179 TCC9_MC0 (TCC9) — TCC Match/Compare 0
180 TCC9_MC1 (TCC9) — TCC Match/Compare 1
181 TCC9_MC2 (TCC9) — TCC Match/Compare 2
182 TCC9_MC3 (TCC9) — TCC Match/Compare 3
183 TCC9_MC4 (TCC9) — TCC Match/Compare 4
184 TCC9_MC5 (TCC9) — TCC Match/Compare 5
185 ADC_GLOBAL (ADC) — ADC Global Interrupt
186 ADC_CORE1 (ADC) — ADC Core 1 Interrupt
187 ADC_CORE2 (ADC) — ADC Core 2 Interrupt
188 ADC_CORE3 (ADC) — ADC Core 3 Interrupt
189 ADC_CORE4 (ADC) — ADC Core 4 Interrupt
190 AC — Analog Comparator Interrupt
191 PTC — Peripheral Touch Controller
192 SPI_IXS0 — Audio SPI Interrupt 0
194 CAN0 — Controller Area Network 0
195 CAN1 — Controller Area Network 1
196 CAN2 — Controller Area Network 2
197 CAN3 — Controller Area Network 3
202 ETH_PRI_Q_0 (ETH) — Ethernet MAC Interrupt
203 ETH_PRI_Q_1 (ETH) — Ethernet MAC Queue 1 Interrupt
204 ETH_PRI_Q_2 (ETH) — Ethernet MAC Queue 2 Interrupt
205 ETH_PRI_Q_3 (ETH) — Ethernet MAC Queue 3 Interrupt
206 ETH_PRI_Q_4 (ETH) — Ethernet MAC Queue 4 Interrupt
207 ETH_PRI_Q_5 (ETH) — Ethernet MAC Queue 5 Interrupt
208 SQI0 — Quad SPI Interrupt 0
210 TRNG — True Random Generator
211 SDMMC0 — SD/MMC Host Controller Interrupt 0
213 USBHS0 — High Speed USB Interrupt 0
215 HSM_TAMPER (HSM) — Hardware Security Module Tamper Interrupt
216 HSM_TXINT (HSM) — Hardware Security Module Transmit Interrupt
217 HSM_RXINT (HSM) — Hardware Security Module Receive Interrupt
218 MLB_GENERAL (MLB) — Media Local Bus General Interrupt
219 MLB_BUSREQ (MLB) — Media Local Bus Request Interrupt
220 CM7H_CTIIRQ_0 (CM7H) — Cross Trigger Interface Interrupt 0
221 CM7H_CTIIRQ_1 (CM7H) — Cross Trigger Interface Interrupt 1

## Event generators
1 SUPC_LVDET, 2 OSCCTRL_XOSC_FAIL, 3 OSC32KCTRL_XOSC32K_FAIL, 4 FREQM_DONE, 5 FREQM_WINMON, {n+6} RTC_PER_{n} (n=0..7), {n+14} RTC_CMP_{n} (n=0..3), 18 RTC_TAMPER, 19 RTC_OVF, 20 RTC_PERD, {n+21} EIC_EXTINT_{n} (n=0..15), 37 PAC_ACCERR, {n+38} DMA_CH_{n} (n=0..15), {11n+54} TCC{n}_OVF (n=0..2), {11n+55} TCC{n}_TRG (n=0..2), {11n+56} TCC{n}_CNT (n=0..2), {11n+57} TCC{n}_MC_0 (n=0..2), {11n+58} TCC{n}_MC_1 (n=0..2), {11n+59} TCC{n}_MC_2 (n=0..2), {11n+60} TCC{n}_MC_3 (n=0..2), {11n+61} TCC{n}_MC_4 (n=0..2), {11n+62} TCC{n}_MC_5 (n=0..2), 63 TCC0_MC_6, 64 TCC0_MC_7, 74 TCC1_MC_6, 75 TCC1_MC_7, {5n+70} TCC{n}_OVF (n=3..9), {5n+71} TCC{n}_TRG (n=3..9), {5n+72} TCC{n}_CNT (n=3..9), {5n+73} TCC{n}_MC_0 (n=3..9), {5n+74} TCC{n}_MC_1 (n=3..9), 120 TCC9_MC_2, 121 TCC9_MC_3, 122 TCC9_MC_4, 123 TCC9_MC_5, {n+124} ADC_CHRDYC_{n} (n=0..3), {n+128} ADC_CMP_{n} (n=0..3), 132 AC_COMP_0, 133 AC_COMP_1, 134 AC_WIN_0, 135 PTC_EOC, 136 PTC_WCOMP, 137 ETH_TSU_CMP, 138 TRNG_READY

## Event users
0 FREQM_START, 1 RTC_TAMPER, {n+2} PORT_EV_{n} (n=0..3), {n+6} DMA_CHSTRT_{n} (n=0..15), {n+22} DMA_CHAUX_{n} (n=0..15), {10n+38} TCC{n}_EV_0 (n=0..2), {10n+39} TCC{n}_EV_1 (n=0..2), {10n+40} TCC{n}_MC_0 (n=0..2), {10n+41} TCC{n}_MC_1 (n=0..2), {10n+42} TCC{n}_MC_2 (n=0..2), {10n+43} TCC{n}_MC_3 (n=0..2), {10n+44} TCC{n}_MC_4 (n=0..2), {10n+45} TCC{n}_MC_5 (n=0..2), 46 TCC0_MC_6, 47 TCC0_MC_7, 56 TCC1_MC_6, 57 TCC1_MC_7, {4n+54} TCC{n}_EV_0 (n=3..9), {4n+55} TCC{n}_EV_1 (n=3..9), {4n+56} TCC{n}_MC_0 (n=3..9), {4n+57} TCC{n}_MC_1 (n=3..9), 94 TCC9_MC_2, 95 TCC9_MC_3, 96 TCC9_MC_4, 97 TCC9_MC_5, {n+98} ADC_TRIGGERS_{n} (n=0..10), 109 AC_SOC_0, 110 AC_SOC_1, 111 PTC_DSEQR, 112 PTC_STCONV, {n+113} HSM_TAMPER_{n} (n=0..3)

## Properties
SIGNATURES: DSU_DID=0x1921A053

## Pinouts (pin number, pad)
PIC32CZCA144LUX: A2 PD11, A3 PD10, A4 PD07, A5 PD21, A6 PD04, A7 PD15, A8 PD02, A9 PD01, A10 PD00, A11 USBID0, A12 VCCA3P30, A13 VBUS0, B1 PA01, B2 PD12, B3 PD09, B4 PD08, B5 VDDREG, B6 PD17, B7 PD16, B8 PC17, B9 PD13, B10 RESET_N, B11 USBRBIAS0, B12 VSSUSBA, B13 USBDM0, B14 USBDP0, C1 PA02, C2 PA00, C13 PC14, C14 PC29, D1 PA03, D2 PA04, D5 PD06, D6 PD19, D9 PD03, D10 PD14, D13 VSSF, D14 VDDF, E1 PA05, E2 PA06, E4 PA22, E5 PD20, E6 PD05, E7 VDDIO, E8 PD18, E9 PC18, E10 VDDREG, E11 PC15, E13 PC20, E14 PC19, F1 PA08, F2 PA07, F4 PA23, F5 PA21, F6 VDDIO, F7 VSS, F8 VDDIO, F9 VSSREG, F10 PC13, F11 PC12, F13 PC27, F14 PC28, G1 PA25, G2 PA24, G5 VDDIO, G6 VSS, G7 VSS15, G8 VSS14, G9 VDDIO, G10 PC26, G13 PC10, G14 PC11, H1 PA10, H2 PA09, H5 PB03, H6 VDDIO, H7 VSSUSBD, H8 VSS, H9 VSSF, H10 VDDIO, H13 PC25, H14 PC09, J1 PA27, J2 PA26, J4 PB01, J5 PB18, J6 VSS, J7 VDDIO, J8 VSS, J9 VDDIO, J10 PC24, J11 PC23, J13 PC07, J14 PC06, K1 PA11, K2 PA12, K4 PB02, K5 PB19, K6 PB06, K7 VSS, K8 VDDIO, K9 PB09, K10 PC08, K11 PC22, K13 PC21, K14 PC05, L1 PA13, L2 PA14, L5 PB20, L6 PB21, L9 PB10, L10 PB11, L13 PC04, L14 PC02, M1 PA28, M2 PA29, M13 PC03, M14 PC01, N1 PA17, N2 PA18, N3 PA16, N4 PB00, N5 AVDD, N6 PB05, N7 PB23, N8 PB08, N9 VDDREG, N10 PB26, N11 PB13, N12 PB15, N13 PB17, N14 PC00, P2 PA20, P3 PA15, P4 PA19, P5 AVSS, P6 PB04, P7 PB22, P8 PB07, P9 PB24, P10 PB25, P11 PB12, P12 PB14, P13 PB16
PIC32CZCA1448YX: 1 PA00, 2 PA01, 3 PA02, 4 PA03, 5 PA04, 6 GND, 7 VDDIO, 8 PA05, 9 PA06, 10 PA21, 11 PA22, 12 PA23, 13 PA07, 14 PA08, 15 PA09, 16 PA24, 17 PA25, 18 GND, 19 VDDIO, 20 PA10, 21 PA11, 22 PA26, 23 PA27, 24 PA12, 25 PA13, 26 PA14, 27 PA28, 28 PA29, 29 PA15, 30 GND, 31 VDDIO, 32 PA16, 33 PA17, 34 PA18, 35 PA19, 36 PA20, 37 PB00, 38 PB01, 39 PB02, 40 PB03, 41 PB18, 42 PB19, 43 PB20, 44 AVSS, 45 AVDD, 46 PB04, 47 PB05, 48 VDDIO, 49 GND, 50 PB21, 51 PB06, 52 PB22, 53 PB23, 54 PB07, 55 PB08, 56 VDDIO, 57 GND, 58 PB09, 59 PB10, 60 PB11, 61 PB24, 62 PB25, 63 PB26, 64 PB12, 65 VDDREG, 66 GND, 67 VDDIO, 68 PB13, 69 PB14, 70 PB15, 71 PB16, 72 PB17, 73 PC00, 74 PC01, 75 PC02, 76 PC03, 77 PC04, 78 VDDF, 79 VSSF2, 80 PC05, 81 PC06, 82 PC21, 83 PC22, 84 PC07, 85 PC08, 86 PC23, 87 PC24, 88 PC09, 89 PC25, 90 VDDIO, 91 GND, 92 PC26, 93 PC10, 94 PC11, 95 PC27, 96 PC28, 97 PC12, 98 PC13, 99 PC29, 100 PC14, 101 PC15, 102 VDDF, 103 VSSF1, 104 RESET_N, 105 PC17, 106 PC18, 107 PC19, 108 PC20, 109 USBDM0, 110 USBDP0, 111 USBID0, 112 VCCA3P30, 113 VSSUSBA, 114 VBUS0, 115 USBRBIAS0, 116 GND, 117 VDDREG, 118 PD00, 119 PD01, 120 PD13, 121 PD14, 122 PD02, 123 PD03, 124 GND, 125 VDDIO, 126 PD15, 127 PD16, 128 PD17, 129 PD04, 130 PD18, 131 PD19, 132 PD05, 133 PD06, 134 PD20, 135 PD21, 136 PD07, 137 VDDREG, 138 GND, 139 VDDIO, 140 PD08, 141 PD09, 142 PD10, 143 PD11, 144 PD12

## Notices in the file
Copyright (c) 2021 Microchip Technology Inc.
SPDX-License-Identifier: Apache-2.0
Licensed under the Apache License, Version 2.0 (the "License");
you may not use this file except in compliance with the License.
You may obtain a copy of the License at
http://www.apache.org/licenses/LICENSE-2.0
Unless required by applicable law or agreed to in writing, software
distributed under the License is distributed on an "AS IS" BASIS,
WITHOUT WARRANTIES OR CONDITIONS OF ANY KIND, either express or implied.
See the License for the specific language governing permissions and
limitations under the License.
