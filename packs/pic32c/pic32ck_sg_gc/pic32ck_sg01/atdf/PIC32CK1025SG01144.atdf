# PIC32CK1025SG01144 device description
Architecture: CORTEX-M33; Family: PIC32CK; Series: PIC32CKSG01
Parameters: GCLK_ID_TRACE=47 (Index of Generic Clock), LITTLE_ENDIAN=1, NUM_IRQ=158 (Number of Interrupt Requests), __BKPT_NUM=8 (Number of FPB breakpoint comparators), __CM33_REV=0x0000 (Cortex-M33 Revision), __DEBUG_LVL=2 (Debug Level), __DSP_PRESENT=1 (DSP extension present or not), __ETM_PRESENT=1 (ETM present or not), __FPU_PRESENT=1 (FPU present or not), __ITM_PRESENT=1 (ITM present or not), __MPU_NS_REGIONS=8 (Number of MPU_NS regions), __MPU_PRESENT=1 (MPU present or not), __MPU_S_REGIONS=8 (Number of MPU_S regions), __MTB_PRESENT=0 (MTB present or not), __NVIC_PRIO_BITS=3 (Number of NVIC Priority bits), __SAU_PRESENT=0 (SAU present or not), __SEC_ENABLED=1 (TrustZone-M enabled or not), __SYST_NUM=2 (Number of SysTick instances), __TRACE_LVL=2 (Trace Level), __VTOR_PRESENT=1 (Vector Table Offset Register present or not), __Vendor_SysTickConfig=0 (Set to 1 if different SysTick Config is used), __WPT_NUM=4 (Number of DWT watchpoint comparators), POWER_DOMAIN=PD_CORE_SW, __ARCH_ARM=1, __ARCH_ARM_CORTEX_M=1
Programming and debug interfaces: JTAG, SWD
Registers are 32-bit, read-write, reset 0x0 unless marked. A register's access mark holds for its fields unless they carry their own. Offsets are from the block's base; lines under a group give offsets from that group; [hi:lo] are bit positions; {n}, {i} and the like mark numbered series; 'fields as' and 'values as' point back to an identical list; <NAME> marks a mode.

## Ordering variants
PIC32CK1025SG01144-I/PH: TQFP144, pinout P144, up to 120 MHz, -40 to 85 C, 1.71 to 3.60 V
PIC32CK1025SG01144-E/PH: TQFP144, pinout P144, up to 120 MHz, -40 to 125 C, 1.71 to 3.60 V

## Memory
base space: start 0 size 0x100000000, little endian
  0x0 CMCC_DATARAM size 0x1000 ram, rw, executable
  0x1000 CMCC_TAGRAM size 0x400 ram, rw
  0x3000 CMCC_VALIDRAM size 0x40 ram, rw
  0x4000000 PRM_ROM size 0x8000 rom, ro, executable
  0x8000000 FLASH_BFM size 0x20000 flash, rw, executable, page 4096
  0xA000000 FLASH_CFM_USERCFG1 size 0x1000 flash, rw, page 4096
  0xA001000 FLASH_CFM_USEROTP1 size 0x1000 user_signatures, rw, page 4096
  0xA002000 FLASH_CFM_BOOTCFG1 size 0x1000 flash, rw, page 4096
  0xA004000 FLASH_CFM_DALCFG size 0x1000 flash, rw, page 4096
  0xA006000 FLASH_CFM_CALBACKUP size 0x1000 flash, rw, page 4096
  0xA007000 FLASH_CFM_CALOTP size 0x1000 other, ro, page 4096
  0xA008000 FLASH_CFM_USERCFG2 size 0x1000 flash, rw, page 4096
  0xA009000 FLASH_CFM_USEROTP2 size 0x1000 user_signatures, rw, page 4096
  0xA00A000 FLASH_CFM_BOOTCFG2 size 0x1000 flash, rw, page 4096
  0xC000000 FLASH_PFM size 0x100000 flash, rw, executable, page 4096
  0xFFFF000 SQI_SFR size 0x1000 io, rw
  0x10000000 SQI_XIP size 0x10000000 ram, rw, executable, external
  0x20000000 HSRAM_RET size 0x40000 ram, rw, executable
  0x44000000 HPB0_BRIDGE size 0x30000 io, rw
  0x44800000 HPB1_BRIDGE size 0x30000 io, rw
  0x45000000 HPB2_BRIDGE size 0x30000 io, rw
  0x46000000 USBHS_SFR size 0x1600 io, rw
  0x48000000 HSM_SFR size 0x1000 io, rw
  0x60000000 EBI_CS0 size 0x1000000 ram, rw, executable, external
  0x61000000 EBI_CS1 size 0x1000000 ram, rw, executable, external
  0x62000000 EBI_CS2 size 0x1000000 ram, rw, executable, external
  0x63000000 EBI_CS3 size 0x1000000 ram, rw, executable, external
  0xE0000000 PPB size 0x100000 io, rw

## Peripheral instances (address, pins/pin function, parameters)
AC at 0x45012000
  pins: AIN0 PA06/B; AIN1 PA07/B; AIN2 PC06/B; AIN3 PC07/B; CMP0 PA11/M set 3 or PC09/M set 1 or PC21/M set 2; CMP1 PA12/M set 3 or PC15/M set 1 or PC22/M set 2
  parameters: ATEST_IMPLEMENTED=1 (Defines if the ATEST register is implemented), ATEST_SIZE=2 (Defines the number of effective bits in ATEST register), DACVALUE_BIT=7 (Defines the number of bits in DACCTRLn.VALUE), GCLK_ID=34 (Index of Generic Clock), IO_INPUTS=4 (Defines the number of AC pair inputs connected to IO pins), PAIRS=1 (Defines the number of AC pairs), INSTANCE_ID=73 (Instance index for AC), MCLK_ID_APB=105 (Index for AC APB clock), PAC_ID=73 (Index for AC registers write protection), NUM_CMP=2 (Number of comparators), LOAD_CALIB=0 (Defines if calibration is required)
ADC at 0x45010000
  pins: VINM0 PA05/B; VINM2 PA07/B; VINM4 PA18/B; VINP{n} PA{n+4:02}/B (n=0..8); VINP9 PB00/B; VINP10 PB11/B; VINP11 PB12/B; VREFP0 PB01/B
  parameters: APB_FIFO_DEPTH=16 (Number of Words in APB FIFO), CHNSAR_NMBR1=15 (Number of Channels on SARCORE number 1), CHNSAR_NMBR2=0 (Number of Channels on SARCORE number 2), CHNSAR_NMBR3=0 (Number of Channels on SARCORE number 3), CHNSAR_NMBR4=0 (Number of Channels on SARCORE number 4), DCMP_NMBR=1 (Number of Digital Comparators Max=4), DMAC_ID_PFFRDY=61, EARLY_INTR_PRESENT=1 (Early Interrupts Present), FLTR_NMBR=1 (Number of Digital Filters, Max=0), GCLK_ID=33 (Index of Generic Clock), OCP_ADDR_WIDTH=0 (OCP Address Width), OCP_FIFO_DEPTH=0 (Number of Words in OCP DMA FIFO), OCP_PORT_PRESENT=0 (OCP DMA Bus Master Present), SARCORE_NMBR=1 (Number of SARCOREs. Max=4, Min-1), TRGS_NMBR=16 (Number of Trigger Sources, Max=16), VREF_STARTUP_TIME=50 (Number of Control Clock cycles for VREF to stabalize), INSTANCE_ID=72 (Instance index for ADC), MCLK_ID_APB=104 (Index for ADC APB clock), PAC_ID=72 (Index for ADC registers write protection)
BSDAP
  pins: TCK_SWCLK PA03/G set 1; TDI PA00/G set 1; TDO PA01/G set 1; TMS_SWDIO PA02/G set 1
  parameters: MCLK_ID_DAP=115 (Index for BSDAP DAP clock)
CAN0 at 0x4501E000 (CAN)
  pins: RX PB09/H set 1 or PB17/H set 3 or PB22/H set 4 or PC03/H set 2 or PD19/H set 5; TX PB08/H set 1 or PB16/H set 3 or PB21/H set 4 or PC02/H set 2 or PD18/H set 5
  parameters: DMAC_ID_DEBUG=68 (DMA CAN Debug Req), ECC_BERR_IMPLEMENTED=0 (ECC error), EXT_TSTAMP_IMPLEMENTED=0 (External time stamp), GCLK_ID=39 (Index of Generic Clock), MSG_RAM_ADDR=0x20 (8-bits MSB), RXD_SYNC_METHOD=0 (RXD Synchronization Method), INSTANCE_ID=79 (Instance index for CAN0), MCLK_ID_AHB=13 (Index for CAN0 AHB clock), PAC_ID=79 (Index for CAN0 registers write protection)
CAN1 at 0x45020000 (CAN)
  pins: RX PB01/H set 1 or PB24/H set 3 or PC07/H set 2 or PD21/H set 4; TX PB00/H set 1 or PB23/H set 3 or PC06/H set 2 or PD20/H set 4
  parameters: DMAC_ID_DEBUG=69 (DMA CAN Debug Req), ECC_BERR_IMPLEMENTED=0 (ECC error), EXT_TSTAMP_IMPLEMENTED=0 (External time stamp), GCLK_ID=40 (Index of Generic Clock), MSG_RAM_ADDR=0x20 (8-bits MSB), RXD_SYNC_METHOD=0 (RXD Synchronization Method), INSTANCE_ID=80 (Instance index for CAN1), MCLK_ID_AHB=14 (Index for CAN1 AHB clock), PAC_ID=80 (Index for CAN1 registers write protection)
CCL at 0x4501A000
  pins: IN0 PB07/M set 1 or PB22/M set 2; IN1 PB08/M set 1 or PB23/M set 2; IN2 PB09/M set 1 or PB24/M set 2; IN3 PC10/M set 1 or PC24/M set 2; IN4 PC11/M set 1 or PC25/M set 2; IN5 PC12/M set 1 or PC26/M set 2; IN6 PD08/M set 1 or PD17/M set 2; IN7 PD09/M set 1 or PD18/M set 2; IN8 PD10/M set 1 or PD19/M set 2; IN9 PA04/M set 1 or PA13/M set 2; IN10 PA05/M set 1 or PA14/M set 2; IN11 PA06/M set 1 or PA15/M set 2; OUT0 PB10/M set 1 or PB25/M set 2; OUT1 PC13/M set 1 or PC27/M set 2; OUT2 PD11/M set 1 or PD20/M set 2; OUT3 PA07/M set 1 or PA16/M set 2
  parameters: GCLK_ID=37 (GCLK index for CCL), LUT_NUM=4 (Number of LUT in a CCL), INSTANCE_ID=77 (Instance index for CCL), MCLK_ID_APB=109 (Index for CCL APB clock), PAC_ID=77 (Index for CCL registers write protection)
CMCC at 0x44808000
  parameters: INSTANCE_ID=36 (Instance index for CMCC), MCLK_ID_AHB=11 (Index for CMCC AHB clock), PAC_ID=36 (Index for CMCC registers write protection)
CoreDebug at 0xE000EDF0
CoreDebug_NS at 0xE002EDF0 (CoreDebug)
DIB at 0xE000EFB0
DIB_NS at 0xE002EFB0 (DIB)
DMA0 at 0x44802000 (DMA)
  parameters: DMAC_ID_EVSYS=1 (Events trigger index), DMAC_ID_SWTRG=0 (Software trigger index), INSTANCE_ID=33 (Instance index for DMA0), MCLK_ID_AHB=8 (Index for DMA0 AHB clock), MCLK_ID_APB=65 (Index for DMA0 APB clock), PAC_ID=33 (Index for DMA0 registers write protection)
DMA1 at 0x44804000 (DMA)
  parameters: DMAC_ID_EVSYS=1 (Events trigger index), DMAC_ID_SWTRG=0 (Software trigger index), INSTANCE_ID=34 (Instance index for DMA1), MCLK_ID_AHB=9 (Index for DMA1 AHB clock), MCLK_ID_APB=66 (Index for DMA1 APB clock), PAC_ID=34 (Index for DMA1 registers write protection)
DSU at 0x44000000
  parameters: BMX_ERROR_SUPPORT=0 (Defines whether DSU APB errors are reported as 2-cycles bus errors to the AHB AP0 master), DAL1_IMPLEMENTED=1 (Debug Access Level 1 (Non-Secure) Implemented? for TZ devices only), DMAC_ID_DCC0=2 (DMAC ID for DCC0 register), DMAC_ID_DCC1=3 (DMAC ID for DCC1 register), INSTANCE_ID=0 (Instance index for DSU), MCLK_ID_AHB=3 (Index for DSU AHB clock), MCLK_ID_APB=32 (Index for DSU APB clock), PAC_ID=0 (Index for DSU registers write protection)
DWT at 0xE0001000
  parameters: __WPT_NUM=4 (Number of DWT watchpoint comparators)
EBI at 0x4502C000
  pins: A2 PC19/E; A3 PC18/E; A4 PC17/E; A5 PC16/E; A6 PC15/E; A7 PC05/E; A8 PC14/E; A9 PC04/E; A10 PC03/E; A11 PC02/E; A12 PC01/E; A13 PC00/E; A14 PB10/E; A15 PB09/E; A16 PC27/E or PD08/E; A17 PC26/E or PD07/E; A18 PB25/E or PD06/E; A19 PB24/E or PD02/E; A20 PB23/E; A21 PB22/E; A22 PB21/E; A23 PC28/E; D0 PA13/E; D1 PA14/E; D2 PA15/E; D3 PA16/E; D4 PA17/E; D5 PA04/E; D6 PA05/E; D7 PA06/E; D8 PA07/E; D9 PA08/E; D10 PB11/E; D11 PB12/E; D12 PB05/E; D13 PB13/E; D14 PB06/E; D15 PB14/E; NBS0_A0 PB08/E; NBS1_NWR1 PB07/E; NBS2_NWR2_A1 PC20/E; NCS0 PC25/E or PD12/E; NCS1 PC23/E or PD09/E; NCS2 PC29/E; NCS3 PD15/E; NRD PB15/E; NWAIT PA10/E or PC22/E or PD11/E; NWE_NWR0 PC24/E or PD05/E
  parameters: ACTIVE_BS=0 (NBS signal polarity), ACTIVE_CS=0 (NCS signal polarity), ACTIVE_RD=0 (NRD signal polarity), ACTIVE_WR=0 (NWR signal polarity), DATA_PATH_NBR_XOR_LAYERS=2 (Number of XOR layers in datapath), DIFF_CHIP_ID=0x554E (2 ASCII characters to differentiate chips (0x554E <--> "UN")), EMC_DELAY_REGISTER=0 (Electro Magnetic Compatibility control registers embedded ?), EX_WAIT=0 (External Wait signal polarity), MEM_ADDR_SIZE=24 (Memory Interface size (aligned 32 bits)), NB_CS=4 (Number of Chip Select), NB_PAD_NOE=16 (Number of Pad Control), OCMS_INTERFACE=0 (Off Chip Memory Scrambling implemented ?), OVERLOADED=1 (Overloaded Mode implemented ?), INSTANCE_ID=86 (Instance index for EBI), MCLK_ID_AHB=21 (Index for EBI AHB clock), MCLK_ID_APB=114 (Index for EBI APB clock), PAC_ID=86 (Index for EBI registers write protection)
EIC at 0x4401A000, EIC_SEC 0x4401B000
  pins: EXTINT0 PA16/A or PB00/A or PB16/A or PC00/A or PC16/A or PD00/A or PD16/A; EXTINT1 PA01/A or PA17/A or PB01/A or PB17/A or PC01/A or PC17/A or PD01/A or PD17/A; EXTINT2 PA02/A or PA18/A or PB02/A or PB18/A or PC02/A or PC18/A or PD18/A; EXTINT3 PA03/A or PA19/A or PB03/A or PB19/A or PC03/A or PC19/A or PD03/A or PD19/A; EXTINT4 PA04/A or PA20/A or PB04/A or PB20/A or PC04/A or PC20/A or PD04/A or PD20/A; EXTINT5 PA05/A or PA21/A or PB05/A or PB21/A or PC05/A or PC21/A or PD05/A or PD21/A; EXTINT6 PA06/A or PA22/A or PB06/A or PB22/A or PC06/A or PC22/A or PD06/A; EXTINT7 PA07/A or PA23/A or PB07/A or PB23/A or PC07/A or PC23/A or PD07/A; EXTINT8 PA08/A or PA24/A or PB08/A or PB24/A or PC24/A or PD08/A; EXTINT9 PA09/A or PA25/A or PB09/A or PB25/A or PC09/A or PC25/A or PD09/A; EXTINT10 PA10/A or PA26/A or PB10/A or PB26/A or PC10/A or PC26/A or PD10/A; EXTINT11 PA11/A or PA27/A or PB11/A or PC11/A or PC27/A or PD11/A; EXTINT12 PA12/A or PA28/A or PB12/A or PC12/A or PC28/A or PD12/A; EXTINT13 PA13/A or PB13/A or PC13/A or PC29/A or PD13/A; EXTINT14 PA00/A or PB14/A or PC14/A or PD14/A or PA14/A; EXTINT15 PA15/A or PB15/A or PC15/A or PD15/A; NMI PD02/A
  parameters: EXTINT_NUM=16 (Number of external interrupts), GCLK_ID=5 (Generic Clock index), NUMBER_OF_CONFIG_REGS=2 (Number of CONFIG registers), NUMBER_OF_INTERRUPTS=16 (Number of external interrupts (obsolete)), SECURE_IMPLEMENTED=1 (Security Configuration implemented?), INSTANCE_ID=13 (Instance index for EIC), MCLK_ID_APB=45 (Index for EIC APB clock), PAC_ID=13 (Index for EIC registers write protection)
ETH at 0x45022000
  pins: COL PC18/L; CRS PC17/L; MDC PA11/L or PB10/L or PC03/L or PD07/L; MDIO PA12/L or PC02/L or PC04/L or PC21/L or PD06/L; REF_CLK PC00/L; RXD0 PC07/L; RXD1 PC06/L; RXD2 PC05/L; RXD3 PC14/L; RXDV PC10/L; RXER PC09/L; RX_CLK PC15/L; TSUCOMP PD02/L or PD16/L; TXD0 PC12/L; TXD1 PC13/L; TXD2 PC19/L; TXD3 PC20/L; TXEN PC11/L; TXER PC16/L; TX_CLK PC00/L
  parameters: GCLK_ID_TSU=42 (1588 External Clock), GCLK_ID_TX=41 (GIGE/Loopback clock), MEM_MARGINADJ_MSB=9 (Number of Memory Margin Adjust bits), NUM_INT=1 (Number of Interrupts), INSTANCE_ID=81 (Instance index for ETH), MCLK_ID_AHB=15 (Index for ETH AHB clock), MCLK_ID_APB=111 (Index for ETH APB clock), PAC_ID=81 (Index for ETH registers write protection)
EVSYS at 0x4480E000
  parameters: ASYNCHRONOUS_CHANNELS=0xFFFFF000 (Mask of Only Asynchronous Channels), CHANNELS=32 (Total Number of Channels), CHANNELS_BITS=5 (Number of bits to select Channel), GCLK_ID_{n}={n+6} (Index of Generic Clocks for Synchronous Channels {n}) (n=0..11), GENERATORS=125 (Total Number of Event Generators), GENERATORS_BITS=7 (Number of bits to select Event Generator), SECURE_IMPLEMENTED=0 (Security Configuration implemented?), SPLIT_IRQ_NUM=4 (Number of channels with dedicated interrupt line request), SYNCH_NUM=12 (Number of Synchronous Channels), SYNCH_NUM_BITS=4 (Number of bits to select Synchronous Channels), USERS=104 (Total Number of Event Users), USERS_BITS=7 (Number of bits to select Event User), USERS_GROUPS=4 (Number of 32-user Groups), INSTANCE_ID=39 (Instance index for EVSYS), MCLK_ID_APB=70 (Index for EVSYS APB clock), PAC_ID=39 (Index for EVSYS registers write protection)
FCR at 0x44002000
  parameters: INSTANCE_ID=1 (Instance index for FCR), MCLK_ID_AHB=4 (Index for FCR AHB clock), MCLK_ID_APB=33 (Index for FCR APB clock), PAC_ID=1 (Index for FCR registers write protection)
FCW at 0x44004000
  parameters: PFM_NUM_PAGES=256 (No of PFM Pages Per panel), PFM_PAGE_ADDR_MSB=11 (Flash Page Size MSB), PFM_PAGE_SIZE=4096, PFM_PNL_ADDR_MSB=21 (Single flash panel read address MSbit (using byte addressing)), PFM_SIZE=8 (Flash Memory Parameters), PFM_SYS_ADDR_MSB=20 (The MS bit of the system byte address needed to address the entire PFM region (both panels Main)), FLASH_SIZE=1048576, PAGES=256, PAGES_PR_REGION=16, INSTANCE_ID=2 (Instance index for FCW), MCLK_ID_AHB=5 (Index for FCW AHB clock), MCLK_ID_APB=34 (Index for FCW APB clock), PAC_ID=2 (Index for FCW registers write protection)
FPB at 0xE0002000
  parameters: __BKPT_NUM=8 (Number of FPB breakpoint comparators)
FPU at 0xE000EF30
FPU_NS at 0xE002EF30 (FPU)
  parameters: TYPE=8 (FPU architecture type)
FREQM at 0x44014000
  parameters: GCLK_ID_MSR_0=2 (Index of measure generic clock 0), GCLK_ID_MSR_1=3 (Index of measure generic clock 1), GCLK_ID_REF=4 (Index of reference generic clock), MSRCLK_NB=2 (Number of measured clock sources), INSTANCE_ID=10 (Instance index for FREQM), MCLK_ID_APB=42 (Index for FREQM APB clock), PAC_ID=10 (Index for FREQM registers write protection)
FUSES at FUSES_BOOTCFG1 0x0A002000, FUSES_BOOTCFG2 0x0A00A000 (FUSES_BOOTCFG1), FUSES_DALCFG 0x0A004000, FUSES_USERCFG1 0x0A000000, FUSES_USERCFG2 0x0A008000 (FUSES_USERCFG1), FUSES_CALOTP 0x0A007000
  parameters: RDY_MSB=14
GCLK at 0x44010000
  pins: IO0 PA09/M set 2 or PA03/M set 1; IO1 PA01/M set 1 or PA10/M set 2; IO2 PA20/M set 3 or PC00/M set 1 or PD12/M set 2; IO3 PA21/M set 3 or PC01/M set 1 or PD05/M set 2; IO4 PA22/M set 3 or PC02/M set 1 or PD06/M set 2; IO5 PA23/M set 3 or PC03/M set 1 or PD07/M set 2; IO6 PA17/M set 2 or PC04/M set 1; IO7 PA24/M set 2 or PC05/M set 1
  parameters: GEN_BITS=4, GEN_NUM=12 (Number of Generic Clock Generators), GEN_NUM_MSB=11 (Number of Generic Clock Generators - 1), GEN_SOURCE_NUM_MSB=11 (Number of Generic Clock Sources - 1), IO_NUM=8 (Number of Generic Clock I/Os), NUM=48 (Number of Generic Clock Users), SOURCE_BITS=4, SOURCE_NUM=12 (Number of Generic Clock Sources), INSTANCE_ID=8 (Instance index for GCLK), MCLK_ID_APB=40 (Index for GCLK APB clock), PAC_ID=8 (Index for GCLK registers write protection)
HMATRIX at 0x44806000 (HMATRIX2)
  parameters: INSTANCE_ID=35 (Instance index for HMATRIX), MCLK_ID_AHB=10 (Index for HMATRIX AHB clock), MCLK_ID_APB=67 (Index for HMATRIX APB clock), PAC_ID=35 (Index for HMATRIX registers write protection)
HSM at 0x48000000
  parameters: KEN_VALUE=0, g_ClkGating=1, INSTANCE_ID=98 (Instance index for HSM), MCLK_ID_AHB=22 (Index for HSM AHB clock), PAC_ID=98 (Index for HSM registers write protection)
ICB at 0xE000E000
ICB_NS at 0xE002E000 (ICB)
IDAU at 0x4480C000
  parameters: INSTANCE_ID=38 (Instance index for IDAU), MCLK_ID_APB=69 (Index for IDAU APB clock), PAC_ID=38 (Index for IDAU registers write protection), GRANULARITY_ANSC=0x1000 (Application Non-Secure Callable region granularity), GRANULARITY_ANS=0x1000 (Application Non-Secure region granularity), GRANULARITY_AS=0x1000 (Application Secure region granularity), GRANULARITY_RS=0x1000 (RAM Secure region granularity), GRANULARITY_RNS=0x1000 (RAM Non-Secure region granularity), GRANULARITY_BNSC=0x1000 (Boot Flash Non-Secure Callable region granularity), GRANULARITY_BOOTPROT=0x1000 (BOOTPROT region granularity), GRANULARITY_BS=0x1000 (Boot Flash Secure region granularity), REGION_CMCCDS=0x01 (CMCC DATA RAM Secure region ID), REGION_CMCCTS=0x02 (CMCC TAG RAM Secure region ID), REGION_CMCCVS=0x03 (CMCC VALID RAM Secure region ID), REGION_BOOTROM=0x04 (Boot ROM region ID), REGION_BS=0x05 (Boot Flash Secure region ID), REGION_BNSC=0x06 (Boot Flash Non-Secure Callable region ID), REGION_CFMS=0x07 (CONFIGURATION Flash Secure region ID), REGION_AS=0x08 (Application Secure region ID), REGION_ANSC=0x09 (Application Non-Secure Callable region ID), REGION_ANS=0x0A (Application Non-Secure region ID), REGION_RS=0x0D (RAM Secure region ID), REGION_RNS=0x0E (RAM Non-Secure region ID), REGION_HPB0=0x0F (Peripheral Bus A region ID), REGION_HPB1=0x10 (Peripheral Bus B region ID), REGION_HPB2=0x11 (Peripheral Bus C region ID), REGION_USBHS=0x12 (USB SFR region ID), REGION_HSM=0x13 (HSM region ID), REGION_OTHER=0x00 (Other region ID)
ITM at 0xE0000000
MCLK at 0x44012000
  parameters: DIV_CLK_NUM=1, INSTANCE_ID=9 (Instance index for MCLK), MCLK_ID_APB=41 (Index for MCLK APB clock), PAC_ID=9 (Index for MCLK registers write protection)
MPU at 0xE000ED90
MPU_NS at 0xE002ED90 (MPU)
  parameters: __MPU_NS_REGIONS=8 (Number of MPU_NS regions), __MPU_S_REGIONS=8 (Number of MPU_S regions)
NVIC at 0xE000E100
NVIC_NS at 0xE002E100 (NVIC)
  parameters: NUM_IRQ=158 (Number of interrupt request lines)
OSC32KCTRL at 0x4400E000
  pins: XIN32 PB02/XIN32; XOUT32 PB03/XOUT32
  parameters: INSTANCE_ID=7 (Instance index for OSC32KCTRL), MCLK_ID_APB=39 (Index for OSC32KCTRL APB clock), PAC_ID=7 (Index for OSC32KCTRL registers write protection)
OSCCTRL at 0x4400C000
  pins: XIN PD00/XIN; XOUT PD01/XOUT
  parameters: DFLL48M_ATEST_IMPLEMENTED=1 (DFLL48M ATEST register implemented), DFLL48M_ATEST_SIZE=8 (number of effective bits in DFLL48M ATEST register), DFLL48M_IS_STARTUP_OSCILLATOR=1, DFLL48M_RC48MCAL0_PORVAL=0 (Defines the RC48MCAL0 register reset value after POR.), DIV_8MHZ_NUM=2, FRACDIVS_NUM=1 (Number of FRACDIVs), FRACDIV_DIVIDER_RESET_VAL=32 (Fracdiv Divider reset value), FRACDIV_PLLSRC=0 (Indice of the PLL that is source of the FRACDIV), GCLK_ID_DFLL48M=0 (Index of Generic Clock for DFLL48), GCLK_ID_PLL=1 (Index of Generic Clock for PLL), PLLS_NUM=1 (Number of PLLs), PLL0_OUTPUTS_NUM=6 (number of clock outputs for PLL0), PLL1_OUTPUTS_NUM=0 (number of clock outputs for PLL1), USBHS_NUM=1 (Number of usbhs clock requests), XOSC_ATEST_IMPLEMENTED=1 (XOSC ATEST register implemented), XOSC_ATEST_SIZE=4 (number of effective bits in XOSC ATEST register), XOSC_CFD_CLK_SELECT_SIZE=4 (Clock fail prescaler size), XOSC_CFD_HAS_RETENTION=0 (Clock fail detected for xosc is in tetention domain), INSTANCE_ID=6 (Instance index for OSCCTRL), MCLK_ID_APB=38 (Index for OSCCTRL APB clock), PAC_ID=6 (Index for OSCCTRL registers write protection)
PAC at 0x4401C000
  parameters: HMATRIX1_IMPLEMENTED=0, HPB_NUM=4 (Number of bridges AHB/APB), SECURE_IMPLEMENTED=0 (Security Configuration implemented?), INSTANCE_ID=14 (Instance index for PAC), MCLK_ID_AHB=6 (Index for PAC AHB clock), MCLK_ID_APB=46 (Index for PAC APB clock), PAC_ID=14 (Index for PAC registers write protection)
PCC at 0x45018000
  pins: CLK PA20/K set 2 or PC05/K set 1; DATA0 PA21/K set 2 or PC01/K set 1; DATA1 PA22/K set 2 or PC02/K set 1; DATA2 PA23/K set 2 or PC03/K set 1; DATA3 PA24/K set 2 or PB07/K set 1; DATA4 PA25/K set 2 or PB08/K set 1; DATA5 PA26/K set 2 or PB09/K set 1; DATA6 PA27/K set 2 or PB10/K set 1; DATA7 PA28/K set 2 or PC00/K set 1; DATA8 PB18/K set 2 or PC15/K set 1; DATA9 PB19/K set 2 or PC16/K set 1; DATA10 PB20/K set 2 or PC17/K set 1; DATA11 PB26/K set 2 or PC18/K set 1; DATA12 PC19/K set 1 or PC21/K set 2; DATA13 PC20/K set 1 or PC22/K set 2; DEN1 PA10/K set 1 2 or PC04/K set 1 or PD19/K set 2; DEN2 PC14/K set 1 or PD02/K set 1 2 or PD20/K set 2
  parameters: DATA_SIZE=14, DMAC_ID_RX=67, INSTANCE_ID=76 (Instance index for PCC), MCLK_ID_APB=108 (Index for PCC APB clock), PAC_ID=76 (Index for PCC registers write protection)
PDEC at 0x4501C000
  pins: QDI0 PA20/G set 3 or PB04/G set 1 or PB07/G set 2; QDI1 PA21/G set 3 or PB05/G set 1 or PB08/G set 2; QDI2 PA22/G set 3 or PB09/G set 2 or PB13/G set 1
  parameters: CC_NUM=2 (Number of Compare Channels units), GCLK_ID=38 (Index of Generic Clocks for Synchronous Channels), INSTANCE_ID=78 (Instance index for PDEC), MCLK_ID_APB=110 (Index for PDEC APB clock), PAC_ID=78 (Index for PDEC registers write protection)
PM at 0x44006000
  pins: RESET_N RESET_N
  parameters: BACKUP_IMPLEMENTED=1 (Backup domain is implemented), INSTANCE_ID=3 (Instance index for PM), MCLK_ID_APB=35 (Index for PM APB clock), PAC_ID=3 (Index for PM registers write protection)
PORT at 0x44800000, PORT_SEC 0x44801000
  pins: P{n} PA{n:02} (n=0..28); P{n} PB{n-32:02} (n=32..58); P{n} PC{n-64:02} (n=64..71); P{n} PC{n-64:02} (n=73..93); P{n} PD{n-96:02} (n=96..117)
  parameters: AHB_IMPLEMENTED=0, BITS=118, DRVSTR=0 (Number of DRVSTR bits (0/1/2)), EV_NUM=4, GROUPS=4, HADDR_MSB=31 (AHB bus address MSB), IOBUS_IMPLEMENTED=0, MSB=117, ODRAIN=1 (ODRAIN supported?), PPP_IMPLEMENTED=0 (IOBUS2 implemented?), SECURE_IMPLEMENTED=1 (Secure I/Os supported?), SLEWLIM=2 (Number of SLEWLIM bits (0/1/2)), INSTANCE_ID=32 (Instance index for PORT), MCLK_ID_APB=64 (Index for PORT APB clock), PAC_ID=32 (Index for PORT registers write protection)
PRM at 0x4480A000
  parameters: PRMWS_DEFAULT=0 (Default value of PRMWS register field), ROM_KEN=0 (Value driven on to ROM's KEN input), ROM_SPLIT=0x1C00 (Address defining first restricted address), INSTANCE_ID=37 (Instance index for PRM), MCLK_ID_AHB=12 (Index for PRM AHB clock), MCLK_ID_APB=68 (Index for PRM APB clock), PAC_ID=37 (Index for PRM registers write protection)
PTC at 0x45014000
  pins: DRV0 PA09/N; DRV1 PA10/N; DRV2 PA11/N; DRV3 PA12/N; DRV4 PB00/N; DRV5 PB01/N; DRV6 PB07/N; DRV7 PB08/N; DRV8 PB09/N; DRV9 PB10/N; DRV{n} PC{n-10:02}/N (n=10..17); DRV18 PC13/N; DRV19 PC09/N; DRV20 PC10/N; DRV21 PC11/N; DRV22 PC12/N; DRV23 PC20/N; DRV24 PB16/N; DRV25 PB17/N; DRV26 PC14/N; DRV27 PC15/N; DRV28 PC16/N; DRV29 PC17/N; DRV30 PC18/N; DRV31 PC19/N; ECI0 PA18/N; ECI1 PA19/N
  parameters: DMAC_ID_EOC=64 (Index of DMA EOC trigger), DMAC_ID_SEQ=62 (Index of DMA SEQ trigger), DMAC_ID_WCOMP=63 (Index of DMA WCOMP trigger), GCLK_ID=35 (Index of Generic Clock), LINES_NUM=32 (Number of PTC lines), INSTANCE_ID=74 (Instance index for PTC), MCLK_ID_APB=106 (Index for PTC APB clock), PAC_ID=74 (Index for PTC registers write protection)
RSTC at 0x4400A000
  parameters: BACKUP_IMPLEMENTED=1, CM_DBGRESET_STRETCHED=3 (Reset stretcher size for Cortex CPU related to DBGRESET.), CM_HRESET_N_STRETCHED=3 (Reset stretcher size for Cortex CPU related to HRESETn.), CM_PORESET_STRETCHED=3 (Reset stretcher size for Cortex CPU related to PORESET.), HIB_IMPLEMENTED=1, VBAT_IMPLEMENTED=1 (One if VBAT (Battery backup mode) is supported), INSTANCE_ID=5 (Instance index for RSTC), MCLK_ID_APB=37 (Index for RSTC APB clock), PAC_ID=5 (Index for RSTC registers write protection)
RTC at 0x44018000
  pins: IN0 PB06/RTC_IN; IN1 PB01/RTC_IN; IN2 PB14/RTC_IN; IN3 PB15/RTC_IN; IN4 PB13/RTC_IN; IN5 PB19/RTC_IN; IN6 PB22/RTC_IN; IN7 PB24/RTC_IN; OUT0 PB05/RTC_OUT; OUT1 PB00/RTC_OUT; OUT2 PB11/RTC_OUT; OUT3 PB12/RTC_OUT; OUT4 PB16/RTC_OUT; OUT5 PB18/RTC_OUT; OUT6 PB21/RTC_OUT; OUT7 PB23/RTC_OUT
  parameters: DMAC_ID_TIMESTAMP=4 (DMA RTC timestamp trigger), NUM_OF_ALARMS=2 (Number of Alarms), NUM_OF_BKREGS=0 (Number of Backup Registers), NUM_OF_COMP16=4 (Number of 16-bit Comparators), NUM_OF_TAMPERS=8 (Number of Tamper Inputs), INSTANCE_ID=12 (Instance index for RTC), MCLK_ID_APB=44 (Index for RTC APB clock), PAC_ID=12 (Index for RTC registers write protection)
SCB at 0xE000ED00
SCB_NS at 0xE002ED00 (SCB)
SDMMC0 at 0x45026000 (SDMMC)
  pins: SDCD PA10/I set 1 or PA12/I set 1 or PD12/I set 1; SDCK PD10/I set 1; SDCMD PD06/I set 1; SDDAT0 PD07/I set 1; SDDAT1 PD11/I set 1; SDDAT2 PD08/I set 1; SDDAT3 PD09/I set 1; SDWP PB00/I set 1 or PD05/I set 1
  parameters: CARD_DATA_SIZE=4, CLOCK_MULTIPLIER=2 (Multiplier between "sd_mult_src_clock" and "sd_src_clock"), DDR50_SUPPORT=0 (SD - UHS DDR50 Support Implemented), DIVBY2_FOR_SDSRCCLK=1 (Div-by-2 Source Clock is Implemented), DLL_NB_OF_PHASES=16, EIGHT_BITS_BUS_WIDTH=0 (Data Bus Width), GCLK_ID=44, GCLK_ID_SLOW=18, GLOBAL_INTERRUPT=1, HSDDR_SUPPORT=0 (e.MMC - HSDDR Support Implemented), HS200_SUPPORT=0 (e.MMC - HS200 Support Implemented), MAX_BLOCK_LENGTH=512 (Maximum Block Length), MULTIPLE_SLOTS=1 (Multiple Slots Support Enabled), MULT_SRC_CLK_GATED=1 (Internal Clock Gater is Implemented), PROGRAMMABLE_CLK_GENERATOR=1 (Programmabe Clock Generator is Implemented), RETUNING_TIMER=0, RETUNING_TIMER_MAX_VALUE=0 (Retuning Timer Counter Max Value), SDCD_DEBOUNCE_PERIOD=328 (Debounce Period Value), SDR12_SUPPORT=0 (SD - UHS SDR12 Support Implemented), SDR25_SUPPORT=0 (SD - UHS SDR25 Support Implemented), SDR50_SUPPORT=0 (SD - UHS SDR50 Support Implemented), SDR104_SUPPORT=0 (SD - UHS SDR104 Support Implemented), SD_SRC_CLOCK_FREQ=0 (Source Clock Frequency (MHz)), SHARED_BUS=0 (Shared Bus Enabled), SLOT_TYPE=0 (Slot Usage), TIMEOUT_CLK_DIVISION=1 (Division of TIMEOUT CLOCK compared to "sd_src_clock"), TIMEOUT_CLK_FREQ=12 (TIMEOUT CLOCK frequency), TIMEOUT_CLK_FREQ_UNIT=1 (TIMEOUT CLOCK frequency unit (0=KHz , 1=MHz)), TUNING_FOR_SDR50=0 (SDR50 Tuning Support Enabled), USER_DEBOUNCE=0 (User Debouncing), INSTANCE_ID=83 (Instance index for SDMMC0), MCLK_ID_AHB=17 (Index for SDMMC0 AHB clock), PAC_ID=83 (Index for SDMMC0 registers write protection)
SDMMC1 at 0x45028000 (SDMMC)
  pins: SDCD PC04/I set 1; SDCK PC05/I set 1; SDCMD PB07/I set 1; SDDAT0 PB10/I set 1; SDDAT1 PC00/I set 1; SDDAT2 PC01/I set 1; SDDAT3 PC02/I set 1; SDWP PC03/I set 1
  parameters: CARD_DATA_SIZE=4, CLOCK_MULTIPLIER=2 (Multiplier between "sd_mult_src_clock" and "sd_src_clock"), DDR50_SUPPORT=0 (SD - UHS DDR50 Support Implemented), DIVBY2_FOR_SDSRCCLK=1 (Div-by-2 Source Clock is Implemented), DLL_NB_OF_PHASES=16, EIGHT_BITS_BUS_WIDTH=0 (Data Bus Width), GCLK_ID=45, GCLK_ID_SLOW=18, GLOBAL_INTERRUPT=1, HSDDR_SUPPORT=0 (e.MMC - HSDDR Support Implemented), HS200_SUPPORT=0 (e.MMC - HS200 Support Implemented), MAX_BLOCK_LENGTH=512 (Maximum Block Length), MULTIPLE_SLOTS=1 (Multiple Slots Support Enabled), MULT_SRC_CLK_GATED=1 (Internal Clock Gater is Implemented), PROGRAMMABLE_CLK_GENERATOR=1 (Programmabe Clock Generator is Implemented), RETUNING_TIMER=0, RETUNING_TIMER_MAX_VALUE=0 (Retuning Timer Counter Max Value), SDCD_DEBOUNCE_PERIOD=328 (Debounce Period Value), SDR12_SUPPORT=0 (SD - UHS SDR12 Support Implemented), SDR25_SUPPORT=0 (SD - UHS SDR25 Support Implemented), SDR50_SUPPORT=0 (SD - UHS SDR50 Support Implemented), SDR104_SUPPORT=0 (SD - UHS SDR104 Support Implemented), SD_SRC_CLOCK_FREQ=0 (Source Clock Frequency (MHz)), SHARED_BUS=0 (Shared Bus Enabled), SLOT_TYPE=0 (Slot Usage), TIMEOUT_CLK_DIVISION=1 (Division of TIMEOUT CLOCK compared to "sd_src_clock"), TIMEOUT_CLK_FREQ=12 (TIMEOUT CLOCK frequency), TIMEOUT_CLK_FREQ_UNIT=1 (TIMEOUT CLOCK frequency unit (0=KHz , 1=MHz)), TUNING_FOR_SDR50=0 (SDR50 Tuning Support Enabled), USER_DEBOUNCE=0 (User Debouncing), INSTANCE_ID=84 (Instance index for SDMMC1), MCLK_ID_AHB=18 (Index for SDMMC1 AHB clock), PAC_ID=84 (Index for SDMMC1 registers write protection)
SERCOM0 at 0x44810000 (SERCOM)
  pins: PAD0 PC10/C set 1 or PD06/C set 3 or PD17/C set 2; PAD1 PC11/C set 1 or PD07/C set 3 or PD18/C set 2; PAD2 PC12/C set 1 or PD05/C set 3 or PD19/C set 2; PAD3 PC13/C set 1 or PD12/C set 3 or PD20/C set 2
  parameters: CLK_REDUCTION=1 (Reduce clock options to pin 1 for SPI and USART), DMA=1 (DMA support implemented?), DMAC_ID_RX=5 (Index of DMA RX trigger), DMAC_ID_TX=6 (Index of DMA TX trigger), FIFO_IMPLEMENTED=1 (FIFO Rx/Tx implemented?), FIFO_SIZE=16 (Rx-Tx FIFO size in bytes), FSYNC_IMPLEMENTED=1 (SPI Frame Synch mode implemented?), GCLK_ID_CORE=19, GCLK_ID_SLOW=18, SPI=1 (SPI mode implemented?), TWIM=1 (TWI Master mode implemented?), TWIS=1 (TWI Slave mode implemented?), TWI_HSMODE=1 (TWI HighSpeed mode implemented?), ULTRA_IMPLEMENTATION=0 (ULTRA platform compatibility?), USART=1 (USART mode implemented?), USART_AUTOBAUD=1 (USART autobaud implemented?), USART_IRDA=1 (USART IrDA implemented?), USART_ISO7816=1 (USART ISO7816 mode implemented?), USART_LIN_MASTER=1 (USART LIN Master mode implemented?), USART_RS485=1 (USART RS485 mode implemented?), INSTANCE_ID=40 (Instance index for SERCOM0), MCLK_ID_APB=71 (Index for SERCOM0 APB clock), PAC_ID=40 (Index for SERCOM0 registers write protection), USART_ERROR_INT_SRC=44 (USART/SPI/I2C Error), USART_TX_READY_INT_SRC=45 (USART-SPI Data Register Empty/ I2C Stop Received), USART_TX_COMPLETE_INT_SRC=46 (USART-SPI Transmit Complete/ I2C Address Match), USART_RX_INT_SRC=47 (USART-SPI Receive Complete/ I2C Data Ready), SPI_TX_READY_INT_SRC=45 (USART-SPI Data Register Empty/ I2C Stop Received), SPI_TX_COMPLETE_INT_SRC=46 (USART-SPI Transmit Complete/ I2C Address Match), SPI_RX_INT_SRC=47 (USART-SPI Receive Complete/ I2C Data Ready), I2C_0_INT_SRC=44 (USART/SPI/I2C Error), I2C_1_INT_SRC=47 (USART-SPI Receive Complete/ I2C Data Ready), I2C_2_INT_SRC=48 (USART Receive Start/ SPI Slave Select Low/ I2C TX FIFO Empty), I2C_3_INT_SRC=49 (USART Clear To Send Input Change/ I2C RX FIFO Full)

## Notices in the file
Copyright (c) 2021 Microchip Technology Inc.
SPDX-License-Identifier: Apache-2.0
Licensed under the Apache License, Version 2.0 (the "License");
you may not use this file except in compliance with the License.
You may obtain a copy of the License at
http://www.apache.org/licenses/LICENSE-2.0
Unless required by applicable law or agreed to in writing, software
distributed under the License is distributed on an "AS IS" BASIS,
WITHOUT WARRANTIES OR CONDITIONS OF ANY KIND, either express or implied.
See the License for the specific language governing permissions and
limitations under the License.
