# PIC32CK1012SG01100 device description
Architecture: CORTEX-M33; Family: PIC32CK; Series: PIC32CKSG01
Parameters: GCLK_ID_TRACE=47 (Index of Generic Clock), LITTLE_ENDIAN=1, NUM_IRQ=159 (Number of Interrupt Requests), __BKPT_NUM=8 (Number of FPB breakpoint comparators), __CM33_REV=0x0000 (Cortex-M33 Revision), __DEBUG_LVL=2 (Debug Level), __DSP_PRESENT=1 (DSP extension present or not), __ETM_PRESENT=1 (ETM present or not), __FPU_PRESENT=1 (FPU present or not), __ITM_PRESENT=1 (ITM present or not), __MPU_NS_REGIONS=8 (Number of MPU_NS regions), __MPU_PRESENT=1 (MPU present or not), __MPU_S_REGIONS=8 (Number of MPU_S regions), __MTB_PRESENT=0 (MTB present or not), __NVIC_PRIO_BITS=3 (Number of NVIC Priority bits), __SAU_PRESENT=0 (SAU present or not), __SEC_ENABLED=1 (TrustZone-M enabled or not), __SYST_NUM=2 (Number of SysTick instances), __TRACE_LVL=2 (Trace Level), __VTOR_PRESENT=1 (Vector Table Offset Register present or not), __Vendor_SysTickConfig=0 (Set to 1 if different SysTick Config is used), __WPT_NUM=4 (Number of DWT watchpoint comparators), POWER_DOMAIN=PD_CORE_SW, __ARCH_ARM=1, __ARCH_ARM_CORTEX_M=1
Programming and debug interfaces: JTAG, SWD
Registers are 32-bit, read-write, reset 0x0 unless marked. A register's access mark holds for its fields unless they carry their own. Offsets are from the block's base; lines under a group give offsets from that group; [hi:lo] are bit positions; {n}, {i} and the like mark numbered series; 'fields as' and 'values as' point back to an identical list; <NAME> marks a mode.

## Ordering variants
PIC32CK1012SG01100-I/DD: TQFP100, pinout P100, up to 120 MHz, -40 to 85 C, 1.71 to 3.60 V
PIC32CK1012SG01100-E/DD: TQFP100, pinout P100, up to 120 MHz, -40 to 125 C, 1.71 to 3.60 V

## Memory
base space: start 0 size 0x100000000, little endian
  0x0 CMCC_DATARAM size 0x1000 ram, rw, executable
  0x1000 CMCC_TAGRAM size 0x400 ram, rw
  0x3000 CMCC_VALIDRAM size 0x40 ram, rw
  0x4000000 PRM_ROM size 0x8000 rom, ro, executable
  0x8000000 FLASH_BFM size 0x20000 flash, rw, executable, page 4096
  0xA000000 FLASH_CFM_USERCFG1 size 0x1000 flash, rw, page 4096
  0xA001000 FLASH_CFM_USEROTP1 size 0x1000 user_signatures, rw, page 4096
  0xA002000 FLASH_CFM_BOOTCFG1 size 0x1000 flash, rw, page 4096
  0xA004000 FLASH_CFM_DALCFG size 0x1000 flash, rw, page 4096
  0xA006000 FLASH_CFM_CALBACKUP size 0x1000 flash, rw, page 4096
  0xA007000 FLASH_CFM_CALOTP size 0x1000 other, ro, page 4096
  0xA008000 FLASH_CFM_USERCFG2 size 0x1000 flash, rw, page 4096
  0xA009000 FLASH_CFM_USEROTP2 size 0x1000 user_signatures, rw, page 4096
  0xA00A000 FLASH_CFM_BOOTCFG2 size 0x1000 flash, rw, page 4096
  0xC000000 FLASH_PFM size 0x100000 flash, rw, executable, page 4096
  0xFFFF000 SQI_SFR size 0x1000 io, rw
  0x10000000 SQI_XIP size 0x10000000 ram, rw, executable, external
  0x20000000 HSRAM_RET size 0x20000 ram, rw, executable
  0x44000000 HPB0_BRIDGE size 0x30000 io, rw
  0x44800000 HPB1_BRIDGE size 0x30000 io, rw
  0x45000000 HPB2_BRIDGE size 0x30000 io, rw
  0x48000000 HSM_SFR size 0x1000 io, rw
  0xE0000000 PPB size 0x100000 io, rw

## Peripheral instances (address, pins/pin function, parameters)
AC at 0x45012000
  pins: AIN0 PA06/B or PA09/B; AIN1 PA07/B or PA10/B; AIN2 PC06/B; AIN3 PC07/B; CMP0 PA11/M set 3 or PC09/M set 1; CMP1 PA12/M set 3 or PC15/M set 1
  parameters: ATEST_IMPLEMENTED=1 (Defines if the ATEST register is implemented), ATEST_SIZE=2 (Defines the number of effective bits in ATEST register), DACVALUE_BIT=7 (Defines the number of bits in DACCTRLn.VALUE), GCLK_ID=34 (Index of Generic Clock), IO_INPUTS=4 (Defines the number of AC pair inputs connected to IO pins), PAIRS=1 (Defines the number of AC pairs), INSTANCE_ID=73 (Instance index for AC), MCLK_ID_APB=105 (Index for AC APB clock), PAC_ID=73 (Index for AC registers write protection), NUM_CMP=2 (Number of comparators), LOAD_CALIB=0 (Defines if calibration is required)
ADC at 0x45010000
  pins: VINM0 PA05/B; VINM2 PA07/B; VINM4 PA18/B; VINP{n} PA{n+4:02}/B (n=0..8); VINP9 PB00/B; VINP10 PB11/B; VINP11 PB12/B; VREFP0 PB01/B
  parameters: APB_FIFO_DEPTH=16 (Number of Words in APB FIFO), CHNSAR_NMBR1=15 (Number of Channels on SARCORE number 1), CHNSAR_NMBR2=0 (Number of Channels on SARCORE number 2), CHNSAR_NMBR3=0 (Number of Channels on SARCORE number 3), CHNSAR_NMBR4=0 (Number of Channels on SARCORE number 4), DCMP_NMBR=1 (Number of Digital Comparators Max=4), DMAC_ID_PFFRDY=61, EARLY_INTR_PRESENT=1 (Early Interrupts Present), FLTR_NMBR=1 (Number of Digital Filters, Max=0), GCLK_ID=33 (Index of Generic Clock), OCP_ADDR_WIDTH=0 (OCP Address Width), OCP_FIFO_DEPTH=0 (Number of Words in OCP DMA FIFO), OCP_PORT_PRESENT=0 (OCP DMA Bus Master Present), SARCORE_NMBR=1 (Number of SARCOREs. Max=4, Min-1), TRGS_NMBR=16 (Number of Trigger Sources, Max=16), VREF_STARTUP_TIME=50 (Number of Control Clock cycles for VREF to stabalize), INSTANCE_ID=72 (Instance index for ADC), MCLK_ID_APB=104 (Index for ADC APB clock), PAC_ID=72 (Index for ADC registers write protection)
BSDAP
  pins: TCK_SWCLK PA03/G set 1; TDI PA00/G set 1; TDO PA01/G set 1; TMS_SWDIO PA02/G set 1
  parameters: MCLK_ID_DAP=115 (Index for BSDAP DAP clock)
CAN0 at 0x4501E000 (CAN)
  pins: RX PB01/H set 4 or PB09/H set 1 or PB17/H set 3 or PC03/H set 2 or PC07/H set 2; TX PB00/H set 4 or PB08/H set 1 or PB16/H set 3 or PC02/H set 2 or PC06/H set 2
  parameters: DMAC_ID_DEBUG=68 (DMA CAN Debug Req), ECC_BERR_IMPLEMENTED=0 (ECC error), EXT_TSTAMP_IMPLEMENTED=0 (External time stamp), GCLK_ID=39 (Index of Generic Clock), MSG_RAM_ADDR=0x20 (8-bits MSB), RXD_SYNC_METHOD=0 (RXD Synchronization Method), INSTANCE_ID=79 (Instance index for CAN0), MCLK_ID_AHB=13 (Index for CAN0 AHB clock), PAC_ID=79 (Index for CAN0 registers write protection)
CCL at 0x4501A000
  pins: IN0 PB02/M set 1 or PB07/M set 1; IN1 PB03/M set 1 or PB08/M set 1; IN2 PB09/M set 1 or PD02/M set 1; IN3 PC10/M set 1; IN4 PC11/M set 1; IN5 PC06/M set 1 or PC12/M set 1; IN6 PB00/M set 1 or PD08/M set 1; IN7 PB01/M set 1 or PD09/M set 1; IN8 PB04/M set 1 or PD10/M set 1; IN9 PA04/M set 1 or PA13/M set 2; IN10 PA05/M set 1 or PA14/M set 2; IN11 PA06/M set 1 or PA15/M set 2; OUT0 PB06/M set 1 or PB10/M set 1; OUT1 PA00/M set 1 or PC13/M set 1; OUT2 PC07/M set 1 or PD11/M set 1; OUT3 PA07/M set 1 or PA16/M set 2 or PB05/M set 1
  parameters: GCLK_ID=37 (GCLK index for CCL), LUT_NUM=4 (Number of LUT in a CCL), INSTANCE_ID=77 (Instance index for CCL), MCLK_ID_APB=109 (Index for CCL APB clock), PAC_ID=77 (Index for CCL registers write protection)
CMCC at 0x44808000
  parameters: INSTANCE_ID=36 (Instance index for CMCC), MCLK_ID_AHB=11 (Index for CMCC AHB clock), PAC_ID=36 (Index for CMCC registers write protection)
CoreDebug at 0xE000EDF0
CoreDebug_NS at 0xE002EDF0 (CoreDebug)
DIB at 0xE000EFB0
DIB_NS at 0xE002EFB0 (DIB)
DMA0 at 0x44802000 (DMA)
  parameters: DMAC_ID_EVSYS=1 (Events trigger index), DMAC_ID_SWTRG=0 (Software trigger index), INSTANCE_ID=33 (Instance index for DMA0), MCLK_ID_AHB=8 (Index for DMA0 AHB clock), MCLK_ID_APB=65 (Index for DMA0 APB clock), PAC_ID=33 (Index for DMA0 registers write protection)
DMA1 at 0x44804000 (DMA)
  parameters: DMAC_ID_EVSYS=1 (Events trigger index), DMAC_ID_SWTRG=0 (Software trigger index), INSTANCE_ID=34 (Instance index for DMA1), MCLK_ID_AHB=9 (Index for DMA1 AHB clock), MCLK_ID_APB=66 (Index for DMA1 APB clock), PAC_ID=34 (Index for DMA1 registers write protection)
DSU at 0x44000000
  parameters: BMX_ERROR_SUPPORT=0 (Defines whether DSU APB errors are reported as 2-cycles bus errors to the AHB AP0 master), DAL1_IMPLEMENTED=1 (Debug Access Level 1 (Non-Secure) Implemented? for TZ devices only), DMAC_ID_DCC0=2 (DMAC ID for DCC0 register), DMAC_ID_DCC1=3 (DMAC ID for DCC1 register), INSTANCE_ID=0 (Instance index for DSU), MCLK_ID_AHB=3 (Index for DSU AHB clock), MCLK_ID_APB=32 (Index for DSU APB clock), PAC_ID=0 (Index for DSU registers write protection)
DWT at 0xE0001000
  parameters: __WPT_NUM=4 (Number of DWT watchpoint comparators)
EIC at 0x4401A000, EIC_SEC 0x4401B000
  pins: EXTINT0 PA16/A or PB00/A or PB16/A or PC00/A or PC16/A or PD00/A; EXTINT1 PA01/A or PA17/A or PB01/A or PB17/A or PC01/A or PC17/A or PD01/A; EXTINT2 PA02/A or PA18/A or PB02/A or PC02/A or PC18/A; EXTINT3 PA03/A or PA19/A or PB03/A or PC03/A or PC19/A or PD03/A; EXTINT4 PA04/A or PB04/A or PC04/A or PC20/A or PD04/A; EXTINT5 PA05/A or PB05/A or PC05/A or PD05/A; EXTINT6 PA06/A or PB06/A or PC06/A or PD06/A; EXTINT7 PA07/A or PB07/A or PC07/A or PD07/A; EXTINT8 PA08/A or PB08/A or PD08/A; EXTINT9 PA09/A or PB09/A or PC09/A or PD09/A; EXTINT10 PA10/A or PB10/A or PC10/A or PD10/A; EXTINT11 PA11/A or PB11/A or PC11/A or PD11/A; EXTINT12 PA12/A or PB12/A or PC12/A or PD12/A; EXTINT13 PA13/A or PB13/A or PC13/A; EXTINT14 PA00/A or PB14/A or PC14/A or PA14/A; EXTINT15 PA15/A or PB15/A or PC15/A; NMI PD02/A
  parameters: EXTINT_NUM=16 (Number of external interrupts), GCLK_ID=5 (Generic Clock index), NUMBER_OF_CONFIG_REGS=2 (Number of CONFIG registers), NUMBER_OF_INTERRUPTS=16 (Number of external interrupts (obsolete)), SECURE_IMPLEMENTED=1 (Security Configuration implemented?), INSTANCE_ID=13 (Instance index for EIC), MCLK_ID_APB=45 (Index for EIC APB clock), PAC_ID=13 (Index for EIC registers write protection)
ETH at 0x45022000
  pins: COL PC18/L; CRS PC17/L; MDC PA11/O set 5 or PD07/O set 6 or PA11/L set 1 or PB10/L set 2 or PC03/L set 3 or PD07/L set 4; MDIO PA12/O set 5 or PD06/O or PA12/L set 1 or PC02/L set 2 or PC04/L set 3 or PD06/L set 4; REF_CLK PC00/L; RXD0 PC02/O or PC07/L set 1; RXD1 PC01/O or PC06/L set 1; RXD2 PC05/L set 1; RXD3 PC14/L set 1; RXDV PC10/O or PC10/L set 1; RXER PC03/O or PC09/L; RX_CLK PC15/L; TSUCOMP PD02/O or PD02/L set 1; TXD0 PC06/O or PC12/L set 1; TXD1 PC07/O or PC13/L set 1; TXD2 PC19/L set 1; TXD3 PC20/L set 1; TXEN PC05/O or PC11/L set 1; TXER PC16/L; TX_CLK PC00/O or PC00/L set 1
  parameters: GCLK_ID_TSU=42 (1588 External Clock), GCLK_ID_TX=41 (GIGE/Loopback clock), MEM_MARGINADJ_MSB=9 (Number of Memory Margin Adjust bits), NUM_INT=1 (Number of Interrupts), INSTANCE_ID=81 (Instance index for ETH), MCLK_ID_AHB=15 (Index for ETH AHB clock), MCLK_ID_APB=111 (Index for ETH APB clock), PAC_ID=81 (Index for ETH registers write protection)
EVSYS at 0x4480E000
  parameters: ASYNCHRONOUS_CHANNELS=0xFFFFF000 (Mask of Only Asynchronous Channels), CHANNELS=32 (Total Number of Channels), CHANNELS_BITS=5 (Number of bits to select Channel), GCLK_ID_{n}={n+6} (Index of Generic Clocks for Synchronous Channels {n}) (n=0..11), GENERATORS=125 (Total Number of Event Generators), GENERATORS_BITS=7 (Number of bits to select Event Generator), SECURE_IMPLEMENTED=0 (Security Configuration implemented?), SPLIT_IRQ_NUM=4 (Number of channels with dedicated interrupt line request), SYNCH_NUM=12 (Number of Synchronous Channels), SYNCH_NUM_BITS=4 (Number of bits to select Synchronous Channels), USERS=104 (Total Number of Event Users), USERS_BITS=7 (Number of bits to select Event User), USERS_GROUPS=4 (Number of 32-user Groups), INSTANCE_ID=39 (Instance index for EVSYS), MCLK_ID_APB=70 (Index for EVSYS APB clock), PAC_ID=39 (Index for EVSYS registers write protection)
FCR at 0x44002000
  parameters: INSTANCE_ID=1 (Instance index for FCR), MCLK_ID_AHB=4 (Index for FCR AHB clock), MCLK_ID_APB=33 (Index for FCR APB clock), PAC_ID=1 (Index for FCR registers write protection)
FCW at 0x44004000
  parameters: PFM_NUM_PAGES=128 (No of PFM Pages Per panel), PFM_PAGE_ADDR_MSB=11 (Flash Page Size MSB), PFM_PAGE_SIZE=4096, PFM_PNL_ADDR_MSB=18 (Single flash panel read address MSbit (using byte addressing)), PFM_SIZE=3 (Flash Memory Parameters), PFM_SYS_ADDR_MSB=19 (The MS bit of the system byte address needed to address the entire PFM region (both panels Main)), FLASH_SIZE=1048576, PAGES=256, PAGES_PR_REGION=16, INSTANCE_ID=2 (Instance index for FCW), MCLK_ID_AHB=5 (Index for FCW AHB clock), MCLK_ID_APB=34 (Index for FCW APB clock), PAC_ID=2 (Index for FCW registers write protection)
FPB at 0xE0002000
  parameters: __BKPT_NUM=8 (Number of FPB breakpoint comparators)
FPU at 0xE000EF30
FPU_NS at 0xE002EF30 (FPU)
  parameters: TYPE=8 (FPU architecture type)
FREQM at 0x44014000
  parameters: GCLK_ID_MSR_0=2 (Index of measure generic clock 0), GCLK_ID_MSR_1=3 (Index of measure generic clock 1), GCLK_ID_REF=4 (Index of reference generic clock), MSRCLK_NB=2 (Number of measured clock sources), INSTANCE_ID=10 (Instance index for FREQM), MCLK_ID_APB=42 (Index for FREQM APB clock), PAC_ID=10 (Index for FREQM registers write protection)
FUSES at FUSES_BOOTCFG1 0x0A002000, FUSES_BOOTCFG2 0x0A00A000 (FUSES_BOOTCFG1), FUSES_DALCFG 0x0A004000, FUSES_USERCFG1 0x0A000000, FUSES_USERCFG2 0x0A008000 (FUSES_USERCFG1), FUSES_CALOTP 0x0A007000
  parameters: RDY_MSB=14
GCLK at 0x44010000
  pins: IO0 PA09/M set 2 or PA03/M set 1; IO1 PA01/M set 1 or PA10/M set 2; IO2 PC00/M set 1 or PD12/M set 2; IO3 PC01/M set 1 or PD05/M set 2; IO4 PC02/M set 1 or PD06/M set 2; IO5 PC03/M set 1 or PD07/M set 2; IO6 PA17/M set 2 or PC04/M set 1; IO7 PC05/M set 1
  parameters: GEN_BITS=4, GEN_NUM=12 (Number of Generic Clock Generators), GEN_NUM_MSB=11 (Number of Generic Clock Generators - 1), GEN_SOURCE_NUM_MSB=11 (Number of Generic Clock Sources - 1), IO_NUM=8 (Number of Generic Clock I/Os), NUM=48 (Number of Generic Clock Users), SOURCE_BITS=4, SOURCE_NUM=12 (Number of Generic Clock Sources), INSTANCE_ID=8 (Instance index for GCLK), MCLK_ID_APB=40 (Index for GCLK APB clock), PAC_ID=8 (Index for GCLK registers write protection)
HMATRIX at 0x44806000 (HMATRIX2)
  parameters: INSTANCE_ID=35 (Instance index for HMATRIX), MCLK_ID_AHB=10 (Index for HMATRIX AHB clock), MCLK_ID_APB=67 (Index for HMATRIX APB clock), PAC_ID=35 (Index for HMATRIX registers write protection)
HSM at 0x48000000
  parameters: KEN_VALUE=0, g_ClkGating=1, INSTANCE_ID=98 (Instance index for HSM), MCLK_ID_AHB=22 (Index for HSM AHB clock), PAC_ID=98 (Index for HSM registers write protection)
ICB at 0xE000E000
ICB_NS at 0xE002E000 (ICB)
IDAU at 0x4480C000
  parameters: INSTANCE_ID=38 (Instance index for IDAU), MCLK_ID_APB=69 (Index for IDAU APB clock), PAC_ID=38 (Index for IDAU registers write protection), GRANULARITY_ANSC=0x1000 (Application Non-Secure Callable region granularity), GRANULARITY_ANS=0x1000 (Application Non-Secure region granularity), GRANULARITY_AS=0x1000 (Application Secure region granularity), GRANULARITY_RS=0x1000 (RAM Secure region granularity), GRANULARITY_RNS=0x1000 (RAM Non-Secure region granularity), GRANULARITY_BNSC=0x1000 (Boot Flash Non-Secure Callable region granularity), GRANULARITY_BOOTPROT=0x1000 (BOOTPROT region granularity), GRANULARITY_BS=0x1000 (Boot Flash Secure region granularity), REGION_CMCCDS=0x01 (CMCC DATA RAM Secure region ID), REGION_CMCCTS=0x02 (CMCC TAG RAM Secure region ID), REGION_CMCCVS=0x03 (CMCC VALID RAM Secure region ID), REGION_BOOTROM=0x04 (Boot ROM region ID), REGION_BS=0x05 (Boot Flash Secure region ID), REGION_BNSC=0x06 (Boot Flash Non-Secure Callable region ID), REGION_CFMS=0x07 (CONFIGURATION Flash Secure region ID), REGION_AS=0x08 (Application Secure region ID), REGION_ANSC=0x09 (Application Non-Secure Callable region ID), REGION_ANS=0x0A (Application Non-Secure region ID), REGION_RS=0x0D (RAM Secure region ID), REGION_RNS=0x0E (RAM Non-Secure region ID), REGION_HPB0=0x0F (Peripheral Bus A region ID), REGION_HPB1=0x10 (Peripheral Bus B region ID), REGION_HPB2=0x11 (Peripheral Bus C region ID), RESERVED=0x12, REGION_HSM=0x13 (HSM region ID), REGION_OTHER=0x00 (Other region ID)
ITM at 0xE0000000
MCLK at 0x44012000
  parameters: DIV_CLK_NUM=1, INSTANCE_ID=9 (Instance index for MCLK), MCLK_ID_APB=41 (Index for MCLK APB clock), PAC_ID=9 (Index for MCLK registers write protection)
FLEXRAM at 0x44028000 (MCRAMC)
  parameters: AHB_CLOCK_ENABLE=0 (MCRAMC CLOCK GATER), AHB_ECC=1 (ECC LOGIC), AHB_PORTS_NB=5 (NUMBER OF AHB PORTS), AHB_READ_PREBUFFERING=0, AHB_REQUEST_ISOLATION_REGISTER=0 (AHB REQUEST TIMING PATHS ISOLATION), ARBITRATION_TYPE=2 (ARBITRATION SCHEME, FIXED_PRIORITY = 0, HIGHLIGHT = 1, HOPSCOTCH = 2), BIT_STROBE_RAM=0 (Set this parameter to TRUE if the ram_wem_bundle outputs are connected to ram bit-strobe write masks), CHANNELS_NB=2 (NUMBER OF RAM CHANNELS), ECC_SYNDROM_REGISTER=0 (ECC TIMING PATH BALANCING), HADDR_READ_ISOLATION_REGISTER=0 (Set to IMPLEMENTED to add 1 wait-state max (0 min) per memory new line read access for each of the AHB timing path isolations), HRDATA_ISOLATION_CONFIGURABLE=0 (AHB REQUEST TIMING PATHS ISOLATION), HRDATA_ISOLATION_DEFAULT=0 (Default HRDATA_ISOLATION setting), CLK_GATER=0 (MCRAMC CLOCK GATER), PADDR_SIZE=13 (APB USER INTERFACE), MEMORY_AUTO_CORRECTION=1 (Perform an automatic write-back of the corrected ram word after read), MEMORY_ENABLE_POLARITY=0 (POSITIVE if Memory is selected when ram_me is 1'b1), MW_CLOCK_ENABLE=0 (MCRAMC CLOCK GATER), MW_DATA_SIZE=32 (MW DATA BUS SIZE), MW_PORT_SLICES_NB=0 (NUMBER OF PORT SLICES FOR THE WAITED SRAM INTERFACE), M0_CLOCK_ENABLE=0 (MCRAMC CLOCK GATER), M0_DATA_SIZE=32 (M0 DATA BUS SIZE), M0_HYBRID_READ_WRITE_ACCESS=0 (M0 HYBRID SIMULTANEOUS READ + WRITE ACCESS), M0_PORT_SLICES_NB=0 (NUMBER OF PORT SLICES FOR THE 0 WS SRAM INTERFACE), PRIVILEGED_BIT_CHECK=0 (PRIVILED BIT implemented), RAM_ADD_SIZE=14 (NUMBER OF ADDRESS BITS FOR ONE CHANNEL RAM CELL), RAM_AHB_ADDRESS_OFFSET=0x00000 (RAM BLOCK AHB ADDRESS OFFSET), RAM_ERASE=0 (IMPLEMENTED if Ram erase on erase active input), STORE_BYTE_STROBE=0 (AHB byte strobes can be stored and read back through the M0 interface), ULTRA=1 (ULTRA USER INTERFACE), WP_KEY=0x465852 (KEY value), WRITE_ENABLE_POLARITY=0 (POSITIVE if Memory is written when ram_we is 1'b1), WRITE_ENABLE_USED=1 (TRUE if the Memory makes use of a global per channel ram_we write enable), WRITE_MASK_POLARITY=0 (POSITIVE if Memory is written when ram_wem is 1'b1), WRITE_PROTECT_REGISTER=0 (WRITE Protect register implemented), INSTANCE_ID=20 (Instance index for FLEXRAM), MCLK_ID_AHB=7 (Index for FLEXRAM AHB clock), MCLK_ID_APB=53 (Index for FLEXRAM APB clock), PAC_ID=20 (Index for FLEXRAM registers write protection)
MPU at 0xE000ED90
MPU_NS at 0xE002ED90 (MPU)
  parameters: __MPU_NS_REGIONS=8 (Number of MPU_NS regions), __MPU_S_REGIONS=8 (Number of MPU_S regions)
NVIC at 0xE000E100
NVIC_NS at 0xE002E100 (NVIC)
  parameters: NUM_IRQ=159 (Number of interrupt request lines)
OSC32KCTRL at 0x4400E000
  pins: XIN32 PB02/XIN32; XOUT32 PB03/XOUT32
  parameters: INSTANCE_ID=7 (Instance index for OSC32KCTRL), MCLK_ID_APB=39 (Index for OSC32KCTRL APB clock), PAC_ID=7 (Index for OSC32KCTRL registers write protection)
OSCCTRL at 0x4400C000
  pins: XIN PD00/XIN; XOUT PD01/XOUT
  parameters: DFLL48M_ATEST_IMPLEMENTED=1 (DFLL48M ATEST register implemented), DFLL48M_ATEST_SIZE=8 (number of effective bits in DFLL48M ATEST register), DFLL48M_IS_STARTUP_OSCILLATOR=1, DFLL48M_RC48MCAL0_PORVAL=0 (Defines the RC48MCAL0 register reset value after POR.), DIV_8MHZ_NUM=2, FRACDIVS_NUM=1 (Number of FRACDIVs), FRACDIV_DIVIDER_RESET_VAL=32 (Fracdiv Divider reset value), FRACDIV_PLLSRC=0 (Indice of the PLL that is source of the FRACDIV), GCLK_ID_DFLL48M=0 (Index of Generic Clock for DFLL48), GCLK_ID_PLL=1 (Index of Generic Clock for PLL), PLLS_NUM=1 (Number of PLLs), PLL0_OUTPUTS_NUM=6 (number of clock outputs for PLL0), PLL1_OUTPUTS_NUM=0 (number of clock outputs for PLL1), XOSC_ATEST_IMPLEMENTED=1 (XOSC ATEST register implemented), XOSC_ATEST_SIZE=4 (number of effective bits in XOSC ATEST register), XOSC_CFD_CLK_SELECT_SIZE=4 (Clock fail prescaler size), XOSC_CFD_HAS_RETENTION=0 (Clock fail detected for xosc is in tetention domain), INSTANCE_ID=6 (Instance index for OSCCTRL), MCLK_ID_APB=38 (Index for OSCCTRL APB clock), PAC_ID=6 (Index for OSCCTRL registers write protection)
PAC at 0x4401C000
  parameters: HMATRIX1_IMPLEMENTED=0, HPB_NUM=4 (Number of bridges AHB/APB), SECURE_IMPLEMENTED=0 (Security Configuration implemented?), INSTANCE_ID=14 (Instance index for PAC), MCLK_ID_AHB=6 (Index for PAC AHB clock), MCLK_ID_APB=46 (Index for PAC APB clock), PAC_ID=14 (Index for PAC registers write protection)
PCC at 0x45018000
  pins: CLK PC05/K set 1; DATA0 PC01/K set 1; DATA1 PC02/K set 1; DATA2 PC03/K set 1; DATA3 PB07/K set 1 or PC06/K set 1; DATA4 PB08/K set 1 or PC07/K set 1; DATA5 PB09/K set 1 or PC10/K set 1; DATA6 PB10/K set 1 or PC11/K set 1; DATA7 PC00/K set 1; DATA8 PC15/K set 1; DATA9 PC16/K set 1; DATA10 PC17/K set 1; DATA11 PC18/K set 1; DATA12 PC19/K set 1; DATA13 PC20/K set 1; DEN1 PA10/K set 1 or PC04/K set 1; DEN2 PC14/K set 1 or PD02/K set 1
  parameters: DATA_SIZE=14, DMAC_ID_RX=67, INSTANCE_ID=76 (Instance index for PCC), MCLK_ID_APB=108 (Index for PCC APB clock), PAC_ID=76 (Index for PCC registers write protection)
PDEC at 0x4501C000
  pins: QDI0 PB04/G set 1 3 or PB07/G set 2; QDI1 PB05/G set 1 3 or PB08/G set 2; QDI2 PB06/G set 3 or PB09/G set 2 or PB13/G set 1
  parameters: CC_NUM=2 (Number of Compare Channels units), GCLK_ID=38 (Index of Generic Clocks for Synchronous Channels), INSTANCE_ID=78 (Instance index for PDEC), MCLK_ID_APB=110 (Index for PDEC APB clock), PAC_ID=78 (Index for PDEC registers write protection)
PM at 0x44006000
  pins: RESET_N RESET_N
  parameters: BACKUP_IMPLEMENTED=1 (Backup domain is implemented), INSTANCE_ID=3 (Instance index for PM), MCLK_ID_APB=35 (Index for PM APB clock), PAC_ID=3 (Index for PM registers write protection)
PORT at 0x44800000, PORT_SEC 0x44801000
  pins: P{n} PA{n:02} (n=0..19); P{n} PB{n-32:02} (n=32..49); P{n} PC{n-64:02} (n=64..71); P{n} PC{n-64:02} (n=73..84); P{n} PD{n-96:02} (n=96..108)
  parameters: AHB_IMPLEMENTED=0, BITS=109, DRVSTR=0 (Number of DRVSTR bits (0/1/2)), EV_NUM=4, GROUPS=4, HADDR_MSB=31 (AHB bus address MSB), IOBUS_IMPLEMENTED=0, MSB=108, ODRAIN=1 (ODRAIN supported?), PPP_IMPLEMENTED=0 (IOBUS2 implemented?), SECURE_IMPLEMENTED=1 (Secure I/Os supported?), SLEWLIM=2 (Number of SLEWLIM bits (0/1/2)), INSTANCE_ID=32 (Instance index for PORT), MCLK_ID_APB=64 (Index for PORT APB clock), PAC_ID=32 (Index for PORT registers write protection)
PRM at 0x4480A000
  parameters: PRMWS_DEFAULT=0 (Default value of PRMWS register field), ROM_KEN=0 (Value driven on to ROM's KEN input), ROM_SPLIT=0x1C00 (Address defining first restricted address), INSTANCE_ID=37 (Instance index for PRM), MCLK_ID_AHB=12 (Index for PRM AHB clock), MCLK_ID_APB=68 (Index for PRM APB clock), PAC_ID=37 (Index for PRM registers write protection)
PTC at 0x45014000
  pins: DRV0 PA09/N; DRV1 PA10/N; DRV2 PA11/N; DRV3 PA12/N; DRV4 PB00/N; DRV5 PB01/N; DRV6 PB07/N; DRV7 PB08/N; DRV8 PB09/N; DRV9 PB10/N; DRV{n} PC{n-10:02}/N (n=10..17); DRV18 PC13/N; DRV19 PC09/N; DRV20 PC10/N; DRV21 PC11/N; DRV22 PC12/N; DRV23 PC20/N; DRV24 PB16/N; DRV25 PB17/N; DRV26 PC14/N; DRV27 PC15/N; DRV28 PC16/N; DRV29 PC17/N; DRV30 PC18/N; DRV31 PC19/N; ECI0 PA18/N; ECI1 PA19/N
  parameters: DMAC_ID_EOC=64 (Index of DMA EOC trigger), DMAC_ID_SEQ=62 (Index of DMA SEQ trigger), DMAC_ID_WCOMP=63 (Index of DMA WCOMP trigger), GCLK_ID=35 (Index of Generic Clock), LINES_NUM=32 (Number of PTC lines), INSTANCE_ID=74 (Instance index for PTC), MCLK_ID_APB=106 (Index for PTC APB clock), PAC_ID=74 (Index for PTC registers write protection)
RSTC at 0x4400A000
  parameters: BACKUP_IMPLEMENTED=1, CM_DBGRESET_STRETCHED=3 (Reset stretcher size for Cortex CPU related to DBGRESET.), CM_HRESET_N_STRETCHED=3 (Reset stretcher size for Cortex CPU related to HRESETn.), CM_PORESET_STRETCHED=3 (Reset stretcher size for Cortex CPU related to PORESET.), HIB_IMPLEMENTED=1, VBAT_IMPLEMENTED=1 (One if VBAT (Battery backup mode) is supported), INSTANCE_ID=5 (Instance index for RSTC), MCLK_ID_APB=37 (Index for RSTC APB clock), PAC_ID=5 (Index for RSTC registers write protection)
RTC at 0x44018000
  pins: IN0 PB06/RTC_IN; IN1 PB01/RTC_IN; IN2 PB14/RTC_IN; IN3 PB15/RTC_IN; IN4 PB13/RTC_IN; OUT0 PB05/RTC_OUT; OUT1 PB00/RTC_OUT; OUT2 PB11/RTC_OUT; OUT3 PB12/RTC_OUT; OUT4 PB16/RTC_OUT
  parameters: DMAC_ID_TIMESTAMP=4 (DMA RTC timestamp trigger), NUM_OF_ALARMS=2 (Number of Alarms), NUM_OF_BKREGS=0 (Number of Backup Registers), NUM_OF_COMP16=4 (Number of 16-bit Comparators), NUM_OF_TAMPERS=8 (Number of Tamper Inputs), INSTANCE_ID=12 (Instance index for RTC), MCLK_ID_APB=44 (Index for RTC APB clock), PAC_ID=12 (Index for RTC registers write protection)
SCB at 0xE000ED00
SCB_NS at 0xE002ED00 (SCB)
SDMMC0 at 0x45026000 (SDMMC)
  pins: SDCD PA10/I set 1 or PA12/I set 1 or PC04/I set 2 or PC10/I set 2 or PD12/I set 1; SDCK PC05/I set 2 or PD10/I set 1; SDCMD PB07/I set 2 or PC06/I set 2 or PD06/I set 1; SDDAT0 PB10/I set 2 or PC07/I set 2 or PD07/I set 1; SDDAT1 PC00/I set 2 or PD11/I set 1; SDDAT2 PC01/I set 2 or PD08/I set 1; SDDAT3 PC02/I set 2 or PD09/I set 1; SDWP PB00/I set 1 or PC03/I set 2 or PD05/I set 1
  parameters: CARD_DATA_SIZE=4, CLOCK_MULTIPLIER=2 (Multiplier between "sd_mult_src_clock" and "sd_src_clock"), DDR50_SUPPORT=0 (SD - UHS DDR50 Support Implemented), DIVBY2_FOR_SDSRCCLK=1 (Div-by-2 Source Clock is Implemented), DLL_NB_OF_PHASES=16, EIGHT_BITS_BUS_WIDTH=0 (Data Bus Width), GCLK_ID=44, GCLK_ID_SLOW=18, GLOBAL_INTERRUPT=1, HSDDR_SUPPORT=0 (e.MMC - HSDDR Support Implemented), HS200_SUPPORT=0 (e.MMC - HS200 Support Implemented), MAX_BLOCK_LENGTH=512 (Maximum Block Length), MULTIPLE_SLOTS=1 (Multiple Slots Support Enabled), MULT_SRC_CLK_GATED=1 (Internal Clock Gater is Implemented), PROGRAMMABLE_CLK_GENERATOR=1 (Programmabe Clock Generator is Implemented), RETUNING_TIMER=0, RETUNING_TIMER_MAX_VALUE=0 (Retuning Timer Counter Max Value), SDCD_DEBOUNCE_PERIOD=328 (Debounce Period Value), SDR12_SUPPORT=0 (SD - UHS SDR12 Support Implemented), SDR25_SUPPORT=0 (SD - UHS SDR25 Support Implemented), SDR50_SUPPORT=0 (SD - UHS SDR50 Support Implemented), SDR104_SUPPORT=0 (SD - UHS SDR104 Support Implemented), SD_SRC_CLOCK_FREQ=0 (Source Clock Frequency (MHz)), SHARED_BUS=0 (Shared Bus Enabled), SLOT_TYPE=0 (Slot Usage), TIMEOUT_CLK_DIVISION=1 (Division of TIMEOUT CLOCK compared to "sd_src_clock"), TIMEOUT_CLK_FREQ=12 (TIMEOUT CLOCK frequency), TIMEOUT_CLK_FREQ_UNIT=1 (TIMEOUT CLOCK frequency unit (0=KHz , 1=MHz)), TUNING_FOR_SDR50=0 (SDR50 Tuning Support Enabled), USER_DEBOUNCE=0 (User Debouncing), INSTANCE_ID=83 (Instance index for SDMMC0), MCLK_ID_AHB=17 (Index for SDMMC0 AHB clock), PAC_ID=83 (Index for SDMMC0 registers write protection)
SERCOM0 at 0x44810000 (SERCOM)
  pins: PAD0 PC10/C set 1 or PD06/C set 3; PAD1 PC11/C set 1 or PD07/C set 3; PAD2 PA00/C set 3 or PC12/C set 1 or PD05/C set 3; PAD3 PA01/C set 3 or PC13/C set 1 or PD12/C set 3
  parameters: CLK_REDUCTION=1 (Reduce clock options to pin 1 for SPI and USART), DMA=1 (DMA support implemented?), DMAC_ID_RX=5 (Index of DMA RX trigger), DMAC_ID_TX=6 (Index of DMA TX trigger), FIFO_IMPLEMENTED=1 (FIFO Rx/Tx implemented?), FIFO_SIZE=16 (Rx-Tx FIFO size in bytes), FSYNC_IMPLEMENTED=1 (SPI Frame Synch mode implemented?), GCLK_ID_CORE=19, GCLK_ID_SLOW=18, SPI=1 (SPI mode implemented?), TWIM=1 (TWI Master mode implemented?), TWIS=1 (TWI Slave mode implemented?), TWI_HSMODE=1 (TWI HighSpeed mode implemented?), ULTRA_IMPLEMENTATION=0 (ULTRA platform compatibility?), USART=1 (USART mode implemented?), USART_AUTOBAUD=1 (USART autobaud implemented?), USART_IRDA=1 (USART IrDA implemented?), USART_ISO7816=1 (USART ISO7816 mode implemented?), USART_LIN_MASTER=1 (USART LIN Master mode implemented?), USART_RS485=1 (USART RS485 mode implemented?), INSTANCE_ID=40 (Instance index for SERCOM0), MCLK_ID_APB=71 (Index for SERCOM0 APB clock), PAC_ID=40 (Index for SERCOM0 registers write protection), USART_ERROR_INT_SRC=44 (USART/SPI/I2C Error), USART_TX_READY_INT_SRC=45 (USART-SPI Data Register Empty/ I2C Stop Received), USART_TX_COMPLETE_INT_SRC=46 (USART-SPI Transmit Complete/ I2C Address Match), USART_RX_INT_SRC=47 (USART-SPI Receive Complete/ I2C Data Ready), SPI_TX_READY_INT_SRC=45 (USART-SPI Data Register Empty/ I2C Stop Received), SPI_TX_COMPLETE_INT_SRC=46 (USART-SPI Transmit Complete/ I2C Address Match), SPI_RX_INT_SRC=47 (USART-SPI Receive Complete/ I2C Data Ready), I2C_0_INT_SRC=44 (USART/SPI/I2C Error), I2C_1_INT_SRC=47 (USART-SPI Receive Complete/ I2C Data Ready), I2C_2_INT_SRC=48 (USART Receive Start/ SPI Slave Select Low/ I2C TX FIFO Empty), I2C_3_INT_SRC=49 (USART Clear To Send Input Change/ I2C RX FIFO Full)
SERCOM1 at 0x44812000 (SERCOM)
  pins: PAD0 PA00/D set 2 or PD08/C set 1; PAD1 PA01/D set 2 or PD09/C set 1; PAD2 PD06/D set 2 or PD10/C set 1; PAD3 PD07/D set 2 or PD11/C set 1
  parameters: CLK_REDUCTION=1 (Reduce clock options to pin 1 for SPI and USART), DMA=1 (DMA support implemented?), DMAC_ID_RX=7 (Index of DMA RX trigger), DMAC_ID_TX=8 (Index of DMA TX trigger), FIFO_IMPLEMENTED=1 (FIFO Rx/Tx implemented?), FIFO_SIZE=8 (Rx-Tx FIFO size in bytes), FSYNC_IMPLEMENTED=1 (SPI Frame Synch mode implemented?), GCLK_ID_CORE=20, GCLK_ID_SLOW=18, SPI=1 (SPI mode implemented?), TWIM=1 (TWI Master mode implemented?), TWIS=1 (TWI Slave mode implemented?), TWI_HSMODE=1 (TWI HighSpeed mode implemented?), ULTRA_IMPLEMENTATION=0 (ULTRA platform compatibility?), USART=1 (USART mode implemented?), USART_AUTOBAUD=1 (USART autobaud implemented?), USART_IRDA=1 (USART IrDA implemented?), USART_ISO7816=1 (USART ISO7816 mode implemented?), USART_LIN_MASTER=1 (USART LIN Master mode implemented?), USART_RS485=1 (USART RS485 mode implemented?), INSTANCE_ID=41 (Instance index for SERCOM1), MCLK_ID_APB=72 (Index for SERCOM1 APB clock), PAC_ID=41 (Index for SERCOM1 registers write protection), USART_ERROR_INT_SRC=50 (USART/SPI/I2C Error), USART_TX_READY_INT_SRC=51 (USART-SPI Data Register Empty/ I2C Stop Received), USART_TX_COMPLETE_INT_SRC=52 (USART-SPI Transmit Complete/ I2C Address Match), USART_RX_INT_SRC=53 (USART-SPI Receive Complete/ I2C Data Ready), SPI_TX_READY_INT_SRC=51 (USART-SPI Data Register Empty/ I2C Stop Received), SPI_TX_COMPLETE_INT_SRC=52 (USART-SPI Transmit Complete/ I2C Address Match), SPI_RX_INT_SRC=53 (USART-SPI Receive Complete/ I2C Data Ready), I2C_0_INT_SRC=50 (USART/SPI/I2C Error), I2C_1_INT_SRC=53 (USART-SPI Receive Complete/ I2C Data Ready), I2C_2_INT_SRC=54 (USART Receive Start/ SPI Slave Select Low/ I2C TX FIFO Empty), I2C_3_INT_SRC=55 (USART Clear To Send Input Change/ I2C RX FIFO Full)
SERCOM2 at 0x44814000 (SERCOM)
  pins: PAD0 PC11/D set 1 3 or PC06/C set 4 or PC15/C set 2; PAD1 PC10/D set 1 3 or PC07/C set 4 or PC16/C set 2; PAD2 PC05/D set 3 or PC12/D set 1 or PC09/C set 4 or PC17/C set 2; PAD3 PC02/D set 3 or PC13/D set 1 or PC14/C set 4 or PC18/C set 2
  parameters: CLK_REDUCTION=1 (Reduce clock options to pin 1 for SPI and USART), DMA=1 (DMA support implemented?), DMAC_ID_RX=9 (Index of DMA RX trigger), DMAC_ID_TX=10 (Index of DMA TX trigger), FIFO_IMPLEMENTED=1 (FIFO Rx/Tx implemented?), FIFO_SIZE=8 (Rx-Tx FIFO size in bytes), FSYNC_IMPLEMENTED=1 (SPI Frame Synch mode implemented?), GCLK_ID_CORE=21, GCLK_ID_SLOW=18, SPI=1 (SPI mode implemented?), TWIM=1 (TWI Master mode implemented?), TWIS=1 (TWI Slave mode implemented?), TWI_HSMODE=1 (TWI HighSpeed mode implemented?), ULTRA_IMPLEMENTATION=0 (ULTRA platform compatibility?), USART=1 (USART mode implemented?), USART_AUTOBAUD=1 (USART autobaud implemented?), USART_IRDA=1 (USART IrDA implemented?), USART_ISO7816=1 (USART ISO7816 mode implemented?), USART_LIN_MASTER=1 (USART LIN Master mode implemented?), USART_RS485=1 (USART RS485 mode implemented?), INSTANCE_ID=42 (Instance index for SERCOM2), MCLK_ID_APB=73 (Index for SERCOM2 APB clock), PAC_ID=42 (Index for SERCOM2 registers write protection), USART_ERROR_INT_SRC=56 (USART/SPI/I2C Error), USART_TX_READY_INT_SRC=57 (USART-SPI Data Register Empty/ I2C Stop Received), USART_TX_COMPLETE_INT_SRC=58 (USART-SPI Transmit Complete/ I2C Address Match), USART_RX_INT_SRC=59 (USART-SPI Receive Complete/ I2C Data Ready), SPI_TX_READY_INT_SRC=57 (USART-SPI Data Register Empty/ I2C Stop Received), SPI_TX_COMPLETE_INT_SRC=58 (USART-SPI Transmit Complete/ I2C Address Match), SPI_RX_INT_SRC=59 (USART-SPI Receive Complete/ I2C Data Ready), I2C_0_INT_SRC=56 (USART/SPI/I2C Error), I2C_1_INT_SRC=59 (USART-SPI Receive Complete/ I2C Data Ready), I2C_2_INT_SRC=60 (USART Receive Start/ SPI Slave Select Low/ I2C TX FIFO Empty), I2C_3_INT_SRC=61 (USART Clear To Send Input Change/ I2C RX FIFO Full)
SERCOM3 at 0x44816000 (SERCOM)
  pins: PAD0 PC07/D set 4 or PB16/C set 2 or PC02/C set 1; PAD1 PC06/D set 4 or PB17/C set 2 or PC03/C set 1; PAD2 PC01/D set 4 or PC09/D set 4 or PB07/C set 2 or PC04/C set 1; PAD3 PC00/D set 4 or PC15/D set 4 or PB08/C set 2 or PC05/C set 1
  parameters: CLK_REDUCTION=1 (Reduce clock options to pin 1 for SPI and USART), DMA=1 (DMA support implemented?), DMAC_ID_RX=11 (Index of DMA RX trigger), DMAC_ID_TX=12 (Index of DMA TX trigger), FIFO_IMPLEMENTED=1 (FIFO Rx/Tx implemented?), FIFO_SIZE=8 (Rx-Tx FIFO size in bytes), FSYNC_IMPLEMENTED=1 (SPI Frame Synch mode implemented?), GCLK_ID_CORE=22, GCLK_ID_SLOW=18, SPI=1 (SPI mode implemented?), TWIM=1 (TWI Master mode implemented?), TWIS=1 (TWI Slave mode implemented?), TWI_HSMODE=1 (TWI HighSpeed mode implemented?), ULTRA_IMPLEMENTATION=0 (ULTRA platform compatibility?), USART=1 (USART mode implemented?), USART_AUTOBAUD=1 (USART autobaud implemented?), USART_IRDA=1 (USART IrDA implemented?), USART_ISO7816=1 (USART ISO7816 mode implemented?), USART_LIN_MASTER=1 (USART LIN Master mode implemented?), USART_RS485=1 (USART RS485 mode implemented?), INSTANCE_ID=43 (Instance index for SERCOM3), MCLK_ID_APB=74 (Index for SERCOM3 APB clock), PAC_ID=43 (Index for SERCOM3 registers write protection), USART_ERROR_INT_SRC=62 (USART/SPI/I2C Error), USART_TX_READY_INT_SRC=63 (USART-SPI Data Register Empty/ I2C Stop Received), USART_TX_COMPLETE_INT_SRC=64 (USART-SPI Transmit Complete/ I2C Address Match), USART_RX_INT_SRC=65 (USART-SPI Receive Complete/ I2C Data Ready), SPI_TX_READY_INT_SRC=63 (USART-SPI Data Register Empty/ I2C Stop Received), SPI_TX_COMPLETE_INT_SRC=64 (USART-SPI Transmit Complete/ I2C Address Match), SPI_RX_INT_SRC=65 (USART-SPI Receive Complete/ I2C Data Ready), I2C_0_INT_SRC=62 (USART/SPI/I2C Error), I2C_1_INT_SRC=65 (USART-SPI Receive Complete/ I2C Data Ready), I2C_2_INT_SRC=66 (USART Receive Start/ SPI Slave Select Low/ I2C TX FIFO Empty), I2C_3_INT_SRC=67 (USART Clear To Send Input Change/ I2C RX FIFO Full)
SERCOM4 at 0x45000000 (SERCOM)
  pins: PAD0 PB04/D set 2 or PB10/D set 4 or PB04/C set 2 or PB09/C set 1; PAD1 PB05/D set 2 or PB09/D set 4 or PB05/C set 2 or PB10/C set 1; PAD2 PA10/D set 2 or PB07/D set 4 or PB13/C set 2 or PC00/C set 1; PAD3 PB06/D set 2 or PB08/D set 4 or PB06/C set 2 or PC01/C set 1
  parameters: CLK_REDUCTION=1 (Reduce clock options to pin 1 for SPI and USART), DMA=1 (DMA support implemented?), DMAC_ID_RX=41 (Index of DMA RX trigger), DMAC_ID_TX=42 (Index of DMA TX trigger), FIFO_IMPLEMENTED=1 (FIFO Rx/Tx implemented?), FIFO_SIZE=8 (Rx-Tx FIFO size in bytes), FSYNC_IMPLEMENTED=1 (SPI Frame Synch mode implemented?), GCLK_ID_CORE=25, GCLK_ID_SLOW=18, SPI=1 (SPI mode implemented?), TWIM=1 (TWI Master mode implemented?), TWIS=1 (TWI Slave mode implemented?), TWI_HSMODE=1 (TWI HighSpeed mode implemented?), ULTRA_IMPLEMENTATION=0 (ULTRA platform compatibility?), USART=1 (USART mode implemented?), USART_AUTOBAUD=1 (USART autobaud implemented?), USART_IRDA=1 (USART IrDA implemented?), USART_ISO7816=1 (USART ISO7816 mode implemented?), USART_LIN_MASTER=1 (USART LIN Master mode implemented?), USART_RS485=1 (USART RS485 mode implemented?), INSTANCE_ID=64 (Instance index for SERCOM4), MCLK_ID_APB=96 (Index for SERCOM4 APB clock), PAC_ID=64 (Index for SERCOM4 registers write protection), USART_ERROR_INT_SRC=96 (USART/SPI/I2C Error), USART_TX_READY_INT_SRC=97 (USART-SPI Data Register Empty/ I2C Stop Received), USART_TX_COMPLETE_INT_SRC=98 (USART-SPI Transmit Complete/ I2C Address Match), USART_RX_INT_SRC=99 (USART-SPI Receive Complete/ I2C Data Ready), SPI_TX_READY_INT_SRC=97 (USART-SPI Data Register Empty/ I2C Stop Received), SPI_TX_COMPLETE_INT_SRC=98 (USART-SPI Transmit Complete/ I2C Address Match), SPI_RX_INT_SRC=99 (USART-SPI Receive Complete/ I2C Data Ready), I2C_0_INT_SRC=96 (USART/SPI/I2C Error), I2C_1_INT_SRC=99 (USART-SPI Receive Complete/ I2C Data Ready), I2C_2_INT_SRC=100 (USART Receive Start/ SPI Slave Select Low/ I2C TX FIFO Empty), I2C_3_INT_SRC=101 (USART Clear To Send Input Change/ I2C RX FIFO Full)
SERCOM5 at 0x45002000 (SERCOM)
  pins: PAD0 PA05/D set 4 or PA11/C set 1 or PA13/C set 2; PAD1 PA06/D set 4 or PA12/C set 1 or PA14/C set 2; PAD2 PA07/D set 4 or PA15/C set 2 or PB00/C set 1; PAD3 PA08/D set 4 or PA16/C set 2 or PB01/C set 1
  parameters: CLK_REDUCTION=1 (Reduce clock options to pin 1 for SPI and USART), DMA=1 (DMA support implemented?), DMAC_ID_RX=43 (Index of DMA RX trigger), DMAC_ID_TX=44 (Index of DMA TX trigger), FIFO_IMPLEMENTED=1 (FIFO Rx/Tx implemented?), FIFO_SIZE=8 (Rx-Tx FIFO size in bytes), FSYNC_IMPLEMENTED=1 (SPI Frame Synch mode implemented?), GCLK_ID_CORE=26, GCLK_ID_SLOW=18, SPI=1 (SPI mode implemented?), TWIM=1 (TWI Master mode implemented?), TWIS=1 (TWI Slave mode implemented?), TWI_HSMODE=1 (TWI HighSpeed mode implemented?), ULTRA_IMPLEMENTATION=0 (ULTRA platform compatibility?), USART=1 (USART mode implemented?), USART_AUTOBAUD=1 (USART autobaud implemented?), USART_IRDA=1 (USART IrDA implemented?), USART_ISO7816=1 (USART ISO7816 mode implemented?), USART_LIN_MASTER=1 (USART LIN Master mode implemented?), USART_RS485=1 (USART RS485 mode implemented?), INSTANCE_ID=65 (Instance index for SERCOM5), MCLK_ID_APB=97 (Index for SERCOM5 APB clock), PAC_ID=65 (Index for SERCOM5 registers write protection), USART_ERROR_INT_SRC=102 (USART/SPI/I2C Error), USART_TX_READY_INT_SRC=103 (USART-SPI Data Register Empty/ I2C Stop Received), USART_TX_COMPLETE_INT_SRC=104 (USART-SPI Transmit Complete/ I2C Address Match), USART_RX_INT_SRC=105 (USART-SPI Receive Complete/ I2C Data Ready), SPI_TX_READY_INT_SRC=103 (USART-SPI Data Register Empty/ I2C Stop Received), SPI_TX_COMPLETE_INT_SRC=104 (USART-SPI Transmit Complete/ I2C Address Match), SPI_RX_INT_SRC=105 (USART-SPI Receive Complete/ I2C Data Ready), I2C_0_INT_SRC=102 (USART/SPI/I2C Error), I2C_1_INT_SRC=105 (USART-SPI Receive Complete/ I2C Data Ready), I2C_2_INT_SRC=106 (USART Receive Start/ SPI Slave Select Low/ I2C TX FIFO Empty), I2C_3_INT_SRC=107 (USART Clear To Send Input Change/ I2C RX FIFO Full)
SPI_IXS at 0x45016000
  pins: FSYNC PA09/J set 2 or PD06/J set 1; SCK PA11/J set 2 or PD10/J set 1; SDI PA12/J set 2 or PD07/J set 1; SDO PB00/J set 2 or PD08/J set 1
  parameters: DMAC_ID_RX=65, DMAC_ID_TX=66, GCLK_ID=36 (Index of Generic Clock), TPD_MASTER=0 (Indicates a master or slave number for TPD mode( 1=master,0=slave)), INSTANCE_ID=75 (Instance index for SPI_IXS), MCLK_ID_APB=107 (Index for SPI_IXS APB clock), PAC_ID=75 (Index for SPI_IXS registers write protection)
SQI at 0x0FFFF000
  pins: CLK PC06/P set 2 or PD10/H set 1; CS0 PC01/P set 2 or PD06/H set 1; CS1 PC00/P set 2 or PD05/H set 1; CS2 PA10/H set 1; CS3 PD12/H set 1; DATA0 PC02/P set 2 or PD07/H set 1; DATA1 PC07/P set 2 or PD11/H set 1; DATA2 PC03/P set 2 or PD08/H set 1; DATA3 PC05/P set 2 or PD09/H set 1
  parameters: ATSPEED_IMPLEMENTED=1, CBUF_DEPTH=3, GCLK_ID=43 (Index of Generic Clock), SFR_ADDRESS=0x0ffff000, TRXBUF_DEPTH=8, XIP_ADDRESS=0x10, XIP_CS_MSB=3, XIP_HSEL=1, INSTANCE_ID=96 (Instance index for SQI), MCLK_ID_AHB=16 (Index for SQI AHB clock), PAC_ID=96 (Index for SQI registers write protection)
SUPC at 0x44008000
  pins: ATEST_ANA ATEST_ANA; EXT_VREF_ANA EXT_VREF_ANA
  parameters: ADDVREG_NUM=1 (Number of additional capless regulators for USB, PLL, ...), ADDVREG_PLL_NUM=0 (Number of additional capless regulators dedicated to PLL(s) (between 0 and ADDVREG_NUM)), ADDVREG_PLL_START_INDEX=1 (Index of the first additional capless regulator dedicated to a PLL within [ADDVREG_NUM-1:0] range. Must be equal to 1 if ADDVREG_PLL_NUM=0.), BKOUT_NUM=2 (Number of BKOUT output pin), BORVDDUSB_NUM=1 (Number of BOR_USB), CHRG_PUMP_NUM=2 (Number of Charge Pump), IOB_IMPLEMENTED=1 (one if IOB feature is implemented), RPMU_DEVICE_TYP=OTHERS (Defines the device name this macro is being instantiated in. Will control any register differences between devices.), USER_LDO_IMPLEMENTED=0 (one if USER_LDO feature is implemented), VBAT_IMPLEMENTED=1 (one if VBAT feature (battery backup feature) is implemented.), VREGSW_NUM=3 (Number of main voltage regulator (100mA). Example: 1 for Unicorn, 4 for Riverside.), INSTANCE_ID=4 (Instance index for SUPC), MCLK_ID_APB=36 (Index for SUPC APB clock), PAC_ID=4 (Index for SUPC registers write protection)
SysTick at 0xE000E010
SysTick_NS at 0xE002E010 (SysTick)
  parameters: __SYST_NUM=2 (Number of implemented SysTick timers)
TCC0 at 0x44818000 (TCC)
  pins: WO0 PB10/G set 2 or PB04/F set 1; WO1 PC00/G set 2 or PB05/F set 1; WO2 PC01/G set 2 or PB13/F set 1; WO3 PC02/G set 2 or PB06/F set 1; WO4 PC03/G set 2 or PB14/F set 1; WO5 PC04/G set 2 or PB15/F set 1
  parameters: CC_NUM=6 (Number of Compare/Capture units), DITHERING=1 (Dithering feature implemented), DMAC_ID_MC_{n}={n+14} (Indexes of DMA Match/Compare triggers {n}) (n=0..5), DMAC_ID_OVF=13 (DMA overflow/underflow/retrigger trigger), DTI=1 (Dead-Time-Insertion feature implemented), GCLK_ID=23 (Index of Generic Clock), MASTER_SLAVE_MODE=1 (TCC type 0 : NA, 1 : Master, 2 : Slave), OTMX=1 (Output Matrix feature implemented), OW_NUM=8 (Number of Output Waveforms), PG=1 (Pattern Generation feature implemented), SIZE=32, SWAP=1 (DTI outputs swap feature implemented), INSTANCE_ID=44 (Instance index for TCC0), MCLK_ID_APB=75 (Index for TCC0 APB clock), PAC_ID=44 (Index for TCC0 registers write protection)
TCC1 at 0x4481A000 (TCC)
  pins: WO0 PC05/G set 2 or PC15/F set 1; WO1 PC06/G set 2 or PC16/F set 1; WO2 PC07/G set 2 or PC17/F set 1; WO3 PC09/G set 2 or PC18/F set 1; WO4 PC15/G set 2 or PC19/F set 1; WO5 PC10/G set 2 or PC20/F set 1; WO6 PC11/G set 2; WO7 PC12/G set 2
  parameters: CC_NUM=6 (Number of Compare/Capture units), DITHERING=1 (Dithering feature implemented), DMAC_ID_MC_{n}={n+21} (Indexes of DMA Match/Compare triggers {n}) (n=0..5), DMAC_ID_OVF=20 (DMA overflow/underflow/retrigger trigger), DTI=1 (Dead-Time-Insertion feature implemented), GCLK_ID=23 (Index of Generic Clock), MASTER_SLAVE_MODE=2 (TCC type 0 : NA, 1 : Master, 2 : Slave), OTMX=1 (Output Matrix feature implemented), OW_NUM=8 (Number of Output Waveforms), PG=1 (Pattern Generation feature implemented), SIZE=32, SWAP=1 (DTI outputs swap feature implemented), INSTANCE_ID=45 (Instance index for TCC1), MCLK_ID_APB=76 (Index for TCC1 APB clock), PAC_ID=45 (Index for TCC1 registers write protection)
TCC2 at 0x4481C000 (TCC)
  pins: WO0 PD05/G set 2 or PA00/F set 1 2; WO1 PD06/G set 2 or PC11/F set 2 or PD12/F set 1; WO2 PD07/G set 2 or PC10/F set 2 or PD11/F set 1; WO3 PD08/G set 2 or PA01/F set 1 2; WO4 PD09/G set 2 or PD06/F set 1 2; WO5 PD10/G set 2 or PD07/F set 1 2; WO6 PD11/G set 2; WO7 PD12/G set 2
  parameters: CC_NUM=6 (Number of Compare/Capture units), DITHERING=1 (Dithering feature implemented), DMAC_ID_MC_{n}={n+28} (Indexes of DMA Match/Compare triggers {n}) (n=0..5), DMAC_ID_OVF=27 (DMA overflow/underflow/retrigger trigger), DTI=1 (Dead-Time-Insertion feature implemented), GCLK_ID=24 (Index of Generic Clock), MASTER_SLAVE_MODE=1 (TCC type 0 : NA, 1 : Master, 2 : Slave), OTMX=1 (Output Matrix feature implemented), OW_NUM=8 (Number of Output Waveforms), PG=1 (Pattern Generation feature implemented), SIZE=32, SWAP=1 (DTI outputs swap feature implemented), INSTANCE_ID=46 (Instance index for TCC2), MCLK_ID_APB=77 (Index for TCC2 APB clock), PAC_ID=46 (Index for TCC2 registers write protection)
TCC3 at 0x4481E000 (TCC)
  pins: WO0 PA09/G set 2 3 or PA04/F set 1; WO1 PA10/G set 2 3 or PA05/F set 1; WO2 PA11/G set 2 3 or PA06/F set 1; WO3 PA12/G set 2 3 or PA07/F set 1; WO4 PB00/G set 2 3 or PA08/F set 1; WO5 PB01/G set 2 3 or PA18/F set 1; WO6 PA06/G set 3 or PB11/G set 2; WO7 PA07/G set 3 or PB12/G set 2 or PA19/F set 1
  parameters: CC_NUM=6 (Number of Compare/Capture units), DITHERING=1 (Dithering feature implemented), DMAC_ID_MC_{n}={n+35} (Indexes of DMA Match/Compare triggers {n}) (n=0..5), DMAC_ID_OVF=34 (DMA overflow/underflow/retrigger trigger), DTI=1 (Dead-Time-Insertion feature implemented), GCLK_ID=24 (Index of Generic Clock), MASTER_SLAVE_MODE=2 (TCC type 0 : NA, 1 : Master, 2 : Slave), OTMX=1 (Output Matrix feature implemented), OW_NUM=8 (Number of Output Waveforms), PG=1 (Pattern Generation feature implemented), SIZE=32, SWAP=1 (DTI outputs swap feature implemented), INSTANCE_ID=47 (Instance index for TCC3), MCLK_ID_APB=78 (Index for TCC3 APB clock), PAC_ID=47 (Index for TCC3 registers write protection)
TCC4 at 0x45008000 (TCC)
  pins: WO0 PA11/F set 1 or PA13/F set 2 or PB12/F set 4; WO1 PA12/F set 1 or PA14/F set 2
  parameters: CC_NUM=2 (Number of Compare/Capture units), DITHERING=0 (Dithering feature implemented), DMAC_ID_MC_0=50 (Indexes of DMA Match/Compare triggers 0), DMAC_ID_MC_1=51 (Indexes of DMA Match/Compare triggers 1), DMAC_ID_OVF=49 (DMA overflow/underflow/retrigger trigger), DTI=0 (Dead-Time-Insertion feature implemented), GCLK_ID=29 (Index of Generic Clock), MASTER_SLAVE_MODE=0 (TCC type 0 : NA, 1 : Master, 2 : Slave), OTMX=0 (Output Matrix feature implemented), OW_NUM=2 (Number of Output Waveforms), PG=0 (Pattern Generation feature implemented), SIZE=16, SWAP=0 (DTI outputs swap feature implemented), INSTANCE_ID=68 (Instance index for TCC4), MCLK_ID_APB=100 (Index for TCC4 APB clock), PAC_ID=68 (Index for TCC4 registers write protection)
TCC5 at 0x4500A000 (TCC)
  pins: WO0 PA15/F set 2 or PB00/F set 1; WO1 PA16/F set 2 or PB01/F set 1
  parameters: CC_NUM=2 (Number of Compare/Capture units), DITHERING=0 (Dithering feature implemented), DMAC_ID_MC_0=53 (Indexes of DMA Match/Compare triggers 0), DMAC_ID_MC_1=54 (Indexes of DMA Match/Compare triggers 1), DMAC_ID_OVF=52 (DMA overflow/underflow/retrigger trigger), DTI=0 (Dead-Time-Insertion feature implemented), GCLK_ID=30 (Index of Generic Clock), MASTER_SLAVE_MODE=0 (TCC type 0 : NA, 1 : Master, 2 : Slave), OTMX=0 (Output Matrix feature implemented), OW_NUM=2 (Number of Output Waveforms), PG=0 (Pattern Generation feature implemented), SIZE=16, SWAP=0 (DTI outputs swap feature implemented), INSTANCE_ID=69 (Instance index for TCC5), MCLK_ID_APB=101 (Index for TCC5 APB clock), PAC_ID=69 (Index for TCC5 registers write protection)
TPIU at 0xE0040000
TRAM at 0x4401E000
  parameters: ADDR_MSB=7 (Value of the MSB bit of physical RAM address), INSTANCE_ID=15 (Instance index for TRAM), MCLK_ID_APB=47 (Index for TRAM APB clock), PAC_ID=15 (Index for TRAM registers write protection)
TRNG at 0x45024000
  parameters: INSTANCE_ID=82 (Instance index for TRNG), MCLK_ID_APB=112 (Index for TRNG APB clock), PAC_ID=82 (Index for TRNG registers write protection)
USB at 0x4502A000
  pins: DM PD03/H set 1; DP PD04/H set 1; SOF_1KHZ PC01/H set 2 or PD02/H set 1
  parameters: AHB_2_USB_FIFO_DEPTH=4 (bytes number, should be at least 2, and 2^n (4,8,16 ...)), AHB_2_USB_RD_DATA_BITS=8 (8, 16 or 32, here : 8-bits is required as UTMI interface should work in 8-bits mode), AHB_2_USB_WR_DATA_BITS=32 (8, 16 or 32 : here, AHB transfer is made in word mode), AHB_2_USB_WR_THRESHOLD=2 (as soon as there are N bytes-free inside the fifo, ahb read transfer is requested), DATA_BUS_16_8=0 (UTMI/SIE data bus size : 0 -> 8 bits, 1 -> 16 bits), EPNUM=8 (parameter for rtl : max of ENDPOINT and PIPE NUM), EPT_NUM=8 (Number of USB end points), GCLK_ID=46 (Index of Generic Clock), INITIAL_CONTROL_QOS=3 (CONTROL QOS RESET value), INITIAL_DATA_QOS=3 (DATA QOS RESET value), MISSING_SOF_DET_IMPLEMENTED=1 (48 mHz xPLL feature implemented), PIPE_NUM=8 (Number of USB pipes), SYSTEM_CLOCK_IS_CKUSB=0 (Dual (1'b0) or Single (1'b1) clock system), USB_2_AHB_FIFO_DEPTH=4 (bytes number, should be at least 2, and 2^n (4,8,16 ...)), USB_2_AHB_RD_DATA_BITS=16 (8, 16 or 32, here : 8-bits is required as UTMI interface should work in 8-bits mode), USB_2_AHB_RD_THRESHOLD=2 (as soon as there are 16 bytes-free inside the fifo, ahb read transfer is requested), USB_2_AHB_WR_DATA_BITS=8 (8, 16 or 32 : here : 8-bits is required as UTMI interface should work in 8-bits mode), INSTANCE_ID=85 (Instance index for USB), MCLK_ID_AHB=19 (Index for USB AHB clock), MCLK_ID_APB=113 (Index for USB APB clock), PAC_ID=85 (Index for USB registers write protection)
WDT at 0x44016000
  parameters: FUSES_UPDATE_SUPPORT=0 (WDT Fuse Update Support), INSTANCE_ID=11 (Instance index for WDT), MCLK_ID_APB=43 (Index for WDT APB clock), PAC_ID=11 (Index for WDT registers write protection)

## Notices in the file
Copyright (c) 2021 Microchip Technology Inc.
SPDX-License-Identifier: Apache-2.0
Licensed under the Apache License, Version 2.0 (the "License");
you may not use this file except in compliance with the License.
You may obtain a copy of the License at
http://www.apache.org/licenses/LICENSE-2.0
Unless required by applicable law or agreed to in writing, software
distributed under the License is distributed on an "AS IS" BASIS,
WITHOUT WARRANTIES OR CONDITIONS OF ANY KIND, either express or implied.
See the License for the specific language governing permissions and
limitations under the License.
