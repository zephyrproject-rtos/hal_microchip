# PIC32CM6408PL10064 device description
Architecture: CORTEX-M0PLUS; Family: PIC32CMPL; Series: PIC32CMPL10
Parameters: __CM0PLUS_REV=0x0001 (Cortex-M0+ Core Revision), __MPU_PRESENT=0 (MPU present or not), __NVIC_PRIO_BITS=2 (Number of Bits used for Priority Levels), __VTOR_PRESENT=1 (Vector Table Offset Register present or not), __Vendor_SysTickConfig=0 (Set to 1 if different SysTick Config is used)
Programming and debug interfaces: SWD
Registers are 32-bit, read-write, reset 0x0 unless marked. A register's access mark holds for its fields unless they carry their own. Offsets are from the block's base; lines under a group give offsets from that group; [hi:lo] are bit positions; {n}, {i} and the like mark numbered series; 'fields as' and 'values as' point back to an identical list; <NAME> marks a mode.

## Ordering variants
PIC32CM6408PL10064-I/5LX: VQFN64 WF, pinout QUAD64MVIO, up to 24 MHz, -40 to 85 C, 1.8 to 5.5 V
PIC32CM6408PL10064-E/5LX: VQFN64 WF, pinout QUAD64MVIO, up to 24 MHz, -40 to 125 C, 1.8 to 5.5 V
PIC32CM6408PL10064-I/PT: TQFP64, pinout QUAD64MVIO, up to 24 MHz, -40 to 85 C, 1.8 to 5.5 V
PIC32CM6408PL10064-E/PT: TQFP64, pinout QUAD64MVIO, up to 24 MHz, -40 to 125 C, 1.8 to 5.5 V

## Memory
base space: start 0 size 0x100000000, little endian
  0x00000000 BROM size 0x8000 rom, ro, executable
  0x0C000000 FLASH size 0x10000 flash, rw, executable, page 512
  0x0D000400 BOOTCFG size 0x100 fuses, ro
  0x0D000200 SIGNATURE size 0x100 fuses, ro
  0x20000000 HSRAM size 0x2000 ram, rw, executable
  0x40000000 APBA size 0x4000 io, rw
  0x41000000 APBB size 0x10000 io, rw
  0x42000000 APBC size 0x8000 io, rw
  0x50000000 IOBUS size 0x200 io, rw
  0xE0000000 PPB size 0x100000 io, rw
fuses space: start 0x00000000 size 0x20000000, little endian

## Peripheral instances (address, pins/pin function, parameters)
AC at 0x42002000
  pins: AC0N0 PA19/B; AC0N1 PA16/B; AC0N2 PA23/B; AC0P0 PA18/B; AC0P1 PB08/B; AC0P2 PB10/B; AC0P3 PA22/B; AC0P5 PA20/B; AC0P6 PA21/B; AC1N0 PA21/B; AC1N1 PA16/B; AC1N2 PA23/B; AC1P0 PA18/B; AC1P1 PA19/B; AC1P2 PA20/B; AC1P3 PA22/B; AC1P5 PA21/B; CMP0 PA07/H or PA15/H; CMP1 PA05/H or PA13/H
  parameters: NUM_CMP=2 (Number of comparators), PAIRS=1 (Number of pairs of comparators), INSTANCE_ID=72 (Instance index for AC)
ADC0 at 0x42001C00 (ADC)
  pins: AIN2 PA02/B; AIN3 PA03/B; AIN4 PA04/B; AIN5 PA05/B; AIN6 PA06/B; AIN7 PA07/B; AIN{n} PA{n}/B (n=16..29); AIN31 PA31/B; AIN{n} PB{n-32:02}/B (n=40..47); VREFP PA23/B
  parameters: DMAC_ID_RESRDY=19 (Index of DMA RESRDY trigger), DMAC_ID_SAMPRDY=20 (Index of DMA SAMPRDY trigger), INSTANCE_ID=71 (Instance index for ADC0)
CCL at 0x42002400
  pins: IN0 PA00/H; IN1 PA01/H; IN2 PA02/H; IN3 PA08/H; IN4 PA09/H; IN5 PA10/H; IN6 PA16/H; IN7 PA17/H; IN8 PA18/H; IN9 PA24/H; IN10 PA25/H; IN11 PA26/H; OUT0 PA03/H or PA06/H; OUT1 PA11/H or PA14/H; OUT2 PA19/H or PA22/H; OUT3 PA27/H
  parameters: CCL_WPCTRL_KEY=0x43434C ("CCL" in ASCII, key used to access Write Protection Register), GCLK_ID=12 (GCLK index for CCL), IO_NUM=12 (Numer of input pins), LUT_NUM=4 (Number of LUT in a CCL), SEQ_NUM=2 (Number of SEQ in a CCL), INSTANCE_ID=73 (Instance index for CCL)
DMAC at 0x41006000
  parameters: CH_BITS=1 (Number of bits to select channel), CH_NUM=2 (Number of channels), EVIN_NUM=2 (Number of input events), EVOUT_NUM=2 (Number of output events), LVL_BITS=2 (Number of bit to select level priority), LVL_NUM=4 (Enable priority level number), QOSCTRL_D_RESETVALUE=2 (QOS dmac ahb interface reset value), QOSCTRL_F_RESETVALUE=2 (QOS dmac fetch interface reset value), QOSCTRL_WRB_RESETVALUE=2 (QOS dmac write back interface reset value), SPLIT_IRQ_NUM=0 (Number of IRQ split out), TRIG_BITS=5 (Number of bits to select trigger source), TRIG_NUM=23 (Number of peripheral triggers), INSTANCE_ID=35 (Instance index for DMAC)
DSU at 0x41002000
  pins: MSA PA21/dsu_msa_alt or PA01/dsu_msa; SWCCSTAT PA21/dsu_swccstat_alt or PA01/dsu_swccstat; TDTI_DATA0 PA01/TDTI_8W_ALT1 or PA01/TDTI_8W or PA01/TDTI_4W_ALT3 or PA01/TDTI_4W_ALT2 or PA01/TDTI_4W_ALT1 or PA01/TDTI_4W or PA21/TDTI_1W_ALT1 or PA01/TDTI_1W; TDTI_DATA1 PA20/TDTI_8W_ALT1 or PA09/TDTI_8W or PA20/TDTI_4W_ALT3 or PA23/TDTI_4W_ALT2 or PA20/TDTI_4W_ALT1 or PA09/TDTI_4W; TDTI_DATA2 PA31/TDTI_8W_ALT1 or PA10/TDTI_8W or PA31/TDTI_4W_ALT3 or PA22/TDTI_4W_ALT2 or PA31/TDTI_4W_ALT1 or PA10/TDTI_4W; TDTI_DATA3 PA21/TDTI_8W_ALT1 or PA11/TDTI_8W or PA23/TDTI_4W_ALT3 or PA21/TDTI_4W_ALT2 or PA21/TDTI_4W_ALT1 or PA11/TDTI_4W; TDTI_DATA4 PA09/TDTI_8W_ALT1 or PA04/TDTI_8W; TDTI_DATA5 PA10/TDTI_8W_ALT1 or PA05/TDTI_8W; TDTI_DATA6 PA11/TDTI_8W_ALT1 or PA06/TDTI_8W; TDTI_DATA7 PA23/TDTI_8W_ALT1 or PA07/TDTI_8W
  parameters: DMAC_ID_DCC0=21 (Index of DMA DCC0 trigger), DMAC_ID_DCC1=22 (Index of DMA DCC1 trigger), INSTANCE_ID=33 (Instance index for DSU)
EIC at 0x40002800
  pins: EXTINT0 PA16/A or PB00/A or PB16/A or PA00/A; EXTINT1 PA17/A or PB01/A or PB17/A; EXTINT2 PA02/A or PA18/A or PB02/A or PB18/A; EXTINT3 PA03/A or PA19/A or PB03/A or PB19/A; EXTINT4 PA04/A or PA20/A or PB04/A or PB20/A; EXTINT5 PA05/A or PA21/A or PB05/A or PB21/A; EXTINT6 PA06/A or PA22/A or PB06/A or PB22/A; EXTINT7 PA23/A or PB07/A or PB23/A; EXTINT8 PA08/A or PA24/A or PB08/A; EXTINT9 PA09/A or PA25/A or PB09/A; EXTINT10 PA10/A or PA26/A or PB10/A; EXTINT11 PA11/A or PA27/A or PB11/A; EXTINT12 PA12/A or PA28/A or PB12/A; EXTINT13 PA13/A or PA29/A or PB13/A; EXTINT14 PA14/A or PB14/A; EXTINT15 PA15/A or PA31/A or PB15/A; NMI PA01/A or PA07/A or PA30/A
  parameters: EXTINT_NUM=16, GCLK_ID=0, NUMBER_OF_CONFIG_REGS=2, NUMBER_OF_INTERRUPTS=16, INSTANCE_ID=10 (Instance index for EIC)
EVSYS at 0x42000000
  parameters: CHANNELS=4 (Number of Channels), CHANNELS_BITS=2 (Number of bits to select Channel), CHANNELS_MSB=3 (Number of Channels - 1), EXTEVT_NUM=0 (Number of External Event Generators), GCLK_ID_0=1 (Index of Generic Clocks 0), GCLK_ID_1=2 (Index of Generic Clocks 1), GCLK_ID_2=3 (Index of Generic Clocks 2), GCLK_ID_3=4 (Index of Generic Clocks 3), GENERATORS=62 (Total Number of Event Generators), GENERATORS_BITS=6 (Number of bits to select Event Generator), USERS=23 (Total Number of Event Users), USERS_BITS=5 (Number of bits to select Event User), INSTANCE_ID=64 (Instance index for EVSYS)
FUSES at FUSES_BOOTCFG 0x0D000400, FUSES_SIGNATURE 0x0D000200
GCLK at 0x40001C00
  pins: IO0 PA07/I or PA23/I or PA31/I or PA03/I; IO1 PA04/I or PA08/I or PA11/I or PA22/I or PA24/I or PA29/I or PA00/I; IO2 PA05/I or PA09/I or PA20/I or PA25/I or PA01/I; IO3 PA02/I or PA06/I or PA10/I or PA21/I or PA26/I
  parameters: GENDIV_BITS=16, GEN_BITS=2, GEN_NUM=4 (Number of Generic Clock Generators), GEN_NUM_MSB=3 (Number of Generic Clock Generators - 1), GEN_SOURCE_NUM_MSB=5 (Number of Generic Clock Sources - 1), NUM=13 (Number of Generic Clock Users), SOURCE_BITS=3, SOURCE_GCLKGEN1=2, SOURCE_GCLKIN=1, SOURCE_NUM=6 (Number of Generic Clock Sources), SOURCE_OSCHF=0, SOURCE_OSC32K=3, SOURCE_OSC600K_DIV4=5, SOURCE_XOSC=0, SOURCE_XOSC32K=4, INSTANCE_ID=7 (Instance index for GCLK)
HMATRIXHS at 0x4100A000 (HMATRIXB)
  parameters: INSTANCE_ID=37 (Instance index for HMATRIXHS)
MCLK at 0x40000800
  parameters: CTRLA_MCSEL_GCLK=1, CTRLA_MCSEL_OSC8M=0, MCLK_CLK_APB_NUM=3, SYSTEM_CLOCK=4000000 (System Clock Frequency at Reset), INSTANCE_ID=2 (Instance index for MCLK)
  clocks: AHB APBA bit 0, APBB bit 1, APBC bit 2, DSU bit 3, HMATRIXHS bit 4, NVMCTRL bit 5, HSRAM bit 6, DMAC bit 7, PAC bit 8, BROM bit 9
MTB at 0x41008000
  parameters: INSTANCE_ID=36 (Instance index for MTB)
NVIC at 0xE000E100
  parameters: NUM_IRQ=15 (Number of interrupt requests), __NVIC_PRIO_BITS=2 (Number of NVIC interrupt priority bits)
NVMCTRL at 0x41004000
  parameters: FACTORY_WORD_IMPLEMENTED_MASK=0xC0000007FFFFFFFF, PMSB=3, PSZ_BITS=9, REGION_LOCK_NUM=16 (Number of regions that can be individually protected or unprotected), ROW_PAGES=4, USER_WORD_IMPLEMENTED_MASK=0xC01FFFFFFFFFFFFF, FLASH_SIZE=65536, PAGE_SIZE=512, PAGES=128, PAGES_PR_REGION=8, INSTANCE_ID=34 (Instance index for NVMCTRL)
OSC32KCTRL at 0x40001400
  pins: XIN32 PA24/XIN32; XOUT32 PA25/XOUT32
  parameters: HAS_XOSC32K=1 (OSC32K module includes external 32KHz), OSC32K_CALIB_MSB=5 (Bits for internal OSC32kHz Calibration), INSTANCE_ID=5 (Instance index for OSC32KCTRL)
OSCCTRL at 0x40001000
  parameters: INSTANCE_ID=4 (Instance index for OSCCTRL)
PAC at 0x40000000
  parameters: HPB_NUM=3 (Number of bridges AHB/APB), INTFLAG_NUM=4 (Number of intflag registers), INSTANCE_ID=0 (Instance index for PAC)
PM at 0x40000400
  parameters: INSTANCE_ID=1 (Instance index for PM)
PORT at 0x41000000, PORT_IOBUS 0x50000000
  pins: P{n} PA{n:02} (n=0..31); P{n} PB{n-32:02} (n=32..55)
  parameters: BITS=56, DIR_DEFAULT_VAL=0x00000000 0x00000000, DIR_IMPLEMENTED=0xBFFFFFFF 0x00FFFFFF, DRVSTR=0 (DRVSTR supported?), DRVSTR_DEFAULT_VAL=0x00000000 0x00000000, DRVSTR_IMPLEMENTED=0x00000000 0x00000000, EVENT_IMPLEMENTED=0xFFFFFFFF 0x00FFFFFF, EV_NUM=4, GROUPS=2, INEN_DEFAULT_VAL=0x00000000 0x00000000, INEN_IMPLEMENTED=0xFFFFFFFF 0x00FFFFFF, ODRAIN=0 (ODRAIN supported?), ODRAIN_DEFAULT_VAL=0x00000000 0x00000000, ODRAIN_IMPLEMENTED=0x00000000 0x00000000, OUT_DEFAULT_VAL=0x00000000 0x00000000, OUT_IMPLEMENTED=0xBFFFFFFF 0x00FFFFFF, PIN_IMPLEMENTED=0xFFFFFFFF 0x00FFFFFF, PMUXBIT0_DEFAULT_VAL=0x00000000 0x00000000, PMUXBIT0_IMPLEMENTED=0xBFFFEFFF 0x000FFF0F, PMUXBIT1_DEFAULT_VAL=0x80000000 0x00000000, PMUXBIT1_IMPLEMENTED=0xBFFFFFFF 0x0000FF0F, PMUXBIT2_DEFAULT_VAL=0x80000000 0x00000000, PMUXBIT2_IMPLEMENTED=0xBFFFEFFF 0x003FFF0F, PMUXBIT3_DEFAULT_VAL=0x00000000 0x00000000, PMUXBIT3_IMPLEMENTED=0xBFFF0FFF 0x0000FF00, PMUXEN_DEFAULT_VAL=0x80000000 0x00000000, PMUXEN_IMPLEMENTED=0xFFFFFFFF 0x00FFFFFF, PULLEN_DEFAULT_VAL=0x00000000 0x00000000, PULLEN_IMPLEMENTED=0xFFFFFFFF 0x00FFFFFF, SLEWLIM=1 (SLEWLIM supported?), SLEWLIM_DEFAULT_VAL=0x00000000 0x00000000, SLEWLIM_IMPLEMENTED=0xBFFFFFFF 0x00FFFFFF, INSTANCE_ID=32 (Instance index for PORT)
PTC
  pins: PAD2 PA02/P; PAD3 PA03/P; PAD4 PA04/P; PAD5 PA05/P; PAD6 PA06/P; PAD7 PA07/P; PAD{n} PA{n}/P (n=16..29); PAD31 PA31/P; PAD{n} PB{n-32:02}/P (n=40..47); PTC_EXTCINT PA21/B; PTC_EXTCINT1 PA22/B
  parameters: INSTANCE_ID=74 (Instance index for PTC)
RSTC at 0x40000C00
  parameters: INSTANCE_ID=3 (Instance index for RSTC)
RTC at 0x40002400
  parameters: ALARM_NUM=1 (Number of Alarms), COMP16_NUM=2 (Number of 16-bit Comparators), COMP32_NUM=1 (Number of 32-bit Comparators), GPR_NUM=0 (Number of General-Purpose Registers), PER_NUM=8 (Number of Periodic Intervals), INSTANCE_ID=9 (Instance index for RTC)
SERCOM0 at 0x42000400 (SERCOM)
  pins: PAD0 PA10/D or PA00/C or PA04/C; PAD1 PA11/D or PA01/C or PA05/C; PAD2 PA08/D or PA31/D or PA02/C or PA06/C; PAD3 PA09/D or PA03/C or PA07/C
  parameters: DMAC_ID_RX=1 (Index of DMA RX trigger), DMAC_ID_TX=2 (Index of DMA TX trigger), GCLK_ID_CORE=6, GCLK_ID_SLOW=5, INT_MSB=6, PMSB=3, INSTANCE_ID=65 (Instance index for SERCOM0)
SERCOM1 at 0x42000800 (SERCOM)
  pins: PAD0 PA00/D or PA26/D or PB00/D or PA10/C or PA14/C or PA20/C or PA31/C; PAD1 PA01/D or PA27/D or PB01/D or PA11/C or PA15/C; PAD2 PA02/D or PA24/D or PB02/D or PA08/C or PA12/C or PA22/C; PAD3 PA03/D or PA25/D or PB03/D or PA09/C or PA13/C or PA23/C
  parameters: DMAC_ID_RX=3 (Index of DMA RX trigger), DMAC_ID_TX=4 (Index of DMA TX trigger), GCLK_ID_CORE=8, GCLK_ID_SLOW=7, INT_MSB=6, PMSB=3, INSTANCE_ID=66 (Instance index for SERCOM1)
SUPC at 0x40001800
  parameters: INSTANCE_ID=6 (Instance index for SUPC)
SYSCTRL at 0x42002C00
  pins: ATWI PA21/ATWI_ALT3 or PA23/ATWI_ALT2 or PA22/ATWI_ALT1; ATWO PA23/ATWO_ALT3 or PA22/ATWO_ALT2 or PA21/ATWO_ALT1; DTWROUTE0 PA04/DTW0_ALT4 or PA08/DTW0_ALT3 or PA30/DTW0_ALT2 or PA20/DTW0_ALT1; DTWROUTE1 PA05/DTW1_ALT4 or PA09/DTW1_ALT3 or PA31/DTW1_ALT2 or PA21/DTW1_ALT1; DTWROUTE2 PA06/DTW2_ALT4 or PA10/DTW2_ALT3 or PA00/DTW2_ALT2 or PA22/DTW2_ALT1; DTWROUTE3 PA07/DTW3_ALT4 or PA11/DTW3_ALT3 or PA01/DTW3_ALT2 or PA23/DTW3_ALT1; ICELL0 PA20/ICELL0_ALT1; ICELL11 PA21/ICELL1_ALT1; PULLDIS PA30/PULLDIS; TBUF PA21/TBUF_ALT or PA22/TBUF
  parameters: INSTANCE_ID=75 (Instance index for SYSCTRL)
SysTick at 0xE000E010
SystemControl at 0xE000E000
  parameters: __VTOR_PRESENT=1 (Vector Table Offset Register present)
TC0 at 0x42000C00 (TC)
  pins: WO0 PA00/E or PA10/E; WO1 PA01/E or PA11/E
  parameters: CC_NUM=2, DMAC_ID_MC_0=6 (Indexes of DMA Match/Compare triggers 0), DMAC_ID_MC_1=7 (Indexes of DMA Match/Compare triggers 1), DMAC_ID_OVF=5 (Indexes of DMA Overflow trigger), EXT=0 (Coding of implemented extended features (keep 0 value)), GCLK_ID=9 (Index of Generic Clock), MASTER_SLAVE_MODE=1 (TC type 0 : NA, 1 : Master, 2 : Slave), OW_NUM=2 (Number of Output Waveforms), INSTANCE_ID=67 (Instance index for TC0)
TC1 at 0x42001000 (TC)
  pins: WO0 PA02/E or PA08/E; WO1 PA03/E or PA09/E
  parameters: CC_NUM=2, DMAC_ID_MC_0=9 (Indexes of DMA Match/Compare triggers 0), DMAC_ID_MC_1=10 (Indexes of DMA Match/Compare triggers 1), DMAC_ID_OVF=8 (Indexes of DMA Overflow trigger), EXT=0 (Coding of implemented extended features (keep 0 value)), GCLK_ID=9 (Index of Generic Clock), MASTER_SLAVE_MODE=2 (TC type 0 : NA, 1 : Master, 2 : Slave), OW_NUM=2 (Number of Output Waveforms), INSTANCE_ID=68 (Instance index for TC1)
TC2 at 0x42001400 (TC)
  pins: WO0 PA20/E or PB20/E; WO1 PA21/E or PB21/E
  parameters: CC_NUM=2, DMAC_ID_MC_0=12 (Indexes of DMA Match/Compare triggers 0), DMAC_ID_MC_1=13 (Indexes of DMA Match/Compare triggers 1), DMAC_ID_OVF=11 (Indexes of DMA Overflow trigger), EXT=0 (Coding of implemented extended features (keep 0 value)), GCLK_ID=10 (Index of Generic Clock), MASTER_SLAVE_MODE=0 (TC type 0 : NA, 1 : Master, 2 : Slave), OW_NUM=2 (Number of Output Waveforms), INSTANCE_ID=69 (Instance index for TC2)
TCC0 at 0x42001800 (TCC)
  pins: WO0 PA00/F or PA08/F or PA16/F or PA24/F or PB00/F or PB08/F or PB16/F; WO1 PA01/F or PA09/F or PA17/F or PA25/F or PB01/F or PB09/F or PB17/F; WO2 PA02/F or PA10/F or PA18/F or PA26/F or PB02/F or PB10/F or PB18/F; WO3 PA03/F or PA11/F or PA19/F or PA27/F or PB03/F or PB11/F or PB19/F
  parameters: CC_NUM=4 (Number of Compare/Capture units), DITHERING=0 (Dithering feature implemented), DMAC_ID_MC_0=15 (Indexes of DMA Match/Compare triggers 0), DMAC_ID_MC_1=16 (Indexes of DMA Match/Compare triggers 1), DMAC_ID_MC_2=17 (Indexes of DMA Match/Compare triggers 2), DMAC_ID_MC_3=18 (Indexes of DMA Match/Compare triggers 3), DMAC_ID_OVF=14 (DMA overflow/underflow/retrigger trigger), DTI=0 (Dead-Time-Insertion feature implemented), GCLK_ID=11 (Index of Generic Clock), MASTER_SLAVE_MODE=0 (TCC type 0 : NA, 1 : Master, 2 : Slave), OTMX=1 (Output Matrix feature implemented), OW_NUM=4 (Number of Output Waveforms), PG=1 (Pattern Generation feature implemented), SIZE=16, SWAP=0 (DTI outputs swap feature implemented), INSTANCE_ID=70 (Instance index for TCC0)
WDT at 0x40002000
  parameters: INSTANCE_ID=8 (Instance index for WDT)

## Interrupts
-15 Reset — Reset Vector, invoked on Power up and warm reset
-14 NonMaskableInt — Non maskable Interrupt, cannot be stopped or preempted
-13 HardFault — Hard Fault, all classes of Fault
-5 SVCall — System Service Call via SVC instruction
-2 PendSV — Pendable request for system service
-1 SysTick — System Tick Timer
0 SYSTEM (MCLK OSCCTRL OSC32KCTRL PAC SUPC)
1 WDT
2 RTC
3 EIC
4 NVMCTRL
5 DMAC
6 EVSYS
7 SERCOM0
8 SERCOM1
9 TC0
10 TC1
11 TC2
12 TCC0
13 ADC0
14 AC

## Event generators
1 OSC32KCTRL_CLKFAIL, 2 SUPC_MVIO, 3 SUPC_VLM, 4 RTC_CMP_0, 5 RTC_CMP_1, 6 RTC_OVF, {n+7} RTC_PER_{n} (n=0..7), {n+15} EIC_EXTINT_{n} (n=0..15), 31 DMAC_CH_0, 32 DMAC_CH_1, {3n+33} TC{n}_OVF (n=0..2), {3n+34} TC{n}_MC_0 (n=0..2), {3n+35} TC{n}_MC_1 (n=0..2), 42 TCC0_OVF, 43 TCC0_TRG, 44 TCC0_CNT, {n+45} TCC0_MC_{n} (n=0..3), 49 ADC0_RESRDY, 50 ADC0_SAMPRDY, 51 ADC0_WCMP, 52 AC_COMP_0, 53 AC_COMP_1, 54 AC_WIN_0, {n+55} CCL_LUTOUT_{n} (n=0..3), 59 SYSCTRL_OSCTEST, 60 PAC_ACCERR, 61 DSU_SWCCSTAT, 62 DSU_COMP

## Event users
{n} PORT_EV_{n} (n=0..3), 4 DMAC_CH_0, 5 DMAC_CH_1, {n+6} TC{n}_EVU (n=0..2), 9 TCC0_EV_0, 10 TCC0_EV_1, {n+11} TCC0_MC_{n} (n=0..3), 15 ADC0_START, {n+16} CCL_LUTIN_{n} (n=0..3), 20 MTB_START, 21 MTB_STOP, 22 SYSCTRL_OSCTEST

## Properties
SIGNATURES: DSU_DID=0x0BA03053

## Pinouts (pin number, pad)
QUAD64MVIO: 1 PA03, 2 PA04, 3 PA05, 4 PA06, 5 PA07, 6 VDDPAD, 7 GNDPAD, 8 PB00, 9 PB01, 10 PB02, 11 PB03, 12 PB04, 13 PB05, 14 PB06, 15 PB07, 16 PA08, 17 PA09, 18 PA10, 19 PA11, 20 VDDIO2PAD, 21 GNDPAD, 22 PA12, 23 PA13, 24 PA14, 25 PA15, 26 PA16, 27 PA17, 28 PA18, 29 PA19, 30 PA20, 31 PA21, 32 PA22, 33 PA23, 34 VDDDBL, 35 GNDDBL, 36 PB08, 37 PB09, 38 PB10, 39 PB11, 40 PB12, 41 PB13, 42 PB14, 43 PB15, 44 PA24, 45 PA25, 46 PA26, 47 PA27, 48 PA28, 49 PA29, 50 PA30, 51 PA31, 52 PB16, 53 PB17, 54 PB18, 55 PB19, 56 VDDPAD, 57 GNDPAD, 58 PB20, 59 PB21, 60 PB22, 61 PB23, 62 PA00, 63 PA01, 64 PA02

## Notices in the file
Copyright (c) 2025 Microchip Technology Inc.
SPDX-License-Identifier: Apache-2.0
Licensed under the Apache License, Version 2.0 (the "License");
you may not use this file except in compliance with the License.
You may obtain a copy of the License at
http://www.apache.org/licenses/LICENSE-2.0
Unless required by applicable law or agreed to in writing, software
distributed under the License is distributed on an "AS IS" BASIS,
WITHOUT WARRANTIES OR CONDITIONS OF ANY KIND, either express or implied.
See the License for the specific language governing permissions and
limitations under the License.
