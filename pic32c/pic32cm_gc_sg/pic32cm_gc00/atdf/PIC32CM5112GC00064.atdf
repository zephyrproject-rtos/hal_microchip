# PIC32CM5112GC00064 device description
Architecture: CORTEX-M23; Family: PIC32CM; Series: PIC32CMGC00
Parameters: NUM_IRQ=141 (Number of interrupt request lines), __BKPT_NUM=4 (Number of breakpoints comparators), __CM23_REV=0x0000 (Cortex-M23 Core Revision), __ETM_PRESENT=0 (No Embedded Trace Macro implemented), __FPU_PRESENT=0 (No FPU), __MPU_NS_REGIONS=8 (Number of Non-Secure Memory Protection Regions), __MPU_PRESENT=1 (MPU implemented), __MPU_REGIONS=8 (same as __MPU_S_REGIONS), __MPU_S_REGIONS=8 (Number of Secure Memory Protection Regions), __MTB_PRESENT=0 (No Macro Trace Buffer implemented), __NVIC_PRIO_BITS=2 (Number of NVIC Priority Bits), __SAUREGION_PRESENT=0 (Number of Security Attribute Unit Regions (No SAU)), __SEC_ENABLED=0 (ARMv8-M security extensions (Trust Zone) enabled), __SYST_NUM=2 (Number of SYSTICK, include secure and non-secure SYSTICK timers), __VTOR_PRESENT=1 (Include Vector Table Offset Register), __Vendor_SysTickConfig=0 (Standard SYSTICK used), __WPT_NUM=2 (Number of watch point comparators), POWER_DOMAIN=PD_CORE, __ARCH_ARM=1, __ARCH_ARM_CORTEX_M=1
Programming and debug interfaces: JTAG, SWD
Registers are 32-bit, read-write, reset 0x0 unless marked. A register's access mark holds for its fields unless they carry their own. Offsets are from the block's base; lines under a group give offsets from that group; [hi:lo] are bit positions; {n}, {i} and the like mark numbered series; 'fields as' and 'values as' point back to an identical list; <NAME> marks a mode.

## Ordering variants
PIC32CM5112GC00064-I/NA: TQFP64, pinout P64, up to 72 MHz, -40 to 85 C, 1.62 to 3.63 V
PIC32CM5112GC00064-V/NA: TQFP64, pinout P64, up to 72 MHz, -40 to 105 C, 1.62 to 3.63 V
PIC32CM5112GC00064-E/NA: TQFP64, pinout P64, up to 72 MHz, -40 to 125 C, 1.62 to 3.63 V
PIC32CM5112GC00064-I/NA: VQFN64, pinout P64_1, up to 72 MHz, -40 to 85 C, 1.62 to 3.63 V
PIC32CM5112GC00064-V/NA: VQFN64, pinout P64_1, up to 72 MHz, -40 to 105 C, 1.62 to 3.63 V
PIC32CM5112GC00064-E/NA: VQFN64, pinout P64_1, up to 72 MHz, -40 to 125 C, 1.62 to 3.63 V

## Memory
base space: start 0 size 0x100000000, little endian
  0x4000000 BROMC_ROM size 0x10000 rom, ro, executable
  0x8000000 FCR_BFM size 0x4000 flash, rw, executable
  0xA000000 FCR_CFM_BOOTCFG1A size 0x1000 flash, rw
  0xA001000 FCR_CFM_USEROTP size 0x1000 user_signatures, rw
  0xA002000 FCR_CFM_BOOTCFG1 size 0x1000 flash, rw
  0xA003000 FCR_CFM_ROMCFG size 0x1000 flash, rw
  0xA004000 FCR_CFM_VSS0 size 0x1000 flash, rw
  0xA005000 FCR_CFM_VSS1 size 0x1000 flash, rw
  0xA006000 FCR_CFM_TEST size 0x1000 flash, rw
  0xA007000 FCR_CFM_CALOTP size 0x1000 other, ro
  0xC000000 FCR_PFM size 0x80000 flash, rw, executable
  0x20000000 MCRAMC_RET size 0x00020000 ram, rw, executable
  0x44000000 APB0_BRIDGE size 0x00034000 io, rw
  0x44800000 APB1_BRIDGE size 0x0003a000 io, rw
  0x45000000 APB2_BRIDGE size 0x00010000 io, rw
  0xe0000000 PPB size 0x00100000 io, rw

## Peripheral instances (address, pins/pin function, parameters)
AC at 0x4482A000
  pins: AIN0 PA07/B; AIN1 PA08/B; AIN2 PB00/B; AIN3 PB03/B; CMP0 PA01/B set 1 or PA13/B set 2; CMP1 PA02/B set 1 or PB07/B set 2
  parameters: ATEST_IMPLEMENTED=1 (Defines if the ATEST register is implemented), ATEST_SIZE=2 (Defines the number of effective bits in ATEST register), DACVALUE_BIT=7 (Defines the number of bits in DACCTRLn.VALUE), IO_INPUTS=4 (Defines the number of AC pair inputs connected to IO pins), PAIRS=1 (Defines the number of AC pairs), NUM_CMP=2 (Number of comparators), LOAD_CALIB=0 (Defines if calibration is required), GCLK_ID=34, BRIDGE_ID=1 (H2PB Bridge ID), PERIPH_ID=21 (H2PB Peripheral ID), INSTANCE_ID=40 (Instance index for AC), MCLK_ID_APB=50 (Index for AC APB clock), PAC_ID=40 (Index for AC registers write protection)
ADC at 0x44818000
  pins: ADC0_AIN0 PA03/B; ADC0_AIN1 PA04/B; ADC0_AIN2 PA05/B; ADC0_AIN3 PA06/B; ADC0_AIN4 PA07/B; ADC0_AIN5 PA08/B; ADC0_AIN6 PA09/B; ADC0_AIN7 PB00/B; ADC0_AIN8 PB03/B; ADC0_AIN9 PB04/B; ADC0_AIN10 PB05/B; ADC0_AIN11 PB06/B; ADC0_ANN0 PA04/B; ADC0_ANN2 PA06/B; ADC0_ANN4 PA08/B; RES_TEST0 PD08/ADC_TEST_PAD; RES_TEST1 PD09/ADC_TEST_PAD; RES_TEST2 PD07/ADC_TEST_PAD; RES_TEST3 PA00/ADC_TEST_PAD; RES_TEST4 PA01/ADC_TEST_PAD; RES_TEST5 PA02/ADC_TEST_PAD; RES_TEST6 PA03/ADC_TEST_PAD; RES_TEST7 PA04/ADC_TEST_PAD; RES_TEST8 PB03/ADC_TEST_PAD; RES_TEST9 PB04/ADC_TEST_PAD; RES_TEST10 PB05/ADC_TEST_PAD; RES_TEST11 PB06/ADC_TEST_PAD; VREFH PA09/VOLT_REF
  parameters: APB_FIFO_DEPTH=16, CHNSAR_NMBR1=16, CHNSAR_NMBR2=0, CHNSAR_NMBR3=0, CHNSAR_NMBR4=0, DCMP_NMBR=1, EARLY_INTR_PRESENT=1, FLTR_NMBR=1, OCP_ADDR_WIDTH=0, OCP_FIFO_DEPTH=0, OCP_PORT_PRESENT=0, SARCORE_NMBR=1, TRGS_NMBR=16, VREF_STARTUP_TIME=50, GCLK_ID=33, DMAC_ID_PFFRDY=37, BRIDGE_ID=1 (H2PB Bridge ID), PERIPH_ID=12 (H2PB Peripheral ID), INSTANCE_ID=39 (Instance index for ADC), MCLK_ID_APB=49 (Index for ADC APB clock), PAC_ID=39 (Index for ADC registers write protection)
AT at 0x4500C000
  parameters: AT_TMPR_OSC_NUM_INV=881 (Number of inverters in tamper oscillator), AT_CTRLAPRIV_IMPLEMENTED=1 (Implement the CTRLA.PRIV bit and privilege access filtering to registers.0 = CTRLA.PRIV not implemented1 = CTRLA.PRIV implemented), AT_WPCTRL_IMPLEMENTED=0 (Implement the WPCTRL register for write protection. 1 = Use WPCTRL register is preset . Used to control write protection enable/disable. 0 = No WPCTRL sfr, only used in legacy device with a PACUse at_wrprot to control write protection enable/disable), AT_WPCTRL_KEY=0x412054 (WPCTRL 24-bit key value. See register description for usage.Set to a unique value for each macro. ASCII of "A T"), BRIDGE_ID=2 (H2PB Bridge ID), PERIPH_ID=6 (H2PB Peripheral ID), INSTANCE_ID=45 (Instance index for AT), MCLK_ID_APB=56 (Index for AT APB clock), PAC_ID=45 (Index for AT registers write protection)
BROMC at 0x44804000
  parameters: BROMC_PADDR_MSB=12, BROMC_PDATA_MSB=31, BROMC_PSTRB_MSB=3, BROMC_PPROT_MSB=5, BROMC_ROM_ADDR_MSB=13, BROMC_ROM_DATA_MSB=31, BROMC_ROM_DATA_SIZE=16384, BROMC_ROM_PRMWS_DEFAULT=0, BROMC_ROM_KEN=0, BROMC_ROM_CRC_EN=1, BROMC_ROM_SPLIT=0x3400 ((8K for PK code) (Note: This parameter may change once boot and PK code sizes are known)), BROMC_BOOTCRC_MODE=2, BROMC_FUSES_DATA_MSB=127 (See Flash Control Chapter for Values), BROMC_FUSES_RDY_MSB=14 (See Flash Control Chapter for Values), BROMC_FUSES_UCFG_ROWID=14 (See Chapter 5 CCFG Fuse map for Values), BROMC_FUSES_UCFG_START=0 (See Chapter 5 CCFG Fuse map for Values), BROMC_CTRLAPRIV_IMPLEMENTED=1, BROMC_WPCTRL_IMPLEMENTED=0, BROMC_WPCTRL_KEY=0x42524F, BROMC_NUM_COOLDN_CYCLES=2, BROMC_NUM_WARMUP_CYCLES=2, BRIDGE_ID=1 (H2PB Bridge ID), PERIPH_ID=2 (H2PB Peripheral ID), INSTANCE_ID=23 (Instance index for BROMC), MCLK_ID_AHB=32 (Index for BROMC AHB clock), MCLK_ID_APB=33 (Index for BROMC APB clock), PAC_ID=23 (Index for BROMC registers write protection)
CAN0 at 0x4402E000 (CAN)
  pins: RX PA10/H set 3 or PC01/H set 1 or PD06/H set 2; TX PA11/H set 3 or PC02/H set 1 or PD08/H set 2
  parameters: ECC_ERR_IMPLEMENTED=0 (ECC error implemented?), INTERNAL_TB_SOF=3 (0: No SOF and no internal Time base, 1: SOF and no internal Time), MSG_RAM_ADDR=0x20 (8-bits MSB), NUMBER_TS=1 (0: 4 Timestamp reg, 1: 8 timestamp reg, 2: 16 timestamp reg), PRIV_IMPLEMENTED=1 (Privilege access is implemented? 0: CTRLA.PRIV bit not implemented, 1: CTRLA.PRIV bit implemented), RXD_SYNC_METHOD=0 (RXD Synchronization Method), SYNT_TIMESTAMP=0x00000 (CAN_SYNT_TIMESTAMP[19:16]: CREL.YEAR reset value (BCD-coded),CAN_SYNT_TIMESTAMP[15:8]: CREL.MON reset value (BCD-coded), CAN_SYNT_TIMESTAMP[7:0]: CREL.DAY reset value (BCD-coded)), WPCTRL_IMPLEMENTED=0 (Write protection control register implemented?), WPCTRL_KEY=0x43414E (Write protection 24 bit key), GCLK_ID=6, BRIDGE_ID=0 (H2PB Bridge ID), PERIPH_ID=23 (H2PB Peripheral ID), INSTANCE_ID=17 (Instance index for CAN0), MCLK_ID_AHB=23 (Index for CAN0 AHB clock), PAC_ID=17 (Index for CAN0 registers write protection)
CAN1 at 0x44030000 (CAN)
  pins: RX PA00/H set 2 or PC05/H set 1 or PD12/H set 3; TX PA01/H set 2 or PC06/H set 1 or PD13/H set 3
  parameters: ECC_ERR_IMPLEMENTED=0 (ECC error implemented?), INTERNAL_TB_SOF=3 (0: No SOF and no internal Time base, 1: SOF and no internal Time), MSG_RAM_ADDR=0x20 (8-bits MSB), NUMBER_TS=1 (0: 4 Timestamp reg, 1: 8 timestamp reg, 2: 16 timestamp reg), PRIV_IMPLEMENTED=1 (Privilege access is implemented? 0: CTRLA.PRIV bit not implemented, 1: CTRLA.PRIV bit implemented), RXD_SYNC_METHOD=0 (RXD Synchronization Method), SYNT_TIMESTAMP=0x00000 (CAN_SYNT_TIMESTAMP[19:16]: CREL.YEAR reset value (BCD-coded),CAN_SYNT_TIMESTAMP[15:8]: CREL.MON reset value (BCD-coded), CAN_SYNT_TIMESTAMP[7:0]: CREL.DAY reset value (BCD-coded)), WPCTRL_IMPLEMENTED=0 (Write protection control register implemented?), WPCTRL_KEY=0x43414E (Write protection 24 bit key), GCLK_ID=7, BRIDGE_ID=0 (H2PB Bridge ID), PERIPH_ID=24 (H2PB Peripheral ID), INSTANCE_ID=18 (Instance index for CAN1), MCLK_ID_AHB=24 (Index for CAN1 AHB clock), PAC_ID=18 (Index for CAN1 registers write protection)
CCL0 at 0x4482E000 (CCL)
  pins: IN0 PC01/I set 1; IN1 PC02/I set 1; IN2 PC09/I set 1; IN3 PD00/I set 1; IN4 PD01/I set 1; IN5 PD10/I set 1; IN6 PA00/I set 1; IN7 PA01/I set 1; IN8 PA10/I set 1; IN9 PB05/I set 1; IN10 PB06/I set 1; IN11 PB10/I set 1; OUT0 PC03/I set 1; OUT1 PD08/I set 1; OUT2 PA02/I set 1; OUT3 PC00/I set 1
  parameters: LUT_NUM=4 (Number of LUT in a CCL), GCLK_ID=36, BRIDGE_ID=1 (H2PB Bridge ID), PERIPH_ID=23 (H2PB Peripheral ID), INSTANCE_ID=42 (Instance index for CCL0), MCLK_ID_APB=52 (Index for CCL0 APB clock), PAC_ID=42 (Index for CCL0 registers write protection)
CCL1 at 0x44830000 (CCL)
  pins: IN0 PC04/I set 1; IN1 PC05/I set 1; IN2 PC10/I set 1; IN3 PD06/I set 1; IN4 PD07/I set 1; IN5 PD11/I set 1 or PD12/I set 2; IN6 PA09/I set 1; IN7 PA06/I set 1; IN8 PA11/I set 1 or PA12/I set 2; IN9 PB04/I set 1; IN10 PB03/I set 1; IN11 PB07/I set 2 or PB08/I set 1; OUT0 PC06/I set 1; OUT1 PD09/I set 1; OUT2 PA05/I set 1; OUT3 PB00/I set 1
  parameters: LUT_NUM=4 (Number of LUT in a CCL), GCLK_ID=37, BRIDGE_ID=1 (H2PB Bridge ID), PERIPH_ID=24 (H2PB Peripheral ID), INSTANCE_ID=43 (Instance index for CCL1), MCLK_ID_APB=53 (Index for CCL1 APB clock), PAC_ID=43 (Index for CCL1 registers write protection)
CoreDebug at 0xE000EDF0
DIB at 0xE000EFB0
DMAC at 0x44802000
  parameters: CH_NUM=8, EVIN_NUM=4, EVOUT_NUM=4, LVL_NUM=4, QOSCTRL_D_RESETVALUE=2, QOSCTRL_F_RESETVALUE=2, QOSCTRL_WRB_RESETVALUE=2, SPLIT_IRQ_NUM=4, TRIG_NUM=43, BRIDGE_ID=1 (H2PB Bridge ID), PERIPH_ID=1 (H2PB Peripheral ID), INSTANCE_ID=21 (Instance index for DMAC), MCLK_ID_AHB=28 (Index for DMAC AHB clock), MCLK_ID_APB=29 (Index for DMAC APB clock), PAC_ID=21 (Index for DMAC registers write protection)
DSU at 0x44000000
  pins: MSA PC05/DSU_MSA; SWCCSTAT PC06/DSU_SWCCSTAT
  parameters: DSU_BASE_ADDR_INTERNAL=0x44000000, DSU_CPU_NUM=0, DSU_TZ_IMPLEMENTED=1, DSU_CORESIGHT_REVISION=0x0, DSU_CORESIGHT_ENTRY=0xE00FF001 0x0 0x0 0x0, DSU_ID_MASKID=0x00 (Microchip Device Mask ID which provides the value for bits [15:8] of the ID - Part Number.), DSU_ID_VER=0x0 (ID Version Code provides the Mask Revision value for the device. Use metal changeable cells to configure this value.), DSU_SD_KEY=0xFFABAFD0, DSU_DCFG_MASK=0xFF0FFF0F 0x10FC7F80 0xC0800203 0x0 0x0 0x0 0x0 0x0, DSU_DAL1_VAL=0x55, DSU_DAL2_VAL=0xAA, DSU_CTRLAPRIV_IMPLEMENTED=1, DSU_CTRLB_IMPLEMENTED_MASK=0x00000000, DSU_WPCTRL_IMPLEMENTED=0, DSU_WPCTRL_KEY=0x445355, DSU_PRVKEY_IMPLEMENTED=0 (key sourced by PUF, not DSU), DSU_BRCTRL_KEY=0x445355, DSU_TDID_DIE=0x00, DSU_TDID_MASK=0x00, DSU_SWCCS_IMPLEMENTED=1, DSU_TESTMODE_IMPLEMENTED_MASK=0x000007FF 0x00000000 0x00000000 0x00000000, DSU_FUSES_DATA_MSB=127 (128-bit bus), DSU_FUSES_RDY_MSB=14 (15 bit fuse ready bus), DSU_FUSES_ID_DEVID_START=24 (DEVID field is DSUCFG0[31:24]), DSU_FUSES_ID_DEVID_SIZE=8, DSU_FUSES_ID_DEVID_ROWID=8 (DEVID on RowID Index = 8), DSU_FUSES_DCFG_START=0 32 64 96 0 32 64 96, DSU_FUSES_DCFG_SIZE=32 32 32 32 32 32 32 32, DSU_FUSES_DCFG_ROWID=8 8 8 8 9 9 9 9 (DSUCFG7-0 = FCCFG39-32), DMAC_ID_DCC0=1, DMAC_ID_DCC1=2, BRIDGE_ID=0 (H2PB Bridge ID), PERIPH_ID=0 (H2PB Peripheral ID), INSTANCE_ID=0 (Instance index for DSU), MCLK_ID_AHB=0 (Index for DSU AHB clock), PAC_ID=0 (Index for DSU registers write protection)
DWT at 0xE0001000
  parameters: __WPT_NUM=2 (Number of DWT watchpoint comparators)
EIC at 0x44020000
  pins: EXTINT0 PA00/A or PB00/A or PC00/A; EXTINT1 PA01/A or PB01/A or PC01/A or PD01/A; EXTINT2 PA02/A or PB02/A or PC02/A or PD04/A; EXTINT3 PA03/A or PB03/A or PC03/A or PD05/A; EXTINT4 PA04/A or PB04/A or PC04/A or PD07/A; EXTINT5 PA05/A or PB05/A or PC05/A or PD08/A; EXTINT6 PA06/A or PB06/A or PC06/A or PD09/A; EXTINT7 PA07/A; EXTINT8 PA08/A or PB07/A or PD10/A; EXTINT9 PA09/A or PB08/A or PC09/A or PD11/A; EXTINT10 PA10/A or PB09/A or PC10/A or PD12/A; EXTINT11 PA11/A or PB10/A or PD13/A; EXTINT12 PA12/A; EXTINT13 PA13/A; NMI PD00/A
  parameters: EXTINT_NUM=16, NUMBER_OF_CONFIG_REGS=2 (=(EIC_EXTINT_NUM +7) / 8), NUMBER_OF_INTERRUPTS=16 (=(EIC_EXTINT_NUM)), SECURE_IMPLEMENTED=1, GCLK_ID=5, BRIDGE_ID=0 (H2PB Bridge ID), PERIPH_ID=16 (H2PB Peripheral ID), INSTANCE_ID=13 (Instance index for EIC), MCLK_ID_APB=13 (Index for EIC APB clock), PAC_ID=13 (Index for EIC registers write protection)
EVSYS at 0x44806000
  parameters: ASYNCHRONOUS_CHANNELS=0xFFFFF000, CHANNELS=12, CHANNELS_BITS=4 (=LEN( BIN(EVSYS_CHANNELS-1)) - 2)derived parameter), GENERATORS=90 (Should be 90), GENERATORS_BITS=7 (=LEN( BIN(EVSYS_GENERATORS-1)) - 2)derived parameter), SECURE_IMPLEMENTED=0, SPLIT_IRQ_NUM=12, SYNCH_NUM=12, SYNCH_NUM_BITS=4 (=LEN( BIN(EVSYS_SYNCH_NUM-1)) - 2)derived parameter), USERS=62 (Should be 62), USERS_BITS=6 (=LEN( BIN(EVSYS_USERS-1)) - 2)derived parameter), USERS_GROUPS=2 (=(EVSYS_USERS+31) / 32derived parameter), GCLK_ID_CH{n}={n+8} (n=0..11), BRIDGE_ID=1 (H2PB Bridge ID), PERIPH_ID=3 (H2PB Peripheral ID), INSTANCE_ID=25 (Instance index for EVSYS), MCLK_ID_APB=35 (Index for EVSYS APB clock), PAC_ID=25 (Index for EVSYS registers write protection)
FCR at 0x44002000
  parameters: FCR_AHB_PORTS_NB=1, FCR_CTRLAPRIV_IMPLEMENTED=1, FCR_INTFLAGSET_IMPLEMENTED=1, FCR_WPCTRL_IMPLEMENTED=0, FCR_WPCTRL_KEY=0x464352, FCR_PDMO_MSB=7, FCR_PFM_ADDR_BASE=0x0C000000, FCR_BFM_ADDR_BASE=0x08000000, FCR_CFM_ADDR_BASE=0x0A000000, FCR_FCD_ADDR_BASE=0x0B000000, FCR_VSS_CFG0_BASE=0x0A004000, FCR_VSS_CFG1_BASE=0x0A005000, FCR_VSS_CFG2_BASE=0, FCR_VSS_CFG3_BASE=0, FCR_VSS_CFG4_BASE=0, FCR_VSS_CFG5_BASE=0, FCR_CRC_PRESENT=1, FCR_FLT_PRESENT=1, FCR_ECC_PRESENT=1, FCR_PCHE_PRESENT=1, FCR_PCHE_AHB_NUM=0, FCR_PCHE_NUM_LINES=4, FCR_PCHE_TAG_MASK=0xF9F8000F, FCR_FUSES_READY_CYCLES=2, FCR_FUSES_DATA_CYCLES=4, FUSES_RDY_MSB=14, FUSES_DATA_MSB=127, FCR_HDATA_SIZE=32, FCR_F1RR_ADDR=0x0A007000, FCR_F2RR_ADDR=0 (Not applicable for QSilver), FCR_RR_NUM_READS=1, FCR_NUM_RR_SFR=1, FCR_FFF_ADDR=0x0A007040, FCR_NOT_FFF_VALUE=0xA5A5A5A5, FCR_OTPLOCK_ADDR=0x0A007060, FCR_CAL_ADDR=0x0A007080, FCR_CAL_NUM_READS=14, FCR_PBUCFG_ADDR=0x0A003400, FCR_PERIOD_MIN=75, FCR_PERIOD_NOM=116, FCR_TCALH_NS=10000, PFM_NUM_PANELS=1, PFM_PNL_ADDR_MSB=18, PFM_SYS_ADDR_MSB=18, PFM_ROW_ADDR_MSB=9, PFM_PAGE_ADDR_MSB=11, PFM_PNL_DATA_MSB=139, PFM_DATA_MSB=127, PFM_PNL_WDATA_MSB=34 (Parameter only in DOS Rev C, not in RTL), PFM_NUM_RR=2, PFM_SRHT_PRESENT=0, BFM_PNL_ADDR_MSB=13, BFM_SYS_ADDR_MSB=13, CFM_PNL_ADDR_MSB=14, CFM_SYS_ADDR_MSB=14, NVR_NUM_PAGES=12, PFM_TDPDH_NS=5000, PFM_TDPDS_NS=100, PFM_TMS_NS=5000 (See Note 2), PFM_TMH_NS=100 (See Note 2), PFM_TRT_NS=500, PFM_TRHR_NS=1000, PFM_TONWAIT_NS=6000, PFM_TLKCFG_NS=1000, PFM_ACC_NS=25, PFM_ACC_HT_NS=30, PFM_ACC_RECALL_NS=70, BRIDGE_ID=0 (H2PB Bridge ID), PERIPH_ID=1 (H2PB Peripheral ID), INSTANCE_ID=1 (Instance index for FCR), MCLK_ID_AHB=1 (Index for FCR AHB clock), PAC_ID=1 (Index for FCR registers write protection)
FCW at 0x44004000
  parameters: FCW_CTRLAPRIV_IMPLEMENTED=1, FCW_INTFLAGSET_IMPLEMENTED=1, FCW_WPCTRL_IMPLEMENTED=0, FCW_WPCTRL_KEY=0x464357, FCW_PFM_ADDR_BASE=0x0C000000, FCW_BFM_ADDR_BASE=0x08000000, FCW_CFM_ADDR_BASE=0x0A000000, FCW_VSS_CFG0_BASE=0x0A004000, FCW_VSS_CFG1_BASE=0x0A005000, FCW_VSS_CFG2_BASE=0 (Not applicable for QS), FCW_VSS_CFG3_BASE=0 (Not applicable for QS), FCW_VSS_CFG4_BASE=0 (Not applicable for QS), FCW_VSS_CFG5_BASE=0 (Not applicable for QS), FCW_PWP_REGIONS=4, FCW_PWP_MSB=6, FCW_TAMPER_PRESENT=1, FCW_TAMPER_ADDR=0x0A003200, FCW_TAMPER_DATA=0x00000000, FCW_SD_USE_CPCNT=1, FCW_NUM_DATA_SFR=4 ((PFM_DATA_MSB+1)/32), FCW_TPAR_MSB=3 ((PFM_PNL_DATA_MSB - PFM_DATA_MSB)/4), FCW_PERIOD_MIN=75, FCW_PERIOD_NOM=116, PFM_SIZE=6, PFM_NUM_PANELS=1, PFM_PNL_ADDR_MSB=18, PFM_SYS_ADDR_MSB=18, PFM_ROW_ADDR_MSB=9, PFM_PAGE_ADDR_MSB=11, PFM_PNL_DATA_MSB=139, PFM_DATA_MSB=127, PFM_NUM_RR=2, BFM_PNL_ADDR_MSB=13, BFM_SYS_ADDR_MSB=13, CFM_PNL_ADDR_MSB=14, CFM_SYS_ADDR_MSB=14, NVR_NUM_PAGES=12, PFM_TWS_NS=5 (value irrelevant, must be >0), PFM_TWH_NS=5 (value irrelevant, must be >0), PFM_TNVS_NS=4000 (See Note 2), PFM_TPROG_NS=18000 (See Note 3), PFM_TPREPROG_NS=3000 (See Note 3), PFM_TADS_NS=15 (See Note 2), PFM_TADH_NS=15 (See Note 2), PFM_TPGS_NS=8000 (See Note 2), PFM_TPREPGH_NS=15 (See Note 2), PFM_TPREPGS_NS=1000 (See Note 2), PFM_TPGH_NS=15 (See Note 2), PFM_TRCV_PROG_NS=5000 (See Note 2), PFM_TRCV_ERASE_NS=50000 (See Note 2), PFM_TERASE_NS=18000000 (See Note 3), PFM_TERASE_RETRY_NS=4500000 (See Note 3), PFM_TSCE_NS=18000000 (See Note 3), PFM_TRW_NS=100 (See Note 2), PFM_TPUMPENS=1000 (See Note 2), PFM_TPUMPENH=100 (See Note 2), PFM_TPUMP_CYCLES=1029 (See Note 2), BRIDGE_ID=0 (H2PB Bridge ID), PERIPH_ID=2 (H2PB Peripheral ID), FLASH_SIZE=524288, INSTANCE_ID=2 (Instance index for FCW), MCLK_ID_AHB=2 (Index for FCW AHB clock), PAC_ID=2 (Index for FCW registers write protection)
FPB at 0xE0002000
  parameters: __BKPT_NUM=4 (Number of FPB breakpoint comparators)
FREQM at 0x4400C000
  parameters: MSRCLK_NB=2 (Number of measured clock sources), GCLK_ID_MSR0=2, GCLK_ID_MSR1=3, GCLK_ID_REF=4, BRIDGE_ID=0 (H2PB Bridge ID), PERIPH_ID=6 (H2PB Peripheral ID), INSTANCE_ID=10 (Instance index for FREQM), MCLK_ID_APB=10 (Index for FREQM APB clock), PAC_ID=10 (Index for FREQM registers write protection)
FUSES at FUSES_ROMCFG 0x0A003000, FUSES_BOOTCFG1 0x0A002000, FUSES_BOOTCFG1A 0x0A000000 (FUSES_BOOTCFG1), FUSES_CALOTP 0x0A007000
GCLK at 0x44008000
  pins: IO0 PB06/K or PC09/K or PD05/K; IO1 PC00/K or PC10/K or PC05/K or PD04/K; IO2 PC01/K; IO3 PC02/K; IO4 PC03/K; IO5 PC04/K; IO6 PB10/K; IO7 PB09/K; TST_GCLK PC08/DSU_TEST_GCLK
  parameters: GEN_NUM=12, IO_NUM=8 (derived, # of "1" in GCLK_GEN_IO_EXIST), MUXED_NUM=39 (Number of GCLK channels), SOURCE_NUM=11, BRIDGE_ID=0 (H2PB Bridge ID), PERIPH_ID=4 (H2PB Peripheral ID), INSTANCE_ID=8 (Instance index for GCLK), MCLK_ID_APB=8 (Index for GCLK APB clock), PAC_ID=8 (Index for GCLK registers write protection)
H2PB0 at 0x44032000 (H2PB)
  parameters: H2PB_MST_N=2, H2PB_MST_MAX=1 (derived parameter), H2PB_SLV_N=32, H2PB_SLV_MAX=31 (derived parameter), H2PB_PADDR_IDXB=5 (derived parameter), H2PB_PADDR_LSB=13, H2PB_WPCTRL_IMPLEMENTED=0, H2PB_PAGE_SIZE=8192 (derived parameter), H2PB_OWN_SFR_SLOT=25, H2PB_PADDR_SIZE=18 (local parameter), H2PB_PADDR_MSB=17 (derived local parameter), H2PB_BASE_MSB=13 (derived parameter), H2PB_USE_HSEL=1, H2PB_USE_DPATH_PIPER=0 (1="all pipelined"0="address pipelined"), H2PB_USE_EARLY_PREAD=0, H2PB_CLK_DIV_EN=0 (1="n:1 clock"0="1:1 clock"), H2PB_USE_PSTRB_FOR_READS=1, H2PB_WPCTRL_KEY=0x504230, H2PB_NONSEC_INIT_VAL=0x00000001, BRIDGE_ID=0 (H2PB Bridge ID), PERIPH_ID=25 (H2PB Peripheral ID), INSTANCE_ID=19 (Instance index for H2PB0), MCLK_ID_AHB=25 (Index for H2PB0 AHB clock), MCLK_ID_APB=26 (Index for H2PB0 APB clock), PAC_ID=19 (Index for H2PB0 registers write protection)
H2PB1 at 0x44838000 (H2PB)
  parameters: H2PB_MST_N=2, H2PB_MST_MAX=1 (derived parameter), H2PB_SLV_N=32, H2PB_SLV_MAX=31 (derived parameter), H2PB_PADDR_IDXB=5 (derived parameter), H2PB_PADDR_LSB=13, H2PB_WPCTRL_IMPLEMENTED=0, H2PB_PAGE_SIZE=8192 (derived parameter), H2PB_OWN_SFR_SLOT=28, H2PB_PADDR_SIZE=18 (local parameter), H2PB_PADDR_MSB=17 (derived local parameter), H2PB_BASE_MSB=13 (derived parameter), H2PB_USE_HSEL=1, H2PB_USE_DPATH_PIPER=0 (1="all pipelined"0="address pipelined"), H2PB_USE_EARLY_PREAD=0, H2PB_CLK_DIV_EN=0 (1="n:1 clock"0="1:1 clock"), H2PB_USE_PSTRB_FOR_READS=1, H2PB_WPCTRL_KEY=0x504231, H2PB_NONSEC_INIT_VAL=0x00000000, BRIDGE_ID=1 (H2PB Bridge ID), PERIPH_ID=28 (H2PB Peripheral ID), INSTANCE_ID=46 (Instance index for H2PB1), MCLK_ID_AHB=57 (Index for H2PB1 AHB clock), MCLK_ID_APB=58 (Index for H2PB1 APB clock), PAC_ID=46 (Index for H2PB1 registers write protection)
H2PB2 at 0x4500E000 (H2PB)
  parameters: H2PB_MST_N=1, H2PB_MST_MAX=0 (derived parameter), H2PB_SLV_N=8, H2PB_SLV_MAX=7 (derived parameter), H2PB_PADDR_IDXB=3 (derived parameter), H2PB_PADDR_LSB=13, H2PB_WPCTRL_IMPLEMENTED=0, H2PB_PAGE_SIZE=8192 (derived parameter), H2PB_OWN_SFR_SLOT=7, H2PB_PADDR_SIZE=16 (local parameter), H2PB_PADDR_MSB=15 (derived local parameter), H2PB_BASE_MSB=15 (derived parameter), H2PB_USE_HSEL=1, H2PB_USE_DPATH_PIPER=1 (1="all pipelined"0="address pipelined"), H2PB_USE_EARLY_PREAD=0, H2PB_CLK_DIV_EN=1 (1="n:1 clock"0="1:1 clock"), H2PB_USE_PSTRB_FOR_READS=1, H2PB_WPCTRL_KEY=0x504232, H2PB_NONSEC_INIT_VAL=0x00, BRIDGE_ID=2 (H2PB Bridge ID), PERIPH_ID=7 (H2PB Peripheral ID), INSTANCE_ID=47 (Instance index for H2PB2), MCLK_ID_AHB=59 (Index for H2PB2 AHB clock), MCLK_ID_APB=60 (Index for H2PB2 APB clock), PAC_ID=47 (Index for H2PB2 registers write protection)
HMATRIX2 at 0x44010000
  parameters: BRIDGE_ID=0 (H2PB Bridge ID), PERIPH_ID=8 (H2PB Peripheral ID), INSTANCE_ID=22 (Instance index for HMATRIX2), MCLK_ID_AHB=30 (Index for HMATRIX2 AHB clock), MCLK_ID_APB=31 (Index for HMATRIX2 APB clock), PAC_ID=22 (Index for HMATRIX2 registers write protection)
ICB at 0xE000E000
MCLK at 0x4400A000
  parameters: MCLK_SYNC_EDGES=1, MCLK_DIV_CLK_NUM=3 (one for all other, one for H2PB2 domain, one for MBISTINTF), MCLK_CKDIV_REGS_BITS=8, MCLK_CKDIV_RESET_VALUE=0x1 0x2 0x4 0x1 0x1 0x1 0x1 0x1 0x1 0x1 0x1 0x1 (values must be binary divisor numberunused divisors must be 8'h1), MCLK_CKDIV_WRLOCK=0x00000000, MCLK_CPU_CLK_DIVIDER=0, MCLK_CPU_CLK_IDLE=0, MCLK_CPU_CLK_OFFDLY=2, MCLK_CPU_CLK_ONDLY=0, MCLK_SYS_CLK_DIVIDER=0, MCLK_SYS_CLK_OFFDLY=2, MCLK_CLKMSK_NUM=65, MCLK_CKPER_IMPLEMENTED=0xFFFFFFFF 0xFFFFFFFF 0x00000001 0x00000000 0x00000000 0x00000000 0x00000000 0x00000000 0x00000000, MCLK_CKPER_RSTVAL=0xFFEEFFFF 0xFFFFFFFF 0x00000001 0x00000000 0x00000000 0x00000000 0x00000000 0x00000000 0x00000000, MCLK_CKPER_DIVIDER=0 0 0 1 1 1 0 1 0 0 0 0 1 0 0 1 0 0 0 2 0 0 0 0 0 0 0 0 0 0 0 0 0 0 0 0 0 0 0 0 0 0 0 0 0 0 0 0 0 0 0 0 0 0 0 0 1 0 0 0 1 0 0 0 0 0 0 0 0 0 0 0 0 0 0 0 0 0 0 0 0 0 0 0 0 0 0 0 0 0 0 0 0 0 0 0 0 0 0 0 0 0 0 0 0 0 0 0 0 0 0 0 0 0 0 0 0 0 0 0 0 0 0 0 0 0 0 0 0 0 0 0 0 0 0 0 0 0 0 0 0 0 0 0 0 0 0 0 0 0 0 0 0 0 0 0 0 0 0 0 0 0 0 0 0 0 0 0 0 0 0 0 0 0 0 0 0 0 0 0 0 0 0 0 0 0 0 0 0 0 0 0 0 0 0 0 0 0 0 0 0 0 0 0 0 0 0 0 0 0 0 0 0 0 0 0 0 0 0 0 0 0 0 0 0 0 0 0 0 0 0 0 0 0 0 0 0 0 0 0 0 0 0 0 0 0 0 0 0 0 0 0 0 0 0 0 0 0 0 0 0 0 0 0 0 0 0 0 0 0 0 0 0 0 0 0 0 0 0 0 0 0 0 0 0 0 0 0, MCLK_CKPER_REQEXISTS=0xD9FFFFFF 0xE1FFFFFF 0x00000001 0x00000000 0x00000000 0x00000000 0x00000000 0x00000000 0x00000000, MCLK_CKPER_MASTER=0x11800004 0x40400000 0x00000000 0x00000000 0x00000000 0x00000000 0x00000000 0x00000000 0x00000000, MCLK_CKPER_WILLRISE=0x00080000 0x10000000 0x00000000 0x00000000 0x00000000 0x00000000 0x00000000 0x00000000 0x00000000, JTAG_IMPLEMENTED=1, BRIDGE_ID=0 (H2PB Bridge ID), PERIPH_ID=5 (H2PB Peripheral ID), INSTANCE_ID=9 (Instance index for MCLK), MCLK_ID_APB=9 (Index for MCLK APB clock), PAC_ID=9 (Index for MCLK registers write protection)
MCRAMC at 0x4402C000
  parameters: AHB_CLOCK_ENABLE=0, AHB_ECC=1, AHB_PORTS_NB=8, AHB_READ_PREBUFFERING=0, AHB_REQUEST_ISOLATION_REGISTER=0, ARBITRATION_TYPE=2 (Parameter should be "ENUM_HOPSCOTCH"Fix for text parameter in ConstellationCONST_DEV-1173), BIT_STROBE_RAM=0 (parameter n/a if STORE_BYTE_STROBE=0), CHANNELS_NB=2, ECC_SYNDROM_REGISTER=0, HADDR_READ_ISOLATION_REGISTER=0, HRDATA_ISOLATION_CONFIGURABLE=1, HRDATA_ISOLATION_DEFAULT=0 (default to 0 wait states), MCRAMC_CLK_GATER=0, MCRAMC_PADDR_SIZE=13, MEMORY_AUTO_CORRECTION=1, MEMORY_ENABLE_POLARITY=0, MW_CLOCK_ENABLE=0, MW_DATA_SIZE=32, MW_PORT_SLICES_NB=0, M0_CLOCK_ENABLE=0, M0_DATA_SIZE=32, M0_HYBRID_READ_WRITE_ACCESS=0, M0_PORT_SLICES_NB=0, PRIVILEGED_BIT_CHECK=1, RAM_ADD_SIZE=14, RAM_AHB_ADDRESS_OFFSET=0, RAM_ERASE=0, STORE_BYTE_STROBE=0, ULTRA=1, WP_KEY=0x465852 ("FXR"), WRITE_ENABLE_POLARITY=0, WRITE_ENABLE_USED=1, WRITE_MASK_POLARITY=0, WRITE_PROTECT_REGISTER=0, BRIDGE_ID=0 (H2PB Bridge ID), PERIPH_ID=22 (H2PB Peripheral ID), INSTANCE_ID=16 (Instance index for MCRAMC), MCLK_ID_APB=21 (Index for MCRAMC APB clock), MCLK_ID_AHB=22 (Index for MCRAMC AHB clock), PAC_ID=16 (Index for MCRAMC registers write protection)
MPU at 0xE000ED90
  parameters: __MPU_REGIONS=8 (Number of MPU regions)
NVIC at 0xE000E100
  parameters: NUM_IRQ=141 (Number of interrupt request lines)
OSC32KCTRL at 0x45008000
  pins: CLKIN3232 PB01/XOSC32K_XIN32_AMODE; XIN3232 PB01/XOSC32K_XIN32; XOUT3232 PB02/XOSC32K_XOUT32
  parameters: BRIDGE_ID=2 (H2PB Bridge ID), PERIPH_ID=4 (H2PB Peripheral ID), INSTANCE_ID=7 (Instance index for OSC32KCTRL), MCLK_ID_APB=7 (Index for OSC32KCTRL APB clock), PAC_ID=7 (Index for OSC32KCTRL registers write protection)
OSCCTRL at 0x44006000
  pins: CLKIN PD05/XOSC_XIN_AMODE; XIN PD05/XOSC_XIN; XOUT PD04/XOSC_XOUT
  parameters: DFLL48M_ATEST_IMPLEMENTED=1, DFLL48M_ATEST_SIZE=8, DFLL48M_IS_STARTUP_OSCILLATOR=1, DFLL48M_RC48MCAL0_PORVAL=0x00000000, DIV_8MHZ_NUM=2, FRACDIVS_NUM=0, FRACDIV_DIVIDER_RESET_VAL=0, FRACDIV_PLLSRC=0, PLLS_NUM=1, PLL0_OUTPUTS_NUM=5, PLL1_OUTPUTS_NUM=0, USBHS_NUM=1 (should be 0, but IP has bug), XOSC_ATEST_IMPLEMENTED=1, XOSC_ATEST_SIZE=4, XOSC_CFD_CLK_SELECT_SIZE=4, XOSC_CFD_HAS_RETENTION=0, GCLK_ID_DFLL48M=0, GCLK_ID_PLL=1, BRIDGE_ID=0 (H2PB Bridge ID), PERIPH_ID=3 (H2PB Peripheral ID), INSTANCE_ID=6 (Instance index for OSCCTRL), MCLK_ID_APB=6 (Index for OSCCTRL APB clock), PAC_ID=6 (Index for OSCCTRL registers write protection)
PAC at 0x44022000
  parameters: PAC_PER_WRPROT_MASK=0xFFFFFFFF 0x0003FFFF 0x00000000 0x00000000 (Peripheral implemented mask. If PAC_PER_WRPROT_MASK[x]=1 then the PAC implements an SFR bit in INTFLAG, STATUS, and LOCK with the location of <REG>(x/32)[x mod 32]), PAC_STATUS_RESET_VALUE=0x00000000 0x00000000 0x00000000 0x00000000 (WRP STATUS Reset Value for Peripherals. On reset STATUS(x/32)[x mod 32]=PAC_STATUS_RESET_VALUE[x]The reset value for each peripheral should always be 0. The parameter exists if there is an unforeseen circumstance requiring it to be 1. Test blocks are not one of them as they are protected by dsu_test_mode.), PAC_LOCK_RESET_VALUE=0x00000000 0x00000000 0x00000000 0x00000000, PAC_ERRORS_INBAND=1, PAC_CTRLAPRIV_IMPLEMENTED=1, PAC_INTFLAGSET_IMPLEMENTED=0, BRIDGE_ID=0 (H2PB Bridge ID), PERIPH_ID=17 (H2PB Peripheral ID), INSTANCE_ID=14 (Instance index for PAC), MCLK_ID_APB=14 (Index for PAC APB clock), PAC_ID=14 (Index for PAC registers write protection)
PDM
  pins: PDMDIS PDMDIS/TST_DIG; PDMI0 PD07/PDMI_TEST; PDMI1 PD08/PDMI_TEST; PDMI2 PD09/PDMI_TEST; PDMI3 PA00/PDMI_TEST; PDMO0 PB03/PDMO_LV_TEST; PDMO1 PB04/PDMO_LV_TEST; PDMO2 PB05/PDMO_LV_TEST; PDMO3 PB06/PDMO_LV_TEST; PDMO4 PC00/PDMO_LV_TEST; PDMO5 PC01/PDMO_LV_TEST; PDMO6 PC02/PDMO_LV_TEST; PDMO7 PC03/PDMO_LV_TEST; PDMO0_MV PB03/PDMO_MV_TEST; PDMO1_MV PB04/PDMO_MV_TEST; PDMO2_MV PB05/PDMO_MV_TEST; PDMO3_MV PB06/PDMO_MV_TEST; PDMO4_MV PC00/PDMO_MV_TEST; PDMO5_MV PC01/PDMO_MV_TEST; PDMO6_MV PC02/PDMO_MV_TEST; PDMO7_MV PC03/PDMO_MV_TEST
PM at 0x45000000
  parameters: BACKUP_IMPLEMENTED=1, PD_NUM=1 (Number of Switchable Power Domains2 total domains (PD_CORE_SW and PD_CORE_BU)), BRIDGE_ID=2 (H2PB Bridge ID), PERIPH_ID=0 (H2PB Peripheral ID), INSTANCE_ID=3 (Instance index for PM), MCLK_ID_APB=3 (Index for PM APB clock), PAC_ID=3 (Index for PM registers write protection)
PORT at 0x44800000
  pins: P{n} PA{n:02} (n=0..13); P{n} PB{n-32:02} (n=32..42); P{n} PC{n-64:02} (n=64..74); P{n} PD{n-96:02} (n=96..109)
  parameters: AHB_IMPLEMENTED=0 (No AHB bus), BITS=117, DIR_DEFAULT_VAL=0x00000000 0x00000000 0x00000000 0x00000000, DIR_IMPLEMENTED=0x001FFFFF 0x0003FFFF 0x000FFFFF 0x001FFFFF (DIR RegistersImplemented), DRVSTR=0 (No DRVSTR bits), DRVSTR_DEFAULT_VAL=0x00000000 0x00000000 0x00000000 0x00000000, DRVSTR_IMPLEMENTED=0x00000000 0x00000000 0x00000000 0x00000000 (PINCFG.DRVSTR0RegistersImplemented), DRVSTR1_DEFAULT_VAL=0x00000000 0x00000000 0x00000000 0x00000000, DRVSTR1_IMPLEMENTED=0x00000000 0x00000000 0x00000000 0x00000000 (PINCFG.DRVSTR1RegistersImplemented), EVENT_IMPLEMENTED=0x001FFFFF 0x0003FFFF 0x000FFFFF 0x001FFFFF (Event RegistersImplemented), EV_NUM=4, GROUPS=4, HADDR_MSB=31, INEN_DEFAULT_VAL=0x00000000 0x00000000 0x00000000 0x00000000, INEN_IMPLEMENTED=0x001FFFFF 0x0003FFFF 0x000FFFFF 0x001FFFFF (PINCFG.INENRegistersImplemented), IOBUS_IMPLEMENTED=0 (No IOBUS), MSB=116 (PORT_BITS-1), NONSEC_DEFAULT_VAL=0x00000000 0x00000000 0x00000000 0x00000000, NONSEC_IMPLEMENTED=0x001FFFFF 0x0003FFFF 0x000FFFFF 0x001FFFFF (NONSECRegistersImplemented), ODRAIN=1, ODRAIN_DEFAULT_VAL=0x00000000 0x00000000 0x00000000 0x00000000, ODRAIN_IMPLEMENTED=0x001FFFFF 0x0003FFFF 0x000FFFFF 0x001FFFFF (PINCFG.ODRAINRegistersImplemented), OUT_DEFAULT_VAL=0x00000000 0x00000000 0x00000000 0x00000000, OUT_IMPLEMENTED=0x001FFFFF 0x0003FFFF 0x000FFFFF 0x001FFFFF (OUT RegistersImplemented), PIN_IMPLEMENTED=0x001FFFFF 0x0003FFFF 0x000FFFFF 0x001FFFFF (Port PinsImplemented), PMUXBIT0_DEFAULT_VAL=0x00000000 0x00000000 0x00000000 0x0000000C, PMUXBIT0_IMPLEMENTED=0x001FFFFF 0x0003FFF9 0x000FFE7F 0x001FFFC3 (Bit 0 of PMUX field), PMUXBIT1_DEFAULT_VAL=0x00000000 0x00000000 0x000001E0 0x0000000C, PMUXBIT1_IMPLEMENTED=0x0007FFFF 0x000387F9 0x000FFE7F 0x001FFFF3 (Bit 1 of PMUX field), PMUXBIT2_DEFAULT_VAL=0x00000000 0x00000000 0x000001E0 0x0000000C, PMUXBIT2_IMPLEMENTED=0x001BFFFF 0x00007FF9 0x0000067F 0x00003FC3 (Bit 2 of PMUX field), PMUXBIT3_DEFAULT_VAL=0x00000000 0x00000000 0x00000000 0x00000000, PMUXBIT3_IMPLEMENTED=0x001FFFFF 0x0003FFF9 0x000BFE7F 0x001FDFF3 (Bit 3 of PMUX field), PMUXEN_DEFAULT_VAL=0x00000000 0x00000000 0x000001E0 0x00000000, PMUXEN_IMPLEMENTED=0x001FFFFF 0x0003FFFF 0x000FFFFF 0x001FFFFF (PINCFG.PMUXEN bit), PPP_IMPLEMENTED=0 (No IOBUS2), PULLEN_DEFAULT_VAL=0x00000000 0x00000000 0x00000000 0x00000000, PULLEN_IMPLEMENTED=0x001FFFFF 0x0003FFFF 0x000FFFFF 0x001FFFFF (PINCFG.PULLENRegistersImplemented), SECURE_IMPLEMENTED=1 (Mixed Secure Enabled), SLEWLIM=2 (Number of SLEWLIM bit), SLEWLIM_DEFAULT_VAL=0x00000000 0x00000000 0x00000000 0x00000000, SLEWLIM_IMPLEMENTED=0x0007C07F 0x00038078 0x000FF87F 0x001FCFC3 (PINCFG.SLEWLIM0RegistersImplemented), SLEWLIM1_DEFAULT_VAL=0x00000000 0x00000000 0x00000000 0x00000000, SLEWLIM1_IMPLEMENTED=0x0007C07F 0x00038078 0x000FF87F 0x001FCFC3 (PINCFG.SLEWLIM1RegistersImplemented), BRIDGE_ID=1 (H2PB Bridge ID), PERIPH_ID=0 (H2PB Peripheral ID), INSTANCE_ID=20 (Instance index for PORT), MCLK_ID_APB=27 (Index for PORT APB clock), PAC_ID=20 (Index for PORT registers write protection)
PTC at 0x4482C000
  pins: PTCXY0 PD06/P; PTCXY1 PD07/P; PTCXY2 PD08/P; PTCXY3 PD09/P; PTCXY{n} PA{n-4:02}/P (n=4..13); PTCXY14 PB00/P; PTCXY15 PB03/P; PTCXY16 PB04/P; PTCXY17 PB05/P; PTCXY18 PB06/P; PTCXY19 PC00/P; PTCXY20 PC01/P; PTCXY21 PC02/P; PTCXY22 PA10/P; PTCXY23 PA11/P; PTCXY24 PA12/P; PTCXY25 PA13/P; PTCXY26 PB07/P; PTCXY27 PB08/P; PTCXY28 PB09/P; PTCXY29 PB10/P; PTCXY30 PC09/P; PTCXY31 PC10/P; DRV0 PD06/P; DRV1 PD07/P; DRV2 PD08/P; DRV3 PD09/P; DRV{n} PA{n-4:02}/P (n=4..13); DRV14 PB00/P; DRV15 PB03/P; DRV16 PB04/P; DRV17 PB05/P; DRV18 PB06/P; DRV19 PC00/P; DRV20 PC01/P; DRV21 PC02/P; DRV22 PA10/P; DRV23 PA11/P; DRV24 PA12/P; DRV25 PA13/P; DRV26 PB07/P; DRV27 PB08/P; DRV28 PB09/P; DRV29 PB10/P; DRV30 PC09/P; DRV31 PC10/P; ECI0 PC03/P; ECI1 PC04/P
  parameters: PTC_PDATA_MSB=31 (APB Data Bus Size MSB), PTC_PADDR_MSB=12 (APB Address Bus Size MSB), PTC_PADDR_SIZE=13 (Number of bits of the paddr input busPossible Values = PTC_PADDR_MSB -1), PTC_LINES_NUM=36 (Number of PTC lines desired (0 to 64)), PTC_CAL_IMPLEMENTED=1 (Defines if the CALIB register is implemented (1 = implemented)), PTC_CAL_SIZE=16 (Defines Bitfield size for CALIB register), PTC_CAL_PORVAL=0x00000000 (Defines the CALIB register reset value after POR0x00000000 to 0xFFFFFFFF), PTC_ATEST_IMPLEMENTED=1 (Defines if the ATEST register is implemented (1 = implemented)), PTC_ATEST_SIZE=8 (Defines the number of effective bits in ATEST register), PTC_WPCTRL_IMPLEMENTED=0 (Implement the WPCTRL register for write protection.0 = Use apb_ptc_wrprot to control write protection enable/disable1 = Use WPCTRL register to control write protection enable/disable.), PTC_PRIV_IMPLEMENTED=1 (Implement the PRIV register for privilege/non-privilege bus accesses.0 = Register not present1 = Register present), PTC_WPCTRL_KEY=0x505443 (WPCTRL 24-bit key value. See register description for usage.Set to a unique value for each macro.), GCLK_ID=35, DMAC_ID_EOC=38, DMAC_ID_SEQ=39, DMAC_ID_WCOMP=40, BRIDGE_ID=1 (H2PB Bridge ID), PERIPH_ID=22 (H2PB Peripheral ID), INSTANCE_ID=41 (Instance index for PTC), MCLK_ID_APB=51 (Index for PTC APB clock), PAC_ID=41 (Index for PTC registers write protection)
RSTC at 0x45004000
  parameters: BACKUP_IMPLEMENTED=1, CM_DBGRESET_STRETCHED=3 (Reset stretcher size for Cortex CPU related to DBGRESET.), CM_HRESET_N_STRETCHED=3 (Reset stretcher size for Cortex CPU related to HRESETn.), CM_PORESET_STRETCHED=3 (Reset stretcher size for Cortex CPU related to PORESET.), HIB_IMPLEMENTED=1, VBAT_IMPLEMENTED=0 (One if VBAT (Battery backup mode) is supported), BRIDGE_ID=2 (H2PB Bridge ID), PERIPH_ID=2 (H2PB Peripheral ID), INSTANCE_ID=5 (Instance index for RSTC), MCLK_ID_APB=5 (Index for RSTC APB clock), PAC_ID=5 (Index for RSTC registers write protection)
RTC at 0x45006000
  pins: IN0 PA07/RTC_PAD_IE; IN1 PA08/RTC_PAD_IE; IN2 PA09/RTC_PAD_IE; IN3 PB00/RTC_PAD_IE; IN4 PB07/RTC_PAD_IE; IN5 PB08/RTC_PAD_IE; OUT0 PB03/_RTC_PAD_OE_N; OUT1 PB04/_RTC_PAD_OE_N; OUT2 PB05/_RTC_PAD_OE_N; OUT3 PB06/_RTC_PAD_OE_N; OUT4 PB09/_RTC_PAD_OE_N; OUT5 PB10/_RTC_PAD_OE_N
  parameters: NUM_OF_ALARMS=2, NUM_OF_BKREGS=0, NUM_OF_COMP16=4 (=2 * RTC_NUM_OF_ALARMS), NUM_OF_TAMPERS=8, DMAC_ID_TIMESTAMP=3, BRIDGE_ID=2 (H2PB Bridge ID), PERIPH_ID=3 (H2PB Peripheral ID), INSTANCE_ID=12 (Instance index for RTC), MCLK_ID_APB=12 (Index for RTC APB clock), PAC_ID=12 (Index for RTC registers write protection)
SAU at 0xE000EDD0
SCB at 0xE000ED00
SERCOM0 at 0x44808000 (SERCOM)
  pins: PAD0 PC00/D set 1; PAD1 PC01/D set 1; PAD2 PC02/D set 1; PAD3 PC03/D set 1
  parameters: CLK_REDUCTION=1 (Reduce clock options to pin 1 for SPI and USART), DMA=1 (DMA support implemented?), FIFO_IMPLEMENTED=1 (FIFO Rx/Tx implemented?), FIFO_SIZE=16 (Rx-Tx FIFO size in bytes), FSYNC_IMPLEMENTED=1 (SPI Frame Synch mode implemented?), SPI=1 (SPI mode implemented?), TWIM=1 (TWI Master mode implemented?), TWIS=1 (TWI Slave mode implemented?), ULTRA_IMPLEMENTATION=0 (ULTRA platform compatibility?), USART=1 (USART mode implemented?), USART_AUTOBAUD=1 (USART autobaud implemented?), USART_IRDA=1 (USART IrDA implemented?), USART_LIN_MASTER=1 (USART LIN Master mode implemented?), USART_RS485=1 (USART RS485 mode implemented?), GCLK_ID_SLOW=20, GCLK_ID_CORE=21, DMAC_ID_RX=4, DMAC_ID_TX=5, BRIDGE_ID=1 (H2PB Bridge ID), PERIPH_ID=4 (H2PB Peripheral ID), INSTANCE_ID=26 (Instance index for SERCOM0), MCLK_ID_APB=36 (Index for SERCOM0 APB clock), PAC_ID=26 (Index for SERCOM0 registers write protection)
SERCOM1 at 0x4480A000 (SERCOM)
  pins: PAD0 PD01/D; PAD1 PD00/D; PAD2 PC06/D set 1 or PD10/D set 2; PAD3 PC05/D set 1 or PD11/D set 2
  parameters: CLK_REDUCTION=1 (Reduce clock options to pin 1 for SPI and USART), DMA=1 (DMA support implemented?), FIFO_IMPLEMENTED=1 (FIFO Rx/Tx implemented?), FIFO_SIZE=16 (Rx-Tx FIFO size in bytes), FSYNC_IMPLEMENTED=1 (SPI Frame Synch mode implemented?), SPI=1 (SPI mode implemented?), TWIM=1 (TWI Master mode implemented?), TWIS=1 (TWI Slave mode implemented?), ULTRA_IMPLEMENTATION=0 (ULTRA platform compatibility?), USART=1 (USART mode implemented?), USART_AUTOBAUD=1 (USART autobaud implemented?), USART_IRDA=1 (USART IrDA implemented?), USART_LIN_MASTER=1 (USART LIN Master mode implemented?), USART_RS485=1 (USART RS485 mode implemented?), GCLK_ID_SLOW=20, GCLK_ID_CORE=22, DMAC_ID_RX=6, DMAC_ID_TX=7, BRIDGE_ID=1 (H2PB Bridge ID), PERIPH_ID=5 (H2PB Peripheral ID), INSTANCE_ID=27 (Instance index for SERCOM1), MCLK_ID_APB=37 (Index for SERCOM1 APB clock), PAC_ID=27 (Index for SERCOM1 registers write protection)
SERCOM2 at 0x4480C000 (SERCOM)
  pins: PAD0 PC04/D set 1; PAD1 PD06/D set 1; PAD2 PD07/D set 1; PAD3 PD08/D set 1
  parameters: CLK_REDUCTION=1 (Reduce clock options to pin 1 for SPI and USART), DMA=1 (DMA support implemented?), FIFO_IMPLEMENTED=1 (FIFO Rx/Tx implemented?), FIFO_SIZE=16 (Rx-Tx FIFO size in bytes), FSYNC_IMPLEMENTED=1 (SPI Frame Synch mode implemented?), SPI=1 (SPI mode implemented?), TWIM=1 (TWI Master mode implemented?), TWIS=1 (TWI Slave mode implemented?), ULTRA_IMPLEMENTATION=0 (ULTRA platform compatibility?), USART=1 (USART mode implemented?), USART_AUTOBAUD=1 (USART autobaud implemented?), USART_IRDA=1 (USART IrDA implemented?), USART_LIN_MASTER=1 (USART LIN Master mode implemented?), USART_RS485=1 (USART RS485 mode implemented?), GCLK_ID_SLOW=20, GCLK_ID_CORE=23, DMAC_ID_RX=8, DMAC_ID_TX=9, BRIDGE_ID=1 (H2PB Bridge ID), PERIPH_ID=6 (H2PB Peripheral ID), INSTANCE_ID=28 (Instance index for SERCOM2), MCLK_ID_APB=38 (Index for SERCOM2 APB clock), PAC_ID=28 (Index for SERCOM2 registers write protection)
SERCOM3 at 0x4480E000 (SERCOM)
  pins: PAD0 PD09/D set 1; PAD1 PA00/D set 1; PAD2 PA01/D set 1; PAD3 PA02/D set 1
  parameters: CLK_REDUCTION=1 (Reduce clock options to pin 1 for SPI and USART), DMA=1 (DMA support implemented?), FIFO_IMPLEMENTED=1 (FIFO Rx/Tx implemented?), FIFO_SIZE=16 (Rx-Tx FIFO size in bytes), FSYNC_IMPLEMENTED=1 (SPI Frame Synch mode implemented?), SPI=1 (SPI mode implemented?), TWIM=1 (TWI Master mode implemented?), TWIS=1 (TWI Slave mode implemented?), ULTRA_IMPLEMENTATION=0 (ULTRA platform compatibility?), USART=1 (USART mode implemented?), USART_AUTOBAUD=1 (USART autobaud implemented?), USART_IRDA=1 (USART IrDA implemented?), USART_LIN_MASTER=1 (USART LIN Master mode implemented?), USART_RS485=1 (USART RS485 mode implemented?), GCLK_ID_SLOW=20, GCLK_ID_CORE=24, DMAC_ID_RX=10, DMAC_ID_TX=11, BRIDGE_ID=1 (H2PB Bridge ID), PERIPH_ID=7 (H2PB Peripheral ID), INSTANCE_ID=29 (Instance index for SERCOM3), MCLK_ID_APB=39 (Index for SERCOM3 APB clock), PAC_ID=29 (Index for SERCOM3 registers write protection)
SERCOM4 at 0x44820000 (SERCOM)
  pins: PAD0 PA03/D set 1; PAD1 PA04/D set 1; PAD2 PA05/D set 1; PAD3 PA06/D set 1
  parameters: CLK_REDUCTION=1 (Reduce clock options to pin 1 for SPI and USART), DMA=1 (DMA support implemented?), FIFO_IMPLEMENTED=1 (FIFO Rx/Tx implemented?), FIFO_SIZE=16 (Rx-Tx FIFO size in bytes), FSYNC_IMPLEMENTED=1 (SPI Frame Synch mode implemented?), SPI=1 (SPI mode implemented?), TWIM=0 (TWI Master mode implemented?), TWIS=0 (TWI Slave mode implemented?), ULTRA_IMPLEMENTATION=0 (ULTRA platform compatibility?), USART=1 (USART mode implemented?), USART_AUTOBAUD=1 (USART autobaud implemented?), USART_IRDA=1 (USART IrDA implemented?), USART_LIN_MASTER=1 (USART LIN Master mode implemented?), USART_RS485=1 (USART RS485 mode implemented?), GCLK_ID_CORE=28, DMAC_ID_RX=24, DMAC_ID_TX=25, BRIDGE_ID=1 (H2PB Bridge ID), PERIPH_ID=16 (H2PB Peripheral ID), INSTANCE_ID=34 (Instance index for SERCOM4), MCLK_ID_APB=44 (Index for SERCOM4 APB clock), PAC_ID=34 (Index for SERCOM4 registers write protection)
SERCOM5 at 0x44822000 (SERCOM)
  pins: PAD0 PB03/D set 1; PAD1 PB04/D set 1; PAD2 PB05/D set 1; PAD3 PB06/D set 1
  parameters: CLK_REDUCTION=1 (Reduce clock options to pin 1 for SPI and USART), DMA=1 (DMA support implemented?), FIFO_IMPLEMENTED=1 (FIFO Rx/Tx implemented?), FIFO_SIZE=16 (Rx-Tx FIFO size in bytes), FSYNC_IMPLEMENTED=1 (SPI Frame Synch mode implemented?), SPI=1 (SPI mode implemented?), TWIM=0 (TWI Master mode implemented?), TWIS=0 (TWI Slave mode implemented?), ULTRA_IMPLEMENTATION=0 (ULTRA platform compatibility?), USART=1 (USART mode implemented?), USART_AUTOBAUD=1 (USART autobaud implemented?), USART_IRDA=1 (USART IrDA implemented?), USART_LIN_MASTER=1 (USART LIN Master mode implemented?), USART_RS485=1 (USART RS485 mode implemented?), GCLK_ID_CORE=29, DMAC_ID_RX=26, DMAC_ID_TX=27, BRIDGE_ID=1 (H2PB Bridge ID), PERIPH_ID=17 (H2PB Peripheral ID), INSTANCE_ID=35 (Instance index for SERCOM5), MCLK_ID_APB=45 (Index for SERCOM5 APB clock), PAC_ID=35 (Index for SERCOM5 registers write protection)
SUPC at 0x45002000
  pins: RESETn RESET_N/RES; SMOR_DTEST0 PD08/SUPC_VREF_TESTMODE; SMOR_DTEST1 PD09/SUPC_VREF_TESTMODE; SMOR_DTEST2 PD07/SUPC_VREF_TESTMODE; SMOR_DTEST3 PA00/SUPC_VREF_TESTMODE; SMOR_DTEST4 PA01/SUPC_VREF_TESTMODE; SMOR_DTEST5 PA02/SUPC_VREF_TESTMODE; SMOR_DTEST6 PA03/SUPC_VREF_TESTMODE; SMOR_DTEST7 PA04/SUPC_VREF_TESTMODE; SMOR_DTEST8 PB03/SUPC_VREF_TESTMODE; SMOR_DTEST9 PB04/SUPC_VREF_TESTMODE; SMOR_DTEST10 PB05/SUPC_VREF_TESTMODE; SMOR_DTEST11 PB06/SUPC_VREF_TESTMODE; SMOR_DTEST12 PC00/SUPC_VREF_TESTMODE; SMOR_DTEST13 PA06/SUPC_VREF_TESTMODE; SMOR_DTEST14 PA07/SUPC_VREF_TESTMODE; SMOR_DTEST15 PC03/SUPC_VREF_TESTMODE; OUT0 PB04; OUT1 PB05; USERLDO PD06/USER_LDO; USERLDO_OUT USERLDO/USER_LDO_OP_AMP
  parameters: ADDVREG_NUM=1 (Jira PWR109-210), ADDVREG_PLL_NUM=0, ADDVREG_PLL_START_INDEX=1, BKOUT_NUM=2, BORVDDUSB_NUM=1 ((Jira PWR109-219)), CHRG_PUMP_NUM=2, IOB_IMPLEMENTED=0, USER_LDO_IMPLEMENTED=1, VBAT_IMPLEMENTED=0, VREGSW_NUM=1, BRIDGE_ID=2 (H2PB Bridge ID), PERIPH_ID=1 (H2PB Peripheral ID), INSTANCE_ID=4 (Instance index for SUPC), MCLK_ID_APB=4 (Index for SUPC APB clock), PAC_ID=4 (Index for SUPC registers write protection)
SysTick at 0xE000E010
  parameters: __SYST_NUM=2 (Number of implemented SysTick timers)
TCC0 at 0x44810000 (TCC)
  pins: WO0 PC00/F set 1; WO1 PC01/F set 1
  parameters: CC_NUM=2 (Number of Compare/Capture units), DITHERING=0 (Dithering feature implemented), DTI=0 (Dead-Time-Insertion feature implemented), MASTER_SLAVE_MODE=1 (TCC type 0 : NA, 1 : Master, 2 : Slave), OTMX=0 (Output Matrix feature implemented), OW_NUM=2 (Number of Output Waveforms), PG=0 (Pattern Generation feature implemented), SIZE=16, SWAP=0 (DTI outputs swap feature implemented), GCLK_ID_TCC01=25, DMAC_ID_OVF=12, DMAC_ID_MC0=13, DMAC_ID_MC1=14, BRIDGE_ID=1 (H2PB Bridge ID), PERIPH_ID=8 (H2PB Peripheral ID), INSTANCE_ID=30 (Instance index for TCC0), MCLK_ID_APB=40 (Index for TCC0 APB clock), PAC_ID=30 (Index for TCC0 registers write protection)
TCC1 at 0x44812000 (TCC)
  pins: WO0 PC02/F set 1 or PC09/F set 2; WO1 PC03/F set 1 or PC10/F set 2
  parameters: CC_NUM=2 (Number of Compare/Capture units), DITHERING=0 (Dithering feature implemented), DTI=0 (Dead-Time-Insertion feature implemented), MASTER_SLAVE_MODE=2 (TCC type 0 : NA, 1 : Master, 2 : Slave), OTMX=0 (Output Matrix feature implemented), OW_NUM=2 (Number of Output Waveforms), PG=0 (Pattern Generation feature implemented), SIZE=16, SWAP=0 (DTI outputs swap feature implemented), GCLK_ID_TCC01=25, DMAC_ID_OVF=15, DMAC_ID_MC0=16, DMAC_ID_MC1=17, BRIDGE_ID=1 (H2PB Bridge ID), PERIPH_ID=9 (H2PB Peripheral ID), INSTANCE_ID=31 (Instance index for TCC1), MCLK_ID_APB=41 (Index for TCC1 APB clock), PAC_ID=31 (Index for TCC1 registers write protection)
TCC2 at 0x44814000 (TCC)
  pins: WO0 PB09/F set 2 or PC04/F set 1; WO1 PB08/F set 2 or PC05/F set 1
  parameters: CC_NUM=2 (Number of Compare/Capture units), DITHERING=0 (Dithering feature implemented), DTI=0 (Dead-Time-Insertion feature implemented), MASTER_SLAVE_MODE=0 (TCC type 0 : NA, 1 : Master, 2 : Slave), OTMX=0 (Output Matrix feature implemented), OW_NUM=2 (Number of Output Waveforms), PG=0 (Pattern Generation feature implemented), SIZE=16, SWAP=0 (DTI outputs swap feature implemented), GCLK_ID=26, DMAC_ID_OVF=18, DMAC_ID_MC0=19, DMAC_ID_MC1=20, BRIDGE_ID=1 (H2PB Bridge ID), PERIPH_ID=10 (H2PB Peripheral ID), INSTANCE_ID=32 (Instance index for TCC2), MCLK_ID_APB=42 (Index for TCC2 APB clock), PAC_ID=32 (Index for TCC2 registers write protection)
TCC3 at 0x44816000 (TCC)
  pins: WO0 PD00/F set 1; WO1 PD01/F set 1
  parameters: CC_NUM=2 (Number of Compare/Capture units), DITHERING=0 (Dithering feature implemented), DTI=0 (Dead-Time-Insertion feature implemented), MASTER_SLAVE_MODE=0 (TCC type 0 : NA, 1 : Master, 2 : Slave), OTMX=0 (Output Matrix feature implemented), OW_NUM=2 (Number of Output Waveforms), PG=0 (Pattern Generation feature implemented), SIZE=16, SWAP=0 (DTI outputs swap feature implemented), GCLK_ID=27, DMAC_ID_OVF=21, DMAC_ID_MC0=22, DMAC_ID_MC1=23, BRIDGE_ID=1 (H2PB Bridge ID), PERIPH_ID=11 (H2PB Peripheral ID), INSTANCE_ID=33 (Instance index for TCC3), MCLK_ID_APB=43 (Index for TCC3 APB clock), PAC_ID=33 (Index for TCC3 registers write protection)
TCC4 at 0x44824000 (TCC)
  pins: WO0 PA10/F set 2 or PD07/F set 1; WO1 PA11/F set 2 or PD08/F set 1
  parameters: CC_NUM=2 (Number of Compare/Capture units), DITHERING=0 (Dithering feature implemented), DTI=0 (Dead-Time-Insertion feature implemented), MASTER_SLAVE_MODE=0 (TCC type 0 : NA, 1 : Master, 2 : Slave), OTMX=0 (Output Matrix feature implemented), OW_NUM=2 (Number of Output Waveforms), PG=0 (Pattern Generation feature implemented), SIZE=16, SWAP=0 (DTI outputs swap feature implemented), GCLK_ID=30, DMAC_ID_OVF=28, DMAC_ID_MC0=29, DMAC_ID_MC1=30, BRIDGE_ID=1 (H2PB Bridge ID), PERIPH_ID=18 (H2PB Peripheral ID), INSTANCE_ID=36 (Instance index for TCC4), MCLK_ID_APB=46 (Index for TCC4 APB clock), PAC_ID=36 (Index for TCC4 registers write protection)
TCC5 at 0x44826000 (TCC)
  pins: WO0 PD10/F set 2 or PD09/F set 1; WO1 PA00/F set 1 or PD11/F set 2
  parameters: CC_NUM=2 (Number of Compare/Capture units), DITHERING=0 (Dithering feature implemented), DTI=0 (Dead-Time-Insertion feature implemented), MASTER_SLAVE_MODE=0 (TCC type 0 : NA, 1 : Master, 2 : Slave), OTMX=0 (Output Matrix feature implemented), OW_NUM=2 (Number of Output Waveforms), PG=0 (Pattern Generation feature implemented), SIZE=16, SWAP=0 (DTI outputs swap feature implemented), GCLK_ID=31, DMAC_ID_OVF=31, DMAC_ID_MC0=32, DMAC_ID_MC1=33, BRIDGE_ID=1 (H2PB Bridge ID), PERIPH_ID=19 (H2PB Peripheral ID), INSTANCE_ID=37 (Instance index for TCC5), MCLK_ID_APB=47 (Index for TCC5 APB clock), PAC_ID=37 (Index for TCC5 registers write protection)
TCC6 at 0x44828000 (TCC)
  pins: WO0 PA01/F set 1 or PD12/F set 2; WO1 PA02/F set 1 or PD13/F set 2
  parameters: CC_NUM=2 (Number of Compare/Capture units), DITHERING=0 (Dithering feature implemented), DTI=0 (Dead-Time-Insertion feature implemented), MASTER_SLAVE_MODE=0 (TCC type 0 : NA, 1 : Master, 2 : Slave), OTMX=0 (Output Matrix feature implemented), OW_NUM=2 (Number of Output Waveforms), PG=0 (Pattern Generation feature implemented), SIZE=16, SWAP=0 (DTI outputs swap feature implemented), GCLK_ID=32, DMAC_ID_OVF=34, DMAC_ID_MC0=35, DMAC_ID_MC1=36, BRIDGE_ID=1 (H2PB Bridge ID), PERIPH_ID=20 (H2PB Peripheral ID), INSTANCE_ID=38 (Instance index for TCC6), MCLK_ID_APB=48 (Index for TCC6 APB clock), PAC_ID=38 (Index for TCC6 registers write protection)
TESTVAL
  pins: VALIO0 PD00/VALIO; VALIO1 PD01/VALIO; VALIO2 PC04/VALIO; VALIO3 PA05/VALIO; VALIO4 PC01/VALIO; VALIO5 PC02/VALIO
USB at 0x44832000
  pins: SOF PD01/H; USBDM PD02/H; USBDP PD03/H
  parameters: AHB_2_USB_FIFO_DEPTH=4 (bytes number, should be at least 2, and 2^n (4,8,16 ...)), AHB_2_USB_RD_DATA_BITS=8 (8, 16 or 32, here : 8-bits is required as UTMI interface should work in 8-bits mode), AHB_2_USB_WR_DATA_BITS=32 (8, 16 or 32 : here, AHB transfer is made in word mode), AHB_2_USB_WR_THRESHOLD=2 (as soon as there are N bytes-free inside the fifo, ahb read transfer is requested), DATA_BUS_16_8=0 (UTMI/SIE data bus size : 0 -> 8 bits, 1 -> 16 bits), EPNUM=8 (parameter for rtl : max of ENDPOINT and PIPE NUM), EPT_NUM=8 (Number of USB end points), INITIAL_CONTROL_QOS=3 (CONTROL QOS RESET value), INITIAL_DATA_QOS=3 (DATA QOS RESET value), MISSING_SOF_DET_IMPLEMENTED=1 (48 mHz xPLL feature implemented), PIPE_NUM=8 (Number of USB pipes), SYSTEM_CLOCK_IS_CKUSB=0 (Dual (1'b0) or Single (1'b1) clock system), USB_2_AHB_FIFO_DEPTH=4 (bytes number, should be at least 2, and 2^n (4,8,16 ...)), USB_2_AHB_RD_DATA_BITS=16 (8, 16 or 32, here : 8-bits is required as UTMI interface should work in 8-bits mode), USB_2_AHB_RD_THRESHOLD=2 (as soon as there are 16 bytes-free inside the fifo, ahb read transfer is requested), USB_2_AHB_WR_DATA_BITS=8 (8, 16 or 32 : here : 8-bits is required as UTMI interface should work in 8-bits mode), GCLK_ID=38, BRIDGE_ID=1 (H2PB Bridge ID), PERIPH_ID=25 (H2PB Peripheral ID), INSTANCE_ID=44 (Instance index for USB), MCLK_ID_AHB=54 (Index for USB AHB clock), MCLK_ID_APB=55 (Index for USB APB clock), PAC_ID=44 (Index for USB registers write protection)
WDT at 0x4400E000
  parameters: FUSES_UPDATE_SUPPORT=0 (WDT Fuse Update Support), BRIDGE_ID=0 (H2PB Bridge ID), PERIPH_ID=7 (H2PB Peripheral ID), INSTANCE_ID=11 (Instance index for WDT), MCLK_ID_APB=11 (Index for WDT APB clock), PAC_ID=11 (Index for WDT registers write protection)

## Notices in the file
Copyright (c) 2024 Microchip Technology Inc.
SPDX-License-Identifier: Apache-2.0
Licensed under the Apache License, Version 2.0 (the "License");
you may not use this file except in compliance with the License.
You may obtain a copy of the License at
http://www.apache.org/licenses/LICENSE-2.0
Unless required by applicable law or agreed to in writing, software
distributed under the License is distributed on an "AS IS" BASIS,
WITHOUT WARRANTIES OR CONDITIONS OF ANY KIND, either express or implied.
See the License for the specific language governing permissions and
limitations under the License.
