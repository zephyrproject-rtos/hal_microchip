# PIC32CM1216JH01048 device description
Architecture: CORTEX-M0PLUS; Family: PIC32CM; Series: PIC32CMJH01
Parameters: NUM_IRQ=32 (Number of interrupt request lines), __CM0P_REV=0x0001 (Cortex-M0+ Core Revision), __MPU_PRESENT=1 (MPU present or not), __NVIC_PRIO_BITS=2 (Number of Bits used for Priority Levels), __VTOR_PRESENT=1 (Vector Table Offset Register present or not), __Vendor_SysTickConfig=0 (Set to 1 if different SysTick Config is used), POWER_DOMAIN=PDTOP, __ARCH_ARM=1, __ARCH_ARM_CORTEX_M=1
Programming and debug interfaces: SWD
Registers are 32-bit, read-write, reset 0x0 unless marked. A register's access mark holds for its fields unless they carry their own. Offsets are from the block's base; lines under a group give offsets from that group; [hi:lo] are bit positions; {n}, {i} and the like mark numbered series; 'fields as' and 'values as' point back to an identical list; <NAME> marks a mode.

## Ordering variants
PIC32CM1216JH01048-I/Y8X: TQFP48, pinout CMJH48, up to 48 MHz, -40 to 85 C, 2.7 to 5.5 V
PIC32CM1216JH01048-E/Y8X: TQFP48, pinout CMJH48, up to 48 MHz, -40 to 125 C, 2.7 to 5.5 V
PIC32CM1216JH01048-I/U5B: QFN48, pinout CMJH48, up to 48 MHz, -40 to 85 C, 2.7 to 5.5 V
PIC32CM1216JH01048-E/U5B: QFN48, pinout CMJH48, up to 48 MHz, -40 to 125 C, 2.7 to 5.5 V

## Memory
base space: start 0 size 0x100000000, little endian
  0x00000000 FLASH size 0x20000 flash, rw, executable, page 64
  0x00800000 CAL size 0x8 fuses, ro
  0x00802000 LOCKBIT size 0x4 fuses, ro
  0x00806000 OTP1 size 0x8 fuses, ro
  0x00806008 OTP2 size 0x8 fuses, ro
  0x00806010 OTP3 size 0x8 fuses, ro
  0x00806018 OTP4 size 0x8 fuses, ro
  0x00806020 OTP5 size 0x8 fuses, ro
  0x00806030 TEMP_LOG size 0x8 fuses, ro
  0x00804000 USER_PAGE size 0x100 user_page, rw, page 64
  0x00400000 DATAFLASH size 0x1000 flash, rw, executable, page 64
  0x20000000 DRAM size 0x4000 ram, rw, executable
  0x40000000 HPB0 size 0x4000 io, rw
  0x41000000 HPB1 size 0x10000 io, rw
  0x42000000 HPB2 size 0x8000 io, rw
  0x43000000 HPB3 size 0x1800 io, rw
  0x48000000 DIVAS size 0x20 io, rw
  0xE0000000 PPB size 0x100000 io, rw
fuses space: start 0x00000000 size 0x20000000, little endian

## Peripheral instances (address, pins/pin function, parameters)
AC at 0x42004C00
  pins: AIN0 PA04/B; AIN1 PA05/B; AIN2 PA06/B; AIN3 PA07/B; AIN4 PA02/B; AIN5 PA03/B; CMP0 PA12/H or PA18/H; CMP1 PA13/H or PA19/H; CMP2 PA00/H or PA24/H; CMP3 PA01/H or PA25/H
  parameters: COMPCTRL_MUXNEG_OPAMP=7 (OPAMP selection for MUXNEG), GCLK_ID=42 (Index of Generic Clock), NUM_CMP=2 (Number of comparators), PAIRS=1 (Number of pairs of comparators), SPEED_LEVELS=2 (Number of speed values), INSTANCE_ID=83 (Instance index for AC)
ADC0 at 0x42004400 (ADC)
  pins: AIN0 PA02/B; AIN1 PA03/B; AIN2 PB08/B; AIN3 PB09/B; AIN{n} PA{n:02}/B (n=4..11); VREFP PA03/B
  parameters: DMAC_ID_RESRDY=42 (Index of DMA RESRDY trigger), EXTCHANNEL_MSB=11 (Number of external channels), GCLK_ID=36 (Index of Generic Clock), INT_CH30=0 (Select OPAMP or CTAT on Channel 30), MASTER_SLAVE_MODE=0 (ADC Master/Slave Mode), INSTANCE_ID=81 (Instance index for ADC0)
CAN0 at 0x42001C00 (CAN)
  pins: RX PA25/G or PB23/G; TX PA24/G or PB22/G
  parameters: DMAC_ID_DEBUG=14 (DMA CAN Debug Req), GCLK_ID=26 (Index of Generic Clock), MSG_RAM_ADDR=0x200000000, QOS_RESET_VAL=2 (QOS reset value), INSTANCE_ID=71 (Instance index for CAN0)
DIVAS at 0x48000000, DIVAS_IOBUS 0x60000200
DMAC at 0x41006000
  parameters: CH_BITS=4 (Number of bits to select channel), CH_NUM=12 (Number of channels), EVIN_NUM=4 (Number of input events), EVOUT_NUM=4 (Number of output events), LVL_BITS=2 (Number of bit to select level priority), LVL_NUM=4 (Enable priority level number), QOSCTRL_D_RESETVALUE=2 (QOS dmac ahb interface reset value), QOSCTRL_F_RESETVALUE=2 (QOS dmac fetch interface reset value), QOSCTRL_WRB_RESETVALUE=2 (QOS dmac write back interface reset value), SPLIT_IRQ_NUM=0 (Number of IRQ split out), TRIG_BITS=6 (Number of bits to select trigger source), TRIG_NUM=63 (Number of peripheral triggers), INSTANCE_ID=35 (Instance index for DMAC)
DSU at 0x41002000, DSU_EXT 0x41002100
  parameters: INSTANCE_ID=33 (Instance index for DSU)
EIC at 0x40002800
  pins: EXTINT0 PA16/A or PA00/A; EXTINT1 PA17/A or PA01/A; EXTINT2 PA02/A or PA18/A or PB02/A; EXTINT3 PA03/A or PA19/A or PB03/A; EXTINT4 PA04/A or PA20/A; EXTINT5 PA05/A or PA21/A; EXTINT6 PA06/A or PA22/A or PB22/A; EXTINT7 PA07/A or PA23/A or PB23/A; EXTINT8 PB08/A or PA28/A; EXTINT9 PA09/A or PB09/A; EXTINT10 PA10/A or PA30/A or PB10/A; EXTINT11 PA11/A or PA31/A or PB11/A; EXTINT12 PA12/A or PA24/A; EXTINT13 PA13/A or PA25/A; EXTINT14 PA14/A; EXTINT15 PA27/A or PA15/A; NMI PA08/A
  parameters: EXTINT_NUM=16 (Number of external interrupts), GCLK_ID=2 (Generic Clock index), NUMBER_OF_CONFIG_REGS=2 (Number of CONFIG registers), NUMBER_OF_DPRESCALER_REGS=2 (Number of DPRESCALER registers), NUMBER_OF_INTERRUPTS=16 (Number of external interrupts (obsolete)), INSTANCE_ID=10 (Instance index for EIC)
EVSYS at 0x42000000
  parameters: CHANNELS=12 (Number of Channels), CHANNELS_BITS=4 (Number of bits to select Channel), CHANNELS_MSB=11 (Number of Channels - 1), EXTEVT_NUM=0 (Number of External Event Generators), GCLK_ID_{n}={n+5} (Index of Generic Clock {n}) (n=0..11), GENERATORS=86 (Total Number of Event Generators), GENERATORS_BITS=7 (Number of bits to select Event Generator), USERS=45 (Total Number of Event Users), USERS_BITS=6 (Number of bits to select Event User), INSTANCE_ID=64 (Instance index for EVSYS)
FREQM at 0x40002C00
  parameters: GCLK_ID_MSR=3 (Index of measure generic clock), GCLK_ID_REF=4 (Index of reference generic clock), INSTANCE_ID=11 (Instance index for FREQM)
GCLK at 0x40001C00
  pins: IO0 PB22/H or PA14/H or PA27/H or PA30/H or PA28/H; IO1 PB23/H or PA15/H; IO2 PA16/H; IO3 PA17/H; IO4 PA10/H or PA20/H or PB10/H; IO5 PA11/H or PA21/H or PB11/H; IO6 PA22/H; IO7 PA23/H
  parameters: GENDIV_BITS=16, GEN_BITS=4, GEN_NUM=9 (Number of Generic Clock Generators), GEN_NUM_MSB=8 (Number of Generic Clock Generators - 1), GEN_SOURCE_NUM_MSB=7 (Number of Generic Clock Sources - 1), NUM=43 (Number of Generic Clock Users), SOURCE_BITS=3, SOURCE_NUM=8 (Number of Generic Clock Sources), INSTANCE_ID=7 (Instance index for GCLK)
SMBIST at 0x42006c00
  parameters: EN_LMOB=0 (Enable Local SRAM MBIST On Boot.), EN_ONLINE=1 (Enable online Local SRAM MBIST.), INSTANCE_ID=91 (Instance index for SMBIST.)
MCLK at 0x40000800
  parameters: CTRLA_MCSEL_GCLK=1, CTRLA_MCSEL_OSC8M=0, MCLK_CLK_APB_NUM=4, SYSTEM_CLOCK=4000000 (System Clock Frequency at Reset), INSTANCE_ID=2 (Instance index for MCLK)
  clocks: AHB HPB0 bit 0, HPB1 bit 1, HPB2 bit 2, DSU bit 3, HMATRIXHS bit 4, NVMCTRL bit 5, DRAM bit 6, DMAC bit 7, CAN0 bit 8, PAC bit 10, NVMCTRL_PICACHU bit 11, DIVAS bit 12, HPB3 bit 13
MPU at 0xE000ED90
MTB at 0x41008000
  parameters: INSTANCE_ID=36 (Instance index for MTB)
NVIC at 0xE000E100
  parameters: NUM_IRQ=32 (Number of interrupt requests), __NVIC_PRIO_BITS=2 (Number of NVIC interrupt priority bits)
NVMCTRL at 0x41004000
  pins: MARGIN VMARGIN
  parameters: ECC_PRESENT=0 (define out all the added ECC logic - when =0 there shall be no ECC logic present in the design), FACTORY_WORD_IMPLEMENTED_MASK=0XC0000007FFFFFFFF, PMSB=3, PSZ_BITS=6, RSTFFLTADDR=0x00000000 (the reset default for FFLTADDR), USER_PAGE_OFFSET=0x00800000, USER_WORD_IMPLEMENTED_MASK=0XC01FFFFFFFFFFFFF, DATAFLASH_PAGES=64, DATAFLASH_ADDR=0x00400000 (Start address of the Data Flash area), DATAFLASH_SIZE=4096 (Byte size of the Data Flash area), FLASH_SIZE=131072, PAGE_SIZE=64, PAGES=2048, PAGES_PR_REGION=128, INSTANCE_ID=34 (Instance index for NVMCTRL)
FUSES at LOCKBIT_FUSES 0x00802000 in fuses, OTP1_FUSES 0x00806000 in fuses, OTP2_FUSES 0x00806008 in fuses, OTP3_FUSES 0x00806010 in fuses, OTP4_FUSES 0x00806018 in fuses, OTP5_FUSES 0x00806020 in fuses, USER_FUSES 0x00804000 in fuses
OSC32KCTRL at 0x40001400
  pins: XIN32 PA00/XIN32; XOUT32 PA01/XOUT32
  parameters: OSC32K_COARSE_CALIB_MSB=6, INSTANCE_ID=5 (Instance index for OSC32KCTRL)
OSCCTRL at 0x40001000
  pins: XIN PA14/XIN; XOUT PA15/XOUT
  parameters: GCLK_ID_FDPLL=0 (Index of Generic Clock for DPLL), GCLK_ID_FDPLL32K=1 (Index of Generic Clock for DPLL 32K), FDPLL_VERSION=0x220, OSC48M_VERSION=0x101, XOSC_VERSION=0x210, INSTANCE_ID=4 (Instance index for OSCCTRL)
PAC at 0x40000000
  parameters: HPB_NUM=4 (Number of bridges AHB/APB), INTFLAG_NUM=4 (Number of intflag registers), INSTANCE_ID=0 (Instance index for PAC)
PM at 0x40000400
  pins: RESET_N RESET_N
  parameters: BIAS_RAM_HS=1 (one if RAM HS can be back biased), PD_NUM=0 (Number of switchable Power Domain), INSTANCE_ID=1 (Instance index for PM)
PORT at 0x41000000, PORT_IOBUS 0x60000000
  pins: P{n} PA{n:02} (n=0..25); P27 PA27; P28 PA28; P30 PA30; P31 PA31; P34 PB02; P35 PB03; P40 PB08; P41 PB09; P42 PB10; P43 PB11; P54 PB22; P55 PB23
  parameters: BITS=56, DRVSTR=1 (DRVSTR supported?), EV_NUM=4, GROUPS=2, MSB=55, ODRAIN=0 (ODRAIN supported?), INSTANCE_ID=32 (Instance index for PORT)
RSTC at 0x40000C00
  pins: EXTWAKE{n} PA{n:02}/A (n=0..15)
  parameters: BACKUP_IMPLEMENTED=0, NUMBER_OF_EXTWAKE=0 (number of external wakeup line), INSTANCE_ID=3 (Instance index for RSTC)
RTC at 0x40002400
  parameters: DMAC_ID_TIMESTAMP=62 (DMA RTC timestamp trigger), GPR_NUM=2 (Number of General-Purpose Registers), NUM_OF_ALARMS=1 (Number of Alarms), NUM_OF_BKREGS=0 (Number of Backup Registers), NUM_OF_COMP16=2 (Number of 16-bit Comparators), NUM_OF_COMP32=1 (Number of 32-bit Comparators), NUM_OF_TAMPERS=1 (Number of Tamper Inputs), PER_NUM=8 (Number of Periodic Intervals), INSTANCE_ID=9 (Instance index for RTC)
SERCOM0 at 0x42000400 (SERCOM)
  pins: PAD0 PA04/D or PA08/C; PAD1 PA05/D or PA09/C; PAD2 PA06/D or PA10/C; PAD3 PA07/D or PA11/C
  parameters: DMAC_ID_RX=2 (Index of DMA RX trigger), DMAC_ID_TX=3 (Index of DMA TX trigger), GCLK_ID_CORE=18, GCLK_ID_SLOW=17, INT_MSB=6, PMSB=3, INSTANCE_ID=65 (Instance index for SERCOM0)
SERCOM1 at 0x42000800 (SERCOM)
  pins: PAD0 PA16/C or PA00/D; PAD1 PA17/C or PA01/D; PAD2 PA30/D or PA18/C; PAD3 PA31/D or PA19/C
  parameters: DMAC_ID_RX=4 (Index of DMA RX trigger), DMAC_ID_TX=5 (Index of DMA TX trigger), GCLK_ID_CORE=19, GCLK_ID_SLOW=17, INT_MSB=6, PMSB=3, INSTANCE_ID=66 (Instance index for SERCOM1)
SERCOM2 at 0x42000C00 (SERCOM)
  pins: PAD0 PA08/D or PA12/C; PAD1 PA09/D or PA13/C; PAD2 PA10/D or PA14/C; PAD3 PA11/D or PA15/C
  parameters: DMAC_ID_RX=6 (Index of DMA RX trigger), DMAC_ID_TX=7 (Index of DMA TX trigger), GCLK_ID_CORE=20, GCLK_ID_SLOW=17, INT_MSB=6, PMSB=3, INSTANCE_ID=67 (Instance index for SERCOM2)
SERCOM3 at 0x42001000 (SERCOM)
  pins: PAD0 PA16/D or PA22/C; PAD1 PA17/D or PA23/C; PAD2 PA18/D or PA20/D or PA24/C; PAD3 PA19/D or PA21/D or PA25/C
  parameters: DMAC_ID_RX=8 (Index of DMA RX trigger), DMAC_ID_TX=9 (Index of DMA TX trigger), GCLK_ID_CORE=21, GCLK_ID_SLOW=17, INT_MSB=6, PMSB=3, INSTANCE_ID=68 (Instance index for SERCOM3)
SUPC at 0x40001800
  parameters: BODCORE_CALIB_MSB=5, BODVDD_CALIB_MSB=5, SUPC_OUT_NUM_MSB=1 (MSB of backup output pad Number), INSTANCE_ID=6 (Instance index for SUPC)
SysTick at 0xE000E010
SystemControl at 0xE000E000
  parameters: __VTOR_PRESENT=1 (Vector Table Offset Register present)
TC0 at 0x42003000 (TC)
  pins: WO0 PA22/E or PB08/E; WO1 PA23/E or PB09/E
  parameters: CC_NUM=2, DMAC_ID_MC_0=28 (Indexes of DMA Match/Compare triggers 0), DMAC_ID_MC_1=29 (Indexes of DMA Match/Compare triggers 1), DMAC_ID_OVF=27 (Indexes of DMA Overflow trigger), EXT=0 (Coding of implemented extended features (keep 0 value)), GCLK_ID=30 (Index of Generic Clock), MASTER_SLAVE_MODE=1 (TC type 0 : NA, 1 : Master, 2 : Slave), OW_NUM=2 (Number of Output Waveforms), INSTANCE_ID=76 (Instance index for TC0)
TC1 at 0x42003400 (TC)
  pins: WO0 PA24/E or PB10/E; WO1 PA25/E or PB11/E
  parameters: CC_NUM=2, DMAC_ID_MC_0=31 (Indexes of DMA Match/Compare triggers 0), DMAC_ID_MC_1=32 (Indexes of DMA Match/Compare triggers 1), DMAC_ID_OVF=30 (Indexes of DMA Overflow trigger), EXT=0 (Coding of implemented extended features (keep 0 value)), GCLK_ID=30 (Index of Generic Clock), MASTER_SLAVE_MODE=2 (TC type 0 : NA, 1 : Master, 2 : Slave), OW_NUM=2 (Number of Output Waveforms), INSTANCE_ID=77 (Instance index for TC1)
TC2 at 0x42003800 (TC)
  pins: WO0 PB02/E; WO1 PB03/E
  parameters: CC_NUM=2, DMAC_ID_MC_0=34 (Indexes of DMA Match/Compare triggers 0), DMAC_ID_MC_1=35 (Indexes of DMA Match/Compare triggers 1), DMAC_ID_OVF=33 (Indexes of DMA Overflow trigger), EXT=0 (Coding of implemented extended features (keep 0 value)), GCLK_ID=31 (Index of Generic Clock), MASTER_SLAVE_MODE=1 (TC type 0 : NA, 1 : Master, 2 : Slave), OW_NUM=2 (Number of Output Waveforms), INSTANCE_ID=78 (Instance index for TC2)
TC3 at 0x42003C00 (TC)
  pins: WO0 PA20/E or PB22/E; WO1 PA21/E or PB23/E
  parameters: CC_NUM=2, DMAC_ID_MC_0=37 (Indexes of DMA Match/Compare triggers 0), DMAC_ID_MC_1=38 (Indexes of DMA Match/Compare triggers 1), DMAC_ID_OVF=36 (Indexes of DMA Overflow trigger), EXT=0 (Coding of implemented extended features (keep 0 value)), GCLK_ID=31 (Index of Generic Clock), MASTER_SLAVE_MODE=2 (TC type 0 : NA, 1 : Master, 2 : Slave), OW_NUM=2 (Number of Output Waveforms), INSTANCE_ID=79 (Instance index for TC3)
TC4 at 0x42004000 (TC)
  pins: WO0 PA18/E or PA14/E; WO1 PA19/E or PA15/E
  parameters: CC_NUM=2, DMAC_ID_MC_0=40 (Indexes of DMA Match/Compare triggers 0), DMAC_ID_MC_1=41 (Indexes of DMA Match/Compare triggers 1), DMAC_ID_OVF=39 (Indexes of DMA Overflow trigger), EXT=0 (Coding of implemented extended features (keep 0 value)), GCLK_ID=32 (Index of Generic Clock), MASTER_SLAVE_MODE=0 (TC type 0 : NA, 1 : Master, 2 : Slave), OW_NUM=2 (Number of Output Waveforms), INSTANCE_ID=80 (Instance index for TC4)
WDT at 0x40002000
  parameters: INSTANCE_ID=8 (Instance index for WDT)

## Interrupts
-15 Reset — Reset Vector, invoked on Power up and warm reset
-14 NonMaskableInt — Non maskable Interrupt, cannot be stopped or preempted
-13 HardFault — Hard Fault, all classes of Fault
-5 SVCall — System Service Call via SVC instruction
-2 PendSV — Pendable request for system service
-1 SysTick — System Tick Timer
0 SYSTEM (MCLK OSCCTRL OSC32KCTRL PAC PM SUPC) — System peripherals shared interrupt
1 WDT — Watchdog Timer
2 RTC — Real Time Counter
3 EIC — External Interrupt Controller
4 FREQM — Frequency Meter
6 NVMCTRL — Non-Volatile Memory Controller
7 DMAC — Direct Memory Access Controller
8 EVSYS — Event Systems
9 SERCOM0 — Serial Communication Interface 0
10 SERCOM1 — Serial Communication Interface 1
11 SERCOM2 — Serial Communication Interface 2
12 SERCOM3 — Serial Communication Interface 3
15 CAN0 — Control Area Network 0
20 TC0 — Timer/Counter 0
21 TC1 — Timer/Counter 1
22 TC2 — Timer/Counter 2
23 TC3 — Timer/Counter 3
24 TC4 — Timer/Counter 4
25 ADC0 — Analog-to-Digital Converter 0
27 AC — Analog Comparators

## Event generators
1 RTC_PERD, 3 OSCCTRL_XOSC_FAIL, 4 OSC32KCTRL_XOSC32K_FAIL, 5 RTC_CMP_0, 6 RTC_CMP_1, 7 RTC_OVF, {n+8} RTC_PER_{n} (n=0..7), {n+16} EIC_EXTINT_{n} (n=0..15), {n+32} DMAC_CH_{n} (n=0..3), {3n+53} TC{n}_OVF (n=0..4), {3n+54} TC{n}_MC_0 (n=0..4), {3n+55} TC{n}_MC_1 (n=0..4), 68 ADC0_RESRDY, 69 ADC0_WINMON, 72 AC_COMP_0, 73 AC_COMP_1, 76 AC_WIN_0, 85 PAC_ACCERR

## Event users
{n+1} PORT_EV_{n} (n=0..3), {n+5} DMAC_CH_{n} (n=0..3), {n+23} TC{n}_EVU (n=0..4), 28 ADC0_START, 29 ADC0_SYNC, 32 AC_SOC_0, 33 AC_SOC_1, 43 MTB_START, 44 MTB_STOP

## Properties
SIGNATURES: DSU_DID=0x1106100A

## Pinouts (pin number, pad)
CMJH48: 1 PA00, 2 PA01, 3 PA02, 4 PA03, 5 AVSS, 6 AVDD, 7 PB08, 8 PB09, 9 PA04, 10 PA05, 11 PA06, 12 PA07, 13 PA08, 14 PA09, 15 PA10, 16 PA11, 17 VDDIO, 18 GND, 19 PB10, 20 PB11, 21 PA12, 22 PA13, 23 PA14, 24 PA15, 25 PA16, 26 PA17, 27 PA18, 28 PA19, 29 PA20, 30 PA21, 31 PA22, 32 PA23, 33 PA24, 34 PA25, 35 GND, 36 VDDIO, 37 PB22, 38 PB23, 39 PA27, 40 RESET_N, 41 PA28, 42 GND, 43 VDDCORE, 44 VDDIN, 45 PA30, 46 PA31, 47 PB02, 48 PB03

## Notices in the file
Copyright (c) 2023 Microchip Technology Inc.
SPDX-License-Identifier: Apache-2.0
Licensed under the Apache License, Version 2.0 (the "License");
you may not use this file except in compliance with the License.
You may obtain a copy of the License at
http://www.apache.org/licenses/LICENSE-2.0
Unless required by applicable law or agreed to in writing, software
distributed under the License is distributed on an "AS IS" BASIS,
WITHOUT WARRANTIES OR CONDITIONS OF ANY KIND, either express or implied.
See the License for the specific language governing permissions and
limitations under the License.
