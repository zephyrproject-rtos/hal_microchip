# PIC32CZ8110CA80144 device description
Architecture: CORTEX-M7; Family: PIC32C; Series: PIC32CZCA80

## Peripheral instances (address, pins/pin function, parameters)
AC at 0x46822000
  pins: AIN0 PB01/B; AIN1 PB00/B; AIN2 PA20/B; AIN3 PA19/B; CMP0 PC07/B; CMP1 PC06/B
  parameters: ATEST_IMPLEMENTED=1 (Defines if the ATEST register is implemented), ATEST_SIZE=2 (Defines the number of effective bits in ATEST register), DACVALUE_BIT=7 (Defines the number of bits in DACCTRLn.VALUE), GCLK_ID=42 (Index of Generic Clock), IO_INPUTS=4 (Defines the number of AC pair inputs connected to IO pins), PAIRS=1 (Defines the number of AC pairs), INSTANCE_ID=44 (Instance index for AC), MCLK_ID_APB=52 (Index for AC APB clock), PAC_ID=44 (Index for AC registers write protection), NUM_CMP=2 (Number of comparators), LOAD_CALIB=0 (Defines if calibration is required)
ADC0 at 0x46820000 (ADC)
  pins: AIN0 PB03/B; AIN1 PB02/B; AIN2 PB01/B; AIN3 PB00/B; AIN4 PA20/B; AIN5 PA19/B; AIN6 PB18/B; AIN7 PB19/B; AIN8 PB20/B
  parameters: APB_FIFO_DEPTH=16 (Number of Words in APB FIFO), CHNSAR_NMBR1=16 (Number of Channels on SARCORE number 1), CHNSAR_NMBR2=7 (Number of Channels on SARCORE number 2), CHNSAR_NMBR3=7 (Number of Channels on SARCORE number 3), CHNSAR_NMBR4=7 (Number of Channels on SARCORE number 4), DCMP_NMBR=4 (Number of Digital Comparators Max=4), DMAC_ID_PFFRDY=75, EARLY_INTR_PRESENT=1 (Early Interrupts Present), FLTR_NMBR=4 (Number of Digital Filters, Max=0), GCLK_ID=41 (Index of Generic Clock), OCP_ADDR_WIDTH=16 (OCP Address Width), OCP_FIFO_DEPTH=16 (Number of Words in OCP DMA FIFO), OCP_PORT_PRESENT=0 (OCP DMA Bus Master Present), SARCORE_NMBR=4 (Number of SARCOREs. Max=4, Min-1), TRGS_NMBR=16 (Number of Trigger Sources, Max=16), VREF_STARTUP_TIME=50 (Number of Control Clock cycles for VREF to stabalize), INSTANCE_ID=43 (Instance index for ADC), MCLK_ID_APB=51 (Index for ADC APB clock), PAC_ID=43 (Index for ADC registers write protection)
ADC1 at 0x46820000 (ADC)
  pins: AIN0 PA18/B; AIN1 PA17/B; AIN2 PA16/B; AIN3 PA15/B; AIN4 PA29/B; AIN5 PA28/B
  parameters: APB_FIFO_DEPTH=16 (Number of Words in APB FIFO), CHNSAR_NMBR1=16 (Number of Channels on SARCORE number 1), CHNSAR_NMBR2=7 (Number of Channels on SARCORE number 2), CHNSAR_NMBR3=7 (Number of Channels on SARCORE number 3), CHNSAR_NMBR4=7 (Number of Channels on SARCORE number 4), DCMP_NMBR=4 (Number of Digital Comparators Max=4), DMAC_ID_PFFRDY=75, EARLY_INTR_PRESENT=1 (Early Interrupts Present), FLTR_NMBR=4 (Number of Digital Filters, Max=0), GCLK_ID=41 (Index of Generic Clock), OCP_ADDR_WIDTH=16 (OCP Address Width), OCP_FIFO_DEPTH=16 (Number of Words in OCP DMA FIFO), OCP_PORT_PRESENT=0 (OCP DMA Bus Master Present), SARCORE_NMBR=4 (Number of SARCOREs. Max=4, Min-1), TRGS_NMBR=16 (Number of Trigger Sources, Max=16), VREF_STARTUP_TIME=50 (Number of Control Clock cycles for VREF to stabalize), INSTANCE_ID=43 (Instance index for ADC), MCLK_ID_APB=51 (Index for ADC APB clock), PAC_ID=43 (Index for ADC registers write protection)
ADC2 at 0x46820000 (ADC)
  pins: AIN0 PA14/B; AIN1 PA13/B; AIN2 PA12/B; AIN3 PA11/B; AIN4 PA27/B; AIN5 PA26/B
  parameters: APB_FIFO_DEPTH=16 (Number of Words in APB FIFO), CHNSAR_NMBR1=16 (Number of Channels on SARCORE number 1), CHNSAR_NMBR2=7 (Number of Channels on SARCORE number 2), CHNSAR_NMBR3=7 (Number of Channels on SARCORE number 3), CHNSAR_NMBR4=7 (Number of Channels on SARCORE number 4), DCMP_NMBR=4 (Number of Digital Comparators Max=4), DMAC_ID_PFFRDY=75, EARLY_INTR_PRESENT=1 (Early Interrupts Present), FLTR_NMBR=4 (Number of Digital Filters, Max=0), GCLK_ID=41 (Index of Generic Clock), OCP_ADDR_WIDTH=16 (OCP Address Width), OCP_FIFO_DEPTH=16 (Number of Words in OCP DMA FIFO), OCP_PORT_PRESENT=0 (OCP DMA Bus Master Present), SARCORE_NMBR=4 (Number of SARCOREs. Max=4, Min-1), TRGS_NMBR=16 (Number of Trigger Sources, Max=16), VREF_STARTUP_TIME=50 (Number of Control Clock cycles for VREF to stabalize), INSTANCE_ID=43 (Instance index for ADC), MCLK_ID_APB=51 (Index for ADC APB clock), PAC_ID=43 (Index for ADC registers write protection)
ADC3 at 0x46820000 (ADC)
  pins: AIN0 PA10/B; AIN1 PA09/B; AIN2 PA08/B; AIN3 PA07/B; AIN4 PA25/B; AIN5 PA24/B
  parameters: APB_FIFO_DEPTH=16 (Number of Words in APB FIFO), CHNSAR_NMBR1=16 (Number of Channels on SARCORE number 1), CHNSAR_NMBR2=7 (Number of Channels on SARCORE number 2), CHNSAR_NMBR3=7 (Number of Channels on SARCORE number 3), CHNSAR_NMBR4=7 (Number of Channels on SARCORE number 4), DCMP_NMBR=4 (Number of Digital Comparators Max=4), DMAC_ID_PFFRDY=75, EARLY_INTR_PRESENT=1 (Early Interrupts Present), FLTR_NMBR=4 (Number of Digital Filters, Max=0), GCLK_ID=41 (Index of Generic Clock), OCP_ADDR_WIDTH=16 (OCP Address Width), OCP_FIFO_DEPTH=16 (Number of Words in OCP DMA FIFO), OCP_PORT_PRESENT=0 (OCP DMA Bus Master Present), SARCORE_NMBR=4 (Number of SARCOREs. Max=4, Min-1), TRGS_NMBR=16 (Number of Trigger Sources, Max=16), VREF_STARTUP_TIME=50 (Number of Control Clock cycles for VREF to stabalize), INSTANCE_ID=43 (Instance index for ADC), MCLK_ID_APB=51 (Index for ADC APB clock), PAC_ID=43 (Index for ADC registers write protection)
BSDAP
  pins: TCK_SWCLK PC20/G set 1; TDI PC17/G set 1; TDO PC19/G set 1; TMS_SWDIO PC18/G set 1
  parameters: MCLK_ID_DAP=80 (Index for BSDAP DAP clock)
CAN0 at 0x45060000 (CAN)
  pins: RX PC04/H set 1 or PC19/H set 2; TX PC05/H set 1 or PC20/H set 2
  parameters: DMAC_ID_DEBUG=83 (DMA CAN Debug Req), ECC_BERR_IMPLEMENTED=0 (ECC error), EXT_TSTAMP_IMPLEMENTED=0 (External time stamp), GCLK_ID=46 (Index of Generic Clock), MSG_RAM_ADDR=0x20 (8-bits MSB), RXD_SYNC_METHOD=0 (RXD Synchronization Method), INSTANCE_ID=48 (Instance index for CAN0), MCLK_ID_AHB=56 (Index for CAN0 AHB clock), PAC_ID=48 (Index for CAN0 registers write protection)
CAN1 at 0x46060000 (CAN)
  pins: RX PC06/H set 1 or PD08/H set 2; TX PC07/H set 1 or PD09/H set 2
  parameters: DMAC_ID_DEBUG=84 (DMA CAN Debug Req), ECC_BERR_IMPLEMENTED=0 (ECC error), EXT_TSTAMP_IMPLEMENTED=0 (External time stamp), GCLK_ID=47 (Index of Generic Clock), MSG_RAM_ADDR=0x20 (8-bits MSB), RXD_SYNC_METHOD=0 (RXD Synchronization Method), INSTANCE_ID=49 (Instance index for CAN1), MCLK_ID_AHB=57 (Index for CAN1 AHB clock), PAC_ID=49 (Index for CAN1 registers write protection)
CAN2 at 0x46062000 (CAN)
  pins: RX PC25/H; TX PC26/H
  parameters: DMAC_ID_DEBUG=85 (DMA CAN Debug Req), ECC_BERR_IMPLEMENTED=0 (ECC error), EXT_TSTAMP_IMPLEMENTED=0 (External time stamp), GCLK_ID=48 (Index of Generic Clock), MSG_RAM_ADDR=0x20 (8-bits MSB), RXD_SYNC_METHOD=0 (RXD Synchronization Method), INSTANCE_ID=50 (Instance index for CAN2), MCLK_ID_AHB=58 (Index for CAN2 AHB clock), PAC_ID=50 (Index for CAN2 registers write protection)
CAN3 at 0x45860000 (CAN)
  pins: RX PC29/H; TX PD13/H
  parameters: DMAC_ID_DEBUG=86 (DMA CAN Debug Req), ECC_BERR_IMPLEMENTED=0 (ECC error), EXT_TSTAMP_IMPLEMENTED=0 (External time stamp), GCLK_ID=49 (Index of Generic Clock), MSG_RAM_ADDR=0x20 (8-bits MSB), RXD_SYNC_METHOD=0 (RXD Synchronization Method), INSTANCE_ID=51 (Instance index for CAN3), MCLK_ID_AHB=59 (Index for CAN3 AHB clock), PAC_ID=51 (Index for CAN3 registers write protection)
CoreDebug at 0xE000ED00
DMA at 0x44850000
  parameters: DMAC_ID_EVSYS=1 (Events trigger index), DMAC_ID_SWTRG=0 (Software trigger index), INSTANCE_ID=19 (Instance index for DMA), MCLK_ID_APB=25 (Index for DMA APB clock), MCLK_ID_AXI=24 (Index for DMA AXI clock), PAC_ID=19 (Index for DMA registers write protection)
DRMTCM at 0x44820000
  parameters: DPTRMSB=5, DTCMADDR_MSB=16, DTCMPAR=7, IPTRMSB=6, ITCMADDR_MSB=16, ITCMPAR=8, NO_ECC=0, INSTANCE_ID=15 (Instance index for DRMTCM), MCLK_ID_APB=19 (Index for DRMTCM APB clock), PAC_ID=15 (Index for DRMTCM registers write protection)
DSU at 0x44000000
  pins: PMSA0 PA14/dsu_pmsa0; PMSA1 PA12/dsu_pmsa0; PMSA2 PA11/dsu_pmsa0; PMSA3 PA09/dsu_pmsa0; PMSA4 PA07/dsu_pmsa0; PMSA5 PA06/dsu_pmsa0; PMSA6 PA04/dsu_pmsa0; PMSA7 PA02/dsu_pmsa0
  parameters: BMX_ERROR_SUPPORT=1 (Defines whether DSU APB errors are reported as 2-cycles bus errors to the AHB AP0 master), DAL1_IMPLEMENTED=0 (Debug Access Level 1 (Non-Secure) Implemented? for TZ devices only), DMAC_ID_DCC0=2 (DMAC ID for DCC0 register), DMAC_ID_DCC1=3 (DMAC ID for DCC1 register), INSTANCE_ID=0 (Instance index for DSU), MCLK_ID_AHB=0 (Index for DSU AHB clock), MCLK_ID_APB=1 (Index for DSU APB clock), PAC_ID=0 (Index for DSU registers write protection)
DWT at 0xE0001000
EIC at 0x44800000
  pins: EXTINT0 PA00/A or PA16/A or PB00/A or PB16/A or PC00/A or PD00/A or PD15/A; EXTINT1 PA01/A or PA17/A or PB01/A or PB17/A or PC01/A or PC02/A or PC17/A or PD01/A or PD16/A; EXTINT2 PA02/A or PA18/A or PB02/A or PB18/A or PC18/A or PD02/A or PD17/A; EXTINT3 PA03/A or PA19/A or PB03/A or PB19/A or PC03/A or PC19/A or PD03/A or PD18/A; EXTINT4 PA04/A or PA05/A or PA20/A or PB04/A or PB20/A or PC04/A or PD04/A or PD19/A; EXTINT5 PA21/A or PB05/A or PB21/A or PC05/A or PC21/A or PD05/A or PD20/A; EXTINT6 PA06/A or PA22/A or PB06/A or PB22/A or PC06/A or PC22/A or PD06/A or PD21/A; EXTINT7 PA07/A or PA23/A or PB07/A or PB23/A or PC07/A or PC23/A or PD07/A; EXTINT8 PA08/A or PA24/A or PB08/A or PB24/A or PC08/A or PC24/A or PD08/A; EXTINT9 PA09/A or PA25/A or PB09/A or PB25/A or PC09/A or PC25/A or PD09/A; EXTINT10 PA10/A or PA26/A or PB10/A or PB26/A or PC10/A or PC26/A or PD10/A; EXTINT11 PA11/A or PA27/A or PB11/A or PC11/A or PC27/A or PD11/A; EXTINT12 PA12/A or PA28/A or PB12/A or PC12/A or PC28/A or PD12/A; EXTINT13 PA13/A or PA29/A or PB13/A or PC13/A or PC29/A; EXTINT14 PA14/A or PB14/A or PC14/A or PD13/A; EXTINT15 PA15/A or PB15/A or PC15/A or PD14/A; NMI PC20/A
  parameters: EXTINT_NUM=16 (Number of external interrupts), GCLK_ID=5 (Generic Clock index), NUMBER_OF_CONFIG_REGS=2 (Number of CONFIG registers), NUMBER_OF_INTERRUPTS=16 (Number of external interrupts (obsolete)), SECURE_IMPLEMENTED=0 (Security Configuration implemented?), INSTANCE_ID=13 (Instance index for EIC), MCLK_ID_APB=16 (Index for EIC APB clock), PAC_ID=13 (Index for EIC registers write protection)
ETH at 0x45070000
  pins: GCOL PD08/K; GCRS PD09/K; GTXCK PD05/L; GMDC PA03/K; GMDIO PA04/K; GREFCK PD12/K or PD12/L; GRX0 PD11/K; GRX1 PD10/K; GRX2 PD07/K; GRX3 PD06/K; GRX4 PD20/K; GRX5 PD21/K; GRX6 PD19/K; GRX7 PD18/K; GRXDV PA05/K; GRXER PA06/K; TSUCOMP PA22/K or PC05/K or PC17/K; GTX0 PA01/K; GTX1 PA00/K; GTX2 PD04/K; GTX3 PD03/K; GTX4 PD17/K; GTX5 PD16/K; GTX6 PD15/K; GTX7 PD14/K; GTXEN PA02/K; GTXER PD02/K; TXCK PA21/K or PD05/K
  parameters: GCLK_ID_TSU=55 (1588 External Clock), GCLK_ID_TX=54 (GIGE/Loopback clock), MEM_MARGINADJ_MSB=9 (Number of Memory Margin Adjust bits), NUM_INT=6 (Number of Interrupts), INSTANCE_ID=56 (Instance index for ETH), MCLK_ID_AXI=64 (Index for ETH AXI clock), MCLK_ID_APB=65 (Index for ETH APB clock), PAC_ID=56 (Index for ETH registers write protection)
ETM at 0xE0041000
EVSYS at 0x44860000
  parameters: ASYNCHRONOUS_CHANNELS=0xFFFFF000 (Mask of Only Asynchronous Channels), CHANNELS=32 (Total Number of Channels), CHANNELS_BITS=5 (Number of bits to select Channel), GCLK_ID_{n}={n+6} (Index of Generic Clocks for Synchronous Channels {n}) (n=0..11), GENERATORS=138 (Total Number of Event Generators), GENERATORS_BITS=8 (Number of bits to select Event Generator), SECURE_IMPLEMENTED=0 (Security Configuration implemented?), SPLIT_IRQ_NUM=12 (Number of channels with dedicated interrupt line request), SYNCH_NUM=12 (Number of Synchronous Channels), SYNCH_NUM_BITS=4 (Number of bits to select Synchronous Channels), USERS=117 (Total Number of Event Users), USERS_BITS=7 (Number of bits to select Event User), USERS_GROUPS=4 (Number of 32-user Groups), INSTANCE_ID=22 (Instance index for EVSYS), MCLK_ID_APB=30 (Index for EVSYS APB clock), PAC_ID=22 (Index for EVSYS registers write protection)
FCR at 0x44004000
  parameters: BFM_PNL_ADDR_MSB=15 (Flash Memory Parameters), BFM_SYS_ADDR_MSB=16 (Flash Memory Parameters), CFM_ADDR_BASE=0x07000000 (Flash Read Controller Parameters), CFM_PNL_ADDR_MSB=14 (Flash Memory Parameters), CFM_SYS_ADDR_MSB=15 (Flash Memory Parameters), FCR_AHB_PORTS_NB=4 (Flash Read Controller Parameters), FCR_BFM_ADDR_BASE=0x06000000 (Flash Read Controller Parameters), FCR_CAL_ADDR=6000000 (Flash Read Controller Parameters), FCR_CAL_NUM_READS=4 (Flash Read Controller Parameters), FCR_CRC_PRESENT=1 (Flash Read Controller Parameters), FCR_DAL_ADDR=1 (Flash Read Controller Parameters), FCR_ECC_PRESENT=1 (Flash Read Controller Parameters), FCR_FFF_ADDR=1 (Flash Read Controller Parameters), FCR_FLT_PRESENT=0 (Flash Read Controller Parameters), FCR_FUSES_DATA_CYCLES=4 (Flash Read Controller Parameters), FCR_FUSES_READY_CYCLES=1 (Flash Read Controller Parameters), FCR_F1RR_ADDR=1 (Flash Read Controller Parameters), FCR_F2RR_ADDR=1 (Flash Read Controller Parameters), FCR_HDATA_SIZE=64 (Flash Read Controller Parameters), FCR_NOT_FFF_VALUE=0xA5A5A5A5 (Flash Read Controller Parameters), FCR_NO_ECC_BUS_ERROR=0 (Flash Read Controller Parameters), FCR_OTPLOCK_ADDR=0 (Flash Read Controller Parameters), FCR_PADDR_MSB=15 (Flash Read Controller Parameters), FCR_PERIOD_MIN=75 (Flash Read Controller Parameters), FCR_PERIOD_NOM=116 (Flash Read Controller Parameters), FCR_PFM_ADDR_BASE=0x08000000 (Flash Read Controller Parameters), FCR_RR_NUM_READS=1 (Flash Read Controller Parameters), FCR_TCALH_NS=10000 (Flash Read Controller Parameters), FUSES_DATA_MSB=127 (Flash Read Controller Parameters), FUSES_RDY_MSB=8 (Flash Read Controller Parameters), NVR_NUM_PAGES=24 (Flash Memory Parameters), PFM_ACC_HT_NS=30 (Flash Read Controller Parameters), PFM_ACC_NS=25 (Flash Read Controller Parameters), PFM_ACC_RECALL_NS=70 (Flash Read Controller Parameters), PFM_DATA_MSB=255 (Flash Memory Parameters), PFM_NUM_PANELS=2 (Flash Memory Parameters), PFM_NUM_RR=8 (Flash Memory Parameters), PFM_PAGE_ADDR_MSB=11 (Flash Memory Parameters), PFM_PNL_ADDR_MSB=21 (Flash Memory Parameters), PFM_PNL_DATA_MSB=271 (Flash Memory Parameters), PFM_ROW_ADDR_MSB=9 (Flash Memory Parameters), PFM_SRHT_PRESENT=1 (Flash Read Controller Parameters), PFM_SYS_ADDR_MSB=22 (Flash Memory Parameters), PFM_TDPDH_NS=5000 (Flash Read Controller Parameters), PFM_TDPDS_NS=100 (Flash Read Controller Parameters), PFM_TLKCFG_NS=1000 (Flash Read Controller Parameters), PFM_TMH_NS=100 (Flash Read Controller Parameters), PFM_TMS_NS=5000 (Flash Read Controller Parameters), PFM_TONWAIT_NS=6000 (Flash Read Controller Parameters), PFM_TRHR_NS=1000 (Flash Read Controller Parameters), PFM_TRT_NS=500 (Flash Read Controller Parameters), INSTANCE_ID=2 (Instance index for FCR), MCLK_ID_AHB=4 (Index for FCR AHB clock), MCLK_ID_APB=5 (Index for FCR APB clock), PAC_ID=2 (Index for FCR registers write protection)
FCW at 0x44002000
  parameters: BFM_PNL_ADDR_MSB=15 (Flash Memory Parameters), BFM_SYS_ADDR_MSB=16 (Flash Memory Parameters), CFM_PNL_ADDR_MSB=14 (Flash Memory Parameters), CFM_SYS_ADDR_MSB=15 (Flash Memory Parameters), FCW_BFM_ADDR_BASE=0x06000000 (Flash System Address (byte addresses)), FCW_CFM_ADDR_BASE=0x07000000 (Flash System Address (byte addresses)), FCW_CPUS_PRESENT=3 (Flash System Address (byte addresses)), FCW_DAL0_VALUE=0x81 (Flash System Address (byte addresses)), FCW_DAL1_VALUE=0x99 (Flash System Address (byte addresses)), FCW_DAL2_VALUE=0xDB (Flash System Address (byte addresses)), FCW_PADDR_MSB=10 (Flash System Address (byte addresses)), FCW_PERIOD_MIN=75 (Flash System Address (byte addresses)), FCW_PERIOD_NOM=116 (Flash System Address (byte addresses)), FCW_PFM_ADDR_BASE=0x08000000 (Flash System Address (byte addresses)), PFM_NUM_PAGES=1024 (No of PFM Pages Per panel), PFM_NUM_RR=8 (Flash Memory Parameters), PFM_PAGE_ADDR_MSB=11 (Flash Page Size MSB), PFM_PAGE_SIZE=4096, PFM_PNL_ADDR_MSB=21 (Single flash panel read address MSbit (using byte addressing)), PFM_PNL_DATA_MSB=271 (Flash Memory Parameters), PFM_ROW_ADDR_MSB=9 (Flash Memory Parameters), PFM_SIZE=10 (Flash Memory Parameters), PFM_SYS_ADDR_MSB=22 (The MS bit of the system byte address needed to address the entire PFM region (both panels Main)), FLASH_SIZE=8388608, PAGES=2048, PAGES_PR_REGION=128, INSTANCE_ID=1 (Instance index for FCW), MCLK_ID_AHB=2 (Index for FCW AHB clock), MCLK_ID_APB=3 (Index for FCW APB clock), PAC_ID=1 (Index for FCW registers write protection)
FPB at 0xE0002000
  parameters: __BKPT_NUM=8 (Number of FPB breakpoint comparators)
FPU at 0xE000EF30
  parameters: __FPU_DP=1 (FPU double precision or not)
FREQM at 0x44060000
  parameters: GCLK_ID_MSR=3 (Index of measure generic clock), GCLK_ID_REF=4 (Index of reference generic clock), MSRCLK_NB=2 (Number of measured clock sources), INSTANCE_ID=10 (Instance index for FREQM), MCLK_ID_APB=13 (Index for FREQM APB clock), PAC_ID=10 (Index for FREQM registers write protection)
FUSES at FUSES_BOOTCFG1 0x0A002000, FUSES_BOOTCFG2 0x0A00A000 (FUSES_BOOTCFG1), FUSES_CALOTP 0x0A007000, FUSES_DALCFG 0x0A004000, FUSES_USERCFG1 0x0A000000, FUSES_USERCFG2 0x0A008000 (FUSES_USERCFG1)
GCLK at 0x44050000
  pins: IO0 PC20/M; IO1 PC19/M; IO2 PD00/M; IO3 PD01/M; IO4 PC00/M or PD18/M; IO5 PC01/M or PD19/M; IO6 PC02/M or PD20/M; IO7 PC03/M or PD21/M
  parameters: GEN_BITS=4, GEN_NUM=16 (Number of Generic Clock Generators), GEN_NUM_MSB=15 (Number of Generic Clock Generators - 1), GEN_SOURCE_NUM_MSB=13 (Number of Generic Clock Sources - 1), IO_NUM=8 (Number of Generic Clock I/Os), NUM=64 (Number of Generic Clock Users), SOURCE_BITS=4, SOURCE_NUM=14 (Number of Generic Clock Sources), INSTANCE_ID=8 (Instance index for GCLK), MCLK_ID_APB=11 (Index for GCLK APB clock), PAC_ID=8 (Index for GCLK registers write protection)
ITM at 0xE0041000
MCLK at 0x44052000
  parameters: DIV_CLK_NUM=2, INSTANCE_ID=9 (Instance index for MCLK), MCLK_ID_APB=12 (Index for MCLK APB clock), PAC_ID=9 (Index for MCLK registers write protection)
MCRAMC at 0x44822000
  parameters: AHB_CLOCK_ENABLE=1 (MCRAMC CLOCK GATER), AHB_ECC=1 (ECC LOGIC), AHB_PORTS_NB=1 (NUMBER OF AHB PORTS), AHB_READ_PREBUFFERING=1, AHB_REQUEST_ISOLATION_REGISTER=1 (AHB REQUEST TIMING PATHS ISOLATION), ARBITRATION_TYPE=2 (ARBITRATION SCHEME, FIXED_PRIORITY = 0, HIGHLIGHT = 1, HOPSCOTCH = 2), BIT_STROBE_RAM=0 (Set this parameter to TRUE if the ram_wem_bundle outputs are connected to ram bit-strobe write masks), CHANNELS_NB=1 (NUMBER OF RAM CHANNELS), ECC_SYNDROM_REGISTER=1 (ECC TIMING PATH BALANCING), HADDR_READ_ISOLATION_REGISTER=0 (Set to IMPLEMENTED to add 1 wait-state max (0 min) per memory new line read access for each of the AHB timing path isolations), HRDATA_ISOLATION_REGISTER=1 (AHB REQUEST TIMING PATHS ISOLATION), MCRAMC_CLK_GATER=1 (MCRAMC CLOCK GATER), MCRAMC_PADDR_SIZE=8 (APB USER INTERFACE), MEMORY_AUTO_CORRECTION=1 (Perform an automatic write-back of the corrected ram word after read), MEMORY_ENABLE_POLARITY=0 (POSITIVE if Memory is selected when ram_me is 1'b1), MW_CLOCK_ENABLE=0 (MCRAMC CLOCK GATER), MW_DATA_SIZE=32 (MW DATA BUS SIZE), MW_PORT_SLICES_NB=0 (NUMBER OF PORT SLICES FOR THE WAITED SRAM INTERFACE), M0_CLOCK_ENABLE=0 (MCRAMC CLOCK GATER), M0_DATA_SIZE=32 (M0 DATA BUS SIZE), M0_HYBRID_READ_WRITE_ACCESS=0 (M0 HYBRID SIMULTANEOUS READ + WRITE ACCESS), M0_PORT_SLICES_NB=0 (NUMBER OF PORT SLICES FOR THE 0 WS SRAM INTERFACE), RAM_ADD_SIZE=14 (NUMBER OF ADDRESS BITS FOR ONE CHANNEL RAM CELL), RAM_AHB_ADDRESS_OFFSET=0 (RAM BLOCK AHB ADDRESS OFFSET), STORE_BYTE_STROBE=0 (AHB byte strobes can be stored and read back through the M0 interface), ULTRA=1 (ULTRA USER INTERFACE), WRITE_ENABLE_POLARITY=0 (POSITIVE if Memory is written when ram_we is 1'b1), WRITE_ENABLE_USED=0 (TRUE if the Memory makes use of a global per channel ram_we write enable), WRITE_MASK_POLARITY=0 (POSITIVE if Memory is written when ram_wem is 1'b1), INSTANCE_ID=16 (Instance index for MCRAMC), MCLK_ID_APB=20 (Index for MCRAMC APB clock), PAC_ID=16 (Index for MCRAMC registers write protection)
MLB at 0x458C0000
  pins: MLBC PD07/G; MLBD PD09/G; MLBS PD08/G
  parameters: GCLK_ID=62 (Index of Generic Clock), MLB_MEM_MARGINADJ_MSB=4 (MBIST input margin adjustment control), INSTANCE_ID=66 (Instance index for MLB), MCLK_ID_AHB=78 (Index for MLB AHB clock), MCLK_ID_APB=79 (Index for MLB APB clock), PAC_ID=66 (Index for MLB registers write protection)
MPU at 0xE000ED90
  parameters: __MPU_REGIONS=8 (Number of MPU regions)
NVIC at 0xE000E000
  parameters: NUM_IRQ=222 (Number of interrupt requests), __NVIC_PRIO_BITS=3 (Number of NVIC interrupt priority bits)
OSC32KCTRL at 0x44042000
  pins: XIN32 PB05/XIN32; XOUT32 PB04/XOUT32
  parameters: INSTANCE_ID=7 (Instance index for OSC32KCTRL), MCLK_ID_APB=10 (Index for OSC32KCTRL APB clock), PAC_ID=7 (Index for OSC32KCTRL registers write protection)
OSCCTRL at 0x44040000
  pins: XIN PD01/XIN0; XOUT PD00/XOUT0
  parameters: DFLL48M_ATEST_IMPLEMENTED=1 (DFLL48M ATEST register implemented), DFLL48M_ATEST_SIZE=8 (number of effective bits in DFLL48M ATEST register), DFLL48M_IS_STARTUP_OSCILLATOR=1, DFLL48M_RC48MCAL0_PORVAL=0x0 (Defines the RC48MCAL0 register reset value after POR.), DIV_8MHZ_NUM=8, FRACDIVS_NUM=2 (Number of FRACDIVs), FRACDIV_DIVIDER_RESET_VAL=32 (Fracdiv Divider reset value), FRACDIV_PLLSRC=1 (Indice of the PLL that is source of the FRACDIV), GCLK_ID_DFLL48M=0 (Index of Generic Clock for DFLL48), GCLK_ID_PLL_0=1 (Index of Generic Clock for PLL 0), GCLK_ID_PLL_1=2 (Index of Generic Clock for PLL 1), PLLS_NUM=2 (Number of PLLs), PLL0_OUTPUTS_NUM=4 (number of clock outputs for PLL0), PLL1_OUTPUTS_NUM=4 (number of clock outputs for PLL1), USBHS_NUM=2 (Number of usbhs clock requests), XOSC_ATEST_IMPLEMENTED=1 (XOSC ATEST register implemented), XOSC_ATEST_SIZE=4 (number of effective bits in XOSC ATEST register), XOSC_CFD_CLK_SELECT_SIZE=4 (Clock fail prescaler size), XOSC_CFD_HAS_RETENTION=0 (Clock fail detected for xosc is in tetention domain), INSTANCE_ID=6 (Instance index for OSCCTRL), MCLK_ID_APB=9 (Index for OSCCTRL APB clock), PAC_ID=6 (Index for OSCCTRL registers write protection)
PAC at 0x44810000
  parameters: HMATRIX1_IMPLEMENTED=0, HPB_NUM=3 (Number of bridges AHB/APB), SECURE_IMPLEMENTED=0 (Security Configuration implemented?), INSTANCE_ID=14 (Instance index for PAC), MCLK_ID_AHB=17 (Index for PAC AHB clock), MCLK_ID_APB=18 (Index for PAC APB clock), PAC_ID=14 (Index for PAC registers write protection)
PM at 0x44010000
  pins: RESET_N RESET_N
  parameters: BACKUP_IMPLEMENTED=1 (Backup domain is implemented), PD_NUM=0 (Number of switchable Power Domains), INSTANCE_ID=3 (Instance index for PM), MCLK_ID_APB=6 (Index for PM APB clock), PAC_ID=3 (Index for PM registers write protection)
PORT at PORT_AHB 0x40000000, 0x44840000
  pins: P{n} PA{n:02} (n=0..29); P{n} PB{n-32:02} (n=32..58); P{n} PC{n-64:02} (n=64..79); P{n} PC{n-64} (n=81..93); P{n} PD{n-96:02} (n=96..117)
  parameters: AHB_IMPLEMENTED=1, BITS=204, DRVSTR=0 (Number of DRVSTR bits (0/1/2)), EV_NUM=4, GROUPS=4, HADDR_MSB=25 (AHB bus address MSB), IOBUS_IMPLEMENTED=0, MSB=203, ODRAIN=1 (ODRAIN supported?), PPP_IMPLEMENTED=0 (IOBUS2 implemented?), SECURE_IMPLEMENTED=0 (Secure I/Os supported?), SLEWLIM=2 (Number of SLEWLIM bits (0/1/2)), INSTANCE_ID=18 (Instance index for PORT), MCLK_ID_AHB=22 (Index for PORT AHB clock), MCLK_ID_APB=23 (Index for PORT APB clock), PAC_ID=18 (Index for PORT registers write protection)
PRM at 0x44080000
  parameters: PRMWS_DEFAULT=0 (Default value of PRMWS register field), ROM_KEN=0 (Value driven on to ROM's KEN input), ROM_SPLIT=0x0e00 (Address defining first restricted address), INSTANCE_ID=21 (Instance index for PRM), MCLK_ID_AHB=28 (Index for PRM AHB clock), MCLK_ID_APB=29 (Index for PRM APB clock), PAC_ID=21 (Index for PRM registers write protection)
PTC at 0x46828000
  pins: DRV0 PB17/P; DRV1 PB16/P; DRV2 PB15/P; DRV3 PB14/P; DRV4 PB13/P; DRV5 PB12/P; DRV6 PB11/P; DRV7 PB10/P; DRV8 PB09/P; DRV9 PB08/P; DRV10 PB07/P; DRV11 PB06/P; DRV12 PB26/P; DRV13 PB25/P; DRV14 PB24/P; DRV15 PB23/P; DRV16 PB22/P; DRV17 PB21/P; ECI0 PC02/P; ECI1 PC03/P
  parameters: DMAC_ID_EOC=78 (Index of DMA EOC trigger), DMAC_ID_SEQ=76 (Index of DMA SEQ trigger), DMAC_ID_WCOMP=77 (Index of DMA WCOMP trigger), GCLK_ID=43 (Index of Generic Clock), LINES_NUM=32 (Number of PTC lines), INSTANCE_ID=45 (Instance index for PTC), MCLK_ID_APB=53 (Index for PTC APB clock), PAC_ID=45 (Index for PTC registers write protection)
RSTC at 0x44030000
  parameters: BACKUP_IMPLEMENTED=1, CM_DBGRESET_STRETCHED=12 (Reset stretcher size for Cortex CPU related to DBGRESET.), CM_HRESET_N_STRETCHED=12 (Reset stretcher size for Cortex CPU related to HRESETn.), CM_PORESET_STRETCHED=12 (Reset stretcher size for Cortex CPU related to PORESET.), HIB_IMPLEMENTED=1, VBAT_IMPLEMENTED=0 (One if VBAT (Battery backup mode) is supported), INSTANCE_ID=5 (Instance index for RSTC), MCLK_ID_APB=8 (Index for RSTC APB clock), PAC_ID=5 (Index for RSTC registers write protection)
RTC at 0x44072000
  pins: IN0 PB09/RTC_IN; IN1 PB08/RTC_IN; IN2 PB10/RTC_IN; IN3 PB11/RTC_IN; IN4 PB01/RTC_IN; IN5 PB19/RTC_IN; IN6 PB22/RTC_IN; IN7 PB24/RTC_IN; OUT0 PB07/RTC_OUT; OUT1 PB00/RTC_OUT; OUT2 PB02/RTC_OUT; OUT3 PB03/RTC_OUT; OUT4 PB26/RTC_OUT; OUT5 PB18/RTC_OUT; OUT6 PB21/RTC_OUT; OUT7 PB23/RTC_OUT
  parameters: DMAC_ID_TIMESTAMP=4 (DMA RTC timestamp trigger), NUM_OF_ALARMS=2 (Number of Alarms), NUM_OF_BKREGS=0 (Number of Backup Registers), NUM_OF_COMP16=4 (Number of 16-bit Comparators), NUM_OF_TAMPERS=8 (Number of Tamper Inputs), INSTANCE_ID=12 (Instance index for RTC), MCLK_ID_APB=15 (Index for RTC APB clock), PAC_ID=12 (Index for RTC registers write protection)
SDMMC0 at 0x458A0000 (SDMMC)
  pins: SDCD PC15/I set 1; SDCK PC08/I set 1; SDCMD PC13/I set 1; SDDAT0 PC09/I set 1; SDDAT1 PC10/I set 1; SDDAT2 PC11/I set 1; SDDAT3 PC12/I set 1; SDWP PC14/I set 1
  parameters: CARD_DATA_SIZE=4, CLOCK_MULTIPLIER=2 (Multiplier between "sd_mult_src_clock" and "sd_src_clock"), DDR50_SUPPORT=0 (SD - UHS DDR50 Support Implemented), DIVBY2_FOR_SDSRCCLK=1 (Div-by-2 Source Clock is Implemented), DLL_NB_OF_PHASES=16, EIGHT_BITS_BUS_WIDTH=0 (Data Bus Width), GCLK_ID=58, GCLK_ID_SLOW=59, GLOBAL_INTERRUPT=1, HSDDR_SUPPORT=0 (e.MMC - HSDDR Support Implemented), HS200_SUPPORT=0 (e.MMC - HS200 Support Implemented), MAX_BLOCK_LENGTH=512 (Maximum Block Length), MULTIPLE_SLOTS=1 (Multiple Slots Support Enabled), MULT_SRC_CLK_GATED=1 (Internal Clock Gater is Implemented), PROGRAMMABLE_CLK_GENERATOR=1 (Programmabe Clock Generator is Implemented), RETUNING_TIMER=0, RETUNING_TIMER_MAX_VALUE=0 (Retuning Timer Counter Max Value), SDCD_DEBOUNCE_PERIOD=328 (Debounce Period Value), SDR12_SUPPORT=0 (SD - UHS SDR12 Support Implemented), SDR25_SUPPORT=0 (SD - UHS SDR25 Support Implemented), SDR50_SUPPORT=0 (SD - UHS SDR50 Support Implemented), SDR104_SUPPORT=0 (SD - UHS SDR104 Support Implemented), SD_SRC_CLOCK_FREQ=0 (Source Clock Frequency (MHz)), SHARED_BUS=0 (Shared Bus Enabled), SLOT_TYPE=0 (Slot Usage), TIMEOUT_CLK_DIVISION=1 (Division of TIMEOUT CLOCK compared to "sd_src_clock"), TIMEOUT_CLK_FREQ=12 (TIMEOUT CLOCK frequency), TIMEOUT_CLK_FREQ_UNIT=1 (TIMEOUT CLOCK frequency unit (0=KHz , 1=MHz)), TUNING_FOR_SDR50=0 (SDR50 Tuning Support Enabled), USER_DEBOUNCE=0 (User Debouncing), INSTANCE_ID=60 (Instance index for SDMMC0), MCLK_ID_AHB=69 (Index for SDMMC0 AHB clock), MCLK_ID_APB=70 (Index for SDMMC0 APB clock), PAC_ID=60 (Index for SDMMC0 registers write protection)
SERCOM0 at 0x46000000 (SERCOM)
  pins: PAD0 PC00/D; PAD1 PC01/D; PAD2 PC02/D; PAD3 PC03/D
  parameters: CLK_REDUCTION=1 (Reduce clock options to pin 1 for SPI and USART), DMA=1 (DMA support implemented?), DMAC_ID_RX=5 (Index of DMA RX trigger), DMAC_ID_TX=6 (Index of DMA TX trigger), FIFO_IMPLEMENTED=1 (FIFO Rx/Tx implemented?), FIFO_SIZE=16 (Rx-Tx FIFO size in bytes), FSYNC_IMPLEMENTED=1 (SPI Frame Synch mode implemented?), GCLK_ID_CORE=21, GCLK_ID_SLOW=18, SPI=1 (SPI mode implemented?), TWIM=1 (TWI Master mode implemented?), TWIS=1 (TWI Slave mode implemented?), ULTRA_IMPLEMENTATION=0 (ULTRA platform compatibility?), USART=1 (USART mode implemented?), USART_AUTOBAUD=1 (USART autobaud implemented?), USART_IRDA=1 (USART IrDA implemented?), USART_ISO7816=1 (USART ISO7816 mode implemented?), USART_LIN_MASTER=1 (USART LIN Master mode implemented?), USART_RS485=1 (USART RS485 mode implemented?), INSTANCE_ID=23 (Instance index for SERCOM0), MCLK_ID_APB=31 (Index for SERCOM0 APB clock), PAC_ID=23 (Index for SERCOM0 registers write protection), USART_ERROR_INT_SRC=55 (USART/SPI/I2C Error), USART_TX_READY_INT_SRC=57 (USART-SPI Data Register Empty/ I2C Stop Received), USART_TX_COMPLETE_INT_SRC=58 (USART-SPI Transmit Complete/ I2C Address Match), USART_RX_INT_SRC=59 (USART-SPI Receive Complete/ I2C Data Ready), SPI_TX_READY_INT_SRC=57 (USART-SPI Data Register Empty/ I2C Stop Received), SPI_TX_COMPLETE_INT_SRC=58 (USART-SPI Transmit Complete/ I2C Address Match), SPI_RX_INT_SRC=59 (USART-SPI Receive Complete/ I2C Data Ready), I2C_0_INT_SRC=55 (USART/SPI/I2C Error), I2C_1_INT_SRC=59 (USART-SPI Receive Complete/ I2C Data Ready), I2C_2_INT_SRC=60 (USART Receive Start/ SPI Slave Select Low/ I2C TX FIFO Empty), I2C_3_INT_SRC=61 (USART Clear To Send Input Change/ I2C RX FIFO Full)
SERCOM1 at 0x46002000 (SERCOM)
  pins: PAD0 PC04/D set 1 or PC20/D set 2; PAD1 PC05/D set 1 or PC19/D set 2; PAD2 PC06/D set 1 or PC18/D set 2; PAD3 PC07/D set 1 or PC17/D set 2
  parameters: CLK_REDUCTION=1 (Reduce clock options to pin 1 for SPI and USART), DMA=1 (DMA support implemented?), DMAC_ID_RX=7 (Index of DMA RX trigger), DMAC_ID_TX=8 (Index of DMA TX trigger), FIFO_IMPLEMENTED=1 (FIFO Rx/Tx implemented?), FIFO_SIZE=16 (Rx-Tx FIFO size in bytes), FSYNC_IMPLEMENTED=1 (SPI Frame Synch mode implemented?), GCLK_ID_CORE=22, GCLK_ID_SLOW=18, SPI=1 (SPI mode implemented?), TWIM=1 (TWI Master mode implemented?), TWIS=1 (TWI Slave mode implemented?), ULTRA_IMPLEMENTATION=0 (ULTRA platform compatibility?), USART=1 (USART mode implemented?), USART_AUTOBAUD=1 (USART autobaud implemented?), USART_IRDA=1 (USART IrDA implemented?), USART_ISO7816=1 (USART ISO7816 mode implemented?), USART_LIN_MASTER=1 (USART LIN Master mode implemented?), USART_RS485=1 (USART RS485 mode implemented?), INSTANCE_ID=24 (Instance index for SERCOM1), MCLK_ID_APB=32 (Index for SERCOM1 APB clock), PAC_ID=24 (Index for SERCOM1 registers write protection), USART_ERROR_INT_SRC=62 (USART/SPI/I2C Error), USART_TX_READY_INT_SRC=64 (USART-SPI Data Register Empty/ I2C Stop Received), USART_TX_COMPLETE_INT_SRC=65 (USART-SPI Transmit Complete/ I2C Address Match), USART_RX_INT_SRC=66 (USART-SPI Receive Complete/ I2C Data Ready), SPI_TX_READY_INT_SRC=64 (USART-SPI Data Register Empty/ I2C Stop Received), SPI_TX_COMPLETE_INT_SRC=65 (USART-SPI Transmit Complete/ I2C Address Match), SPI_RX_INT_SRC=66 (USART-SPI Receive Complete/ I2C Data Ready), I2C_0_INT_SRC=62 (USART/SPI/I2C Error), I2C_1_INT_SRC=66 (USART-SPI Receive Complete/ I2C Data Ready), I2C_2_INT_SRC=67 (USART Receive Start/ SPI Slave Select Low/ I2C TX FIFO Empty), I2C_3_INT_SRC=68 (USART Clear To Send Input Change/ I2C RX FIFO Full)
SERCOM2 at 0x45800000 (SERCOM)
  pins: PAD0 PC08/D set 1 or PD11/D set 2; PAD1 PC09/D set 1 or PD12/D set 2; PAD2 PC10/D set 1 or PA04/D set 2; PAD3 PC11/D set 1 or PA03/D set 2
  parameters: CLK_REDUCTION=1 (Reduce clock options to pin 1 for SPI and USART), DMA=1 (DMA support implemented?), DMAC_ID_RX=9 (Index of DMA RX trigger), DMAC_ID_TX=10 (Index of DMA TX trigger), FIFO_IMPLEMENTED=1 (FIFO Rx/Tx implemented?), FIFO_SIZE=16 (Rx-Tx FIFO size in bytes), FSYNC_IMPLEMENTED=1 (SPI Frame Synch mode implemented?), GCLK_ID_CORE=23, GCLK_ID_SLOW=19, SPI=1 (SPI mode implemented?), TWIM=1 (TWI Master mode implemented?), TWIS=1 (TWI Slave mode implemented?), ULTRA_IMPLEMENTATION=0 (ULTRA platform compatibility?), USART=1 (USART mode implemented?), USART_AUTOBAUD=1 (USART autobaud implemented?), USART_IRDA=1 (USART IrDA implemented?), USART_ISO7816=1 (USART ISO7816 mode implemented?), USART_LIN_MASTER=1 (USART LIN Master mode implemented?), USART_RS485=1 (USART RS485 mode implemented?), INSTANCE_ID=25 (Instance index for SERCOM2), MCLK_ID_APB=33 (Index for SERCOM2 APB clock), PAC_ID=25 (Index for SERCOM2 registers write protection), USART_ERROR_INT_SRC=69 (USART/SPI/I2C Error), USART_TX_READY_INT_SRC=71 (USART-SPI Data Register Empty/ I2C Stop Received), USART_TX_COMPLETE_INT_SRC=72 (USART-SPI Transmit Complete/ I2C Address Match), USART_RX_INT_SRC=73 (USART-SPI Receive Complete/ I2C Data Ready), SPI_TX_READY_INT_SRC=71 (USART-SPI Data Register Empty/ I2C Stop Received), SPI_TX_COMPLETE_INT_SRC=72 (USART-SPI Transmit Complete/ I2C Address Match), SPI_RX_INT_SRC=73 (USART-SPI Receive Complete/ I2C Data Ready), I2C_0_INT_SRC=69 (USART/SPI/I2C Error), I2C_1_INT_SRC=73 (USART-SPI Receive Complete/ I2C Data Ready), I2C_2_INT_SRC=74 (USART Receive Start/ SPI Slave Select Low/ I2C TX FIFO Empty), I2C_3_INT_SRC=75 (USART Clear To Send Input Change/ I2C RX FIFO Full)
SERCOM3 at 0x45802000 (SERCOM)
  pins: PAD0 PC12/D set 1 or PD03/D set 2; PAD1 PC13/D set 1 or PD04/D set 2; PAD2 PC14/D set 1 or PD05/D set 2; PAD3 PC15/D set 1 or PD06/D set 2
  parameters: CLK_REDUCTION=1 (Reduce clock options to pin 1 for SPI and USART), DMA=1 (DMA support implemented?), DMAC_ID_RX=11 (Index of DMA RX trigger), DMAC_ID_TX=12 (Index of DMA TX trigger), FIFO_IMPLEMENTED=1 (FIFO Rx/Tx implemented?), FIFO_SIZE=16 (Rx-Tx FIFO size in bytes), FSYNC_IMPLEMENTED=1 (SPI Frame Synch mode implemented?), GCLK_ID_CORE=24, GCLK_ID_SLOW=19, SPI=1 (SPI mode implemented?), TWIM=1 (TWI Master mode implemented?), TWIS=1 (TWI Slave mode implemented?), ULTRA_IMPLEMENTATION=0 (ULTRA platform compatibility?), USART=1 (USART mode implemented?), USART_AUTOBAUD=1 (USART autobaud implemented?), USART_IRDA=1 (USART IrDA implemented?), USART_ISO7816=1 (USART ISO7816 mode implemented?), USART_LIN_MASTER=1 (USART LIN Master mode implemented?), USART_RS485=1 (USART RS485 mode implemented?), INSTANCE_ID=26 (Instance index for SERCOM3), MCLK_ID_APB=34 (Index for SERCOM3 APB clock), PAC_ID=26 (Index for SERCOM3 registers write protection), USART_ERROR_INT_SRC=76 (USART/SPI/I2C Error), USART_TX_READY_INT_SRC=78 (USART-SPI Data Register Empty/ I2C Stop Received), USART_TX_COMPLETE_INT_SRC=79 (USART-SPI Transmit Complete/ I2C Address Match), USART_RX_INT_SRC=80 (USART-SPI Receive Complete/ I2C Data Ready), SPI_TX_READY_INT_SRC=78 (USART-SPI Data Register Empty/ I2C Stop Received), SPI_TX_COMPLETE_INT_SRC=79 (USART-SPI Transmit Complete/ I2C Address Match), SPI_RX_INT_SRC=80 (USART-SPI Receive Complete/ I2C Data Ready), I2C_0_INT_SRC=76 (USART/SPI/I2C Error), I2C_1_INT_SRC=80 (USART-SPI Receive Complete/ I2C Data Ready), I2C_2_INT_SRC=81 (USART Receive Start/ SPI Slave Select Low/ I2C TX FIFO Empty), I2C_3_INT_SRC=82 (USART Clear To Send Input Change/ I2C RX FIFO Full)
SERCOM4 at 0x46004000 (SERCOM)
  pins: PAD0 PC21/D; PAD1 PC22/D; PAD2 PC23/D; PAD3 PC24/D
  parameters: CLK_REDUCTION=1 (Reduce clock options to pin 1 for SPI and USART), DMA=1 (DMA support implemented?), DMAC_ID_RX=13 (Index of DMA RX trigger), DMAC_ID_TX=14 (Index of DMA TX trigger), FIFO_IMPLEMENTED=1 (FIFO Rx/Tx implemented?), FIFO_SIZE=16 (Rx-Tx FIFO size in bytes), FSYNC_IMPLEMENTED=1 (SPI Frame Synch mode implemented?), GCLK_ID_CORE=25, GCLK_ID_SLOW=18, SPI=1 (SPI mode implemented?), TWIM=1 (TWI Master mode implemented?), TWIS=1 (TWI Slave mode implemented?), ULTRA_IMPLEMENTATION=0 (ULTRA platform compatibility?), USART=1 (USART mode implemented?), USART_AUTOBAUD=1 (USART autobaud implemented?), USART_IRDA=1 (USART IrDA implemented?), USART_ISO7816=1 (USART ISO7816 mode implemented?), USART_LIN_MASTER=1 (USART LIN Master mode implemented?), USART_RS485=1 (USART RS485 mode implemented?), INSTANCE_ID=27 (Instance index for SERCOM4), MCLK_ID_APB=35 (Index for SERCOM4 APB clock), PAC_ID=27 (Index for SERCOM4 registers write protection), USART_ERROR_INT_SRC=83 (USART/SPI/I2C Error), USART_TX_READY_INT_SRC=85 (USART-SPI Data Register Empty/ I2C Stop Received), USART_TX_COMPLETE_INT_SRC=76 (USART-SPI Transmit Complete/ I2C Address Match), USART_RX_INT_SRC=87 (USART-SPI Receive Complete/ I2C Data Ready), SPI_TX_READY_INT_SRC=85 (USART-SPI Data Register Empty/ I2C Stop Received), SPI_TX_COMPLETE_INT_SRC=86 (USART-SPI Transmit Complete/ I2C Address Match), SPI_RX_INT_SRC=87 (USART-SPI Receive Complete/ I2C Data Ready), I2C_0_INT_SRC=83 (USART/SPI/I2C Error), I2C_1_INT_SRC=87 (USART-SPI Receive Complete/ I2C Data Ready), I2C_2_INT_SRC=88 (USART Receive Start/ SPI Slave Select Low/ I2C TX FIFO Empty), I2C_3_INT_SRC=89 (USART Clear To Send Input Change/ I2C RX FIFO Full)
SERCOM5 at 0x45804000 (SERCOM)
  pins: PAD0 PC25/D; PAD1 PC26/D; PAD2 PC27/D; PAD3 PC28/D
  parameters: CLK_REDUCTION=1 (Reduce clock options to pin 1 for SPI and USART), DMA=1 (DMA support implemented?), DMAC_ID_RX=15 (Index of DMA RX trigger), DMAC_ID_TX=16 (Index of DMA TX trigger), FIFO_IMPLEMENTED=1 (FIFO Rx/Tx implemented?), FIFO_SIZE=16 (Rx-Tx FIFO size in bytes), FSYNC_IMPLEMENTED=1 (SPI Frame Synch mode implemented?), GCLK_ID_CORE=26, GCLK_ID_SLOW=19, SPI=1 (SPI mode implemented?), TWIM=1 (TWI Master mode implemented?), TWIS=1 (TWI Slave mode implemented?), ULTRA_IMPLEMENTATION=0 (ULTRA platform compatibility?), USART=1 (USART mode implemented?), USART_AUTOBAUD=1 (USART autobaud implemented?), USART_IRDA=1 (USART IrDA implemented?), USART_ISO7816=1 (USART ISO7816 mode implemented?), USART_LIN_MASTER=1 (USART LIN Master mode implemented?), USART_RS485=1 (USART RS485 mode implemented?), INSTANCE_ID=28 (Instance index for SERCOM5), MCLK_ID_APB=36 (Index for SERCOM5 APB clock), PAC_ID=28 (Index for SERCOM5 registers write protection), USART_ERROR_INT_SRC=90 (USART/SPI/I2C Error), USART_TX_READY_INT_SRC=92 (USART-SPI Data Register Empty/ I2C Stop Received), USART_TX_COMPLETE_INT_SRC=93 (USART-SPI Transmit Complete/ I2C Address Match), USART_RX_INT_SRC=94 (USART-SPI Receive Complete/ I2C Data Ready), SPI_TX_READY_INT_SRC=92 (USART-SPI Data Register Empty/ I2C Stop Received), SPI_TX_COMPLETE_INT_SRC=93 (USART-SPI Transmit Complete/ I2C Address Match), SPI_RX_INT_SRC=94 (USART-SPI Receive Complete/ I2C Data Ready), I2C_0_INT_SRC=90 (USART/SPI/I2C Error), I2C_1_INT_SRC=94 (USART-SPI Receive Complete/ I2C Data Ready), I2C_2_INT_SRC=95 (USART Receive Start/ SPI Slave Select Low/ I2C TX FIFO Empty), I2C_3_INT_SRC=96 (USART Clear To Send Input Change/ I2C RX FIFO Full)
SPI_IXS0 at 0x46030000 (SPI_IXS)
  pins: FSYNC PC00/J set 1 or PD02/J set 2; SCK PC01/J set 1 or PD04/J set 2; SDI PC02/J set 1 or PD03/J set 2; SDO PC03/J set 1 or PD05/J set 2; MCLK0 PC04/J or PD06/J
  parameters: DMAC_ID_RX=79, DMAC_ID_TX=80, GCLK_ID=44 (Index of Generic Clock), TPD_MASTER=0 (Indicates a master or slave number for TPD mode( 1=master,0=slave)), INSTANCE_ID=46 (Instance index for SPI_IXS0), MCLK_ID_APB=54 (Index for SPI_IXS0 APB clock), PAC_ID=46 (Index for SPI_IXS0 registers write protection)
SQI0 at 0x4F008000 (SQI)
  pins: CLK PC08/H; CS0 PC13/H; CS1 PC15/H; DATA0 PC09/H; DATA1 PC10/H; DATA2 PC11/H; DATA3 PC12/H
  parameters: CBUF_DEPTH=3, GCLK_ID=56 (Index of Generic Clock), SFR_ADDRESS=0x4f008000, TRXBUF_DEPTH=8, XIP_ADDRESS=0x80, XIP_CS_MSB=1, XIP_HSEL=0, INSTANCE_ID=57 (Instance index for SQI0), MCLK_ID_AHB=66 (Index for SQI0 AHB clock), PAC_ID=57 (Index for SQI0 registers write protection)
SUPC at 0x44020000
  parameters: ADDVREG_NUM=3 (Number of additional capless regulators for USB, PLL, ...), ADDVREG_PLL_NUM=1 (Number of additional capless regulators dedicated to PLL(s) (between 0 and ADDVREG_NUM)), ADDVREG_PLL_START_INDEX=2 (Index of the first additional capless regulator dedicated to a PLL within [ADDVREG_NUM-1:0] range. Must be equal to 1 if ADDVREG_PLL_NUM=0.), BKOUT_NUM=2 (Number of BKOUT output pin), BORVDDUSB_NUM=2 (Number of BOR_USB), CHRG_PUMP_NUM=3 (Number of Charge Pump), IOB_IMPLEMENTED=0 (one if IOB feature is implemented), USER_LDO_IMPLEMENTED=0 (one if USER_LDO feature is implemented), VBAT_IMPLEMENTED=0 (one if VBAT feature (battery backup feature) is implemented.), VREGSW_NUM=4 (Number of main voltage regulator (100mA). Example: 1 for Unicorn, 4 for Riverside.), INSTANCE_ID=4 (Instance index for SUPC), MCLK_ID_APB=7 (Index for SUPC APB clock), PAC_ID=4 (Index for SUPC registers write protection)
SysTick at 0xE000E010
SystemControl at 0xE000E000
TCC0 at 0x45010000 (TCC)
  pins: WO{n} PC{n:02}/F (n=0..7)
  parameters: CC_NUM=8 (Number of Compare/Capture units), DITHERING=1 (Dithering feature implemented), DMAC_ID_MC_{n}={n+26} (Indexes of DMA Match/Compare triggers {n}) (n=0..7), DMAC_ID_OVF=25 (DMA overflow/underflow/retrigger trigger), DTI=1 (Dead-Time-Insertion feature implemented), GCLK_ID=31 (Index of Generic Clock), MASTER_SLAVE_MODE=0 (TCC type 0 : NA, 1 : Master, 2 : Slave), OTMX=1 (Output Matrix feature implemented), OW_NUM=8 (Number of Output Waveforms), PG=1 (Pattern Generation feature implemented), SIZE=32, SWAP=1 (DTI outputs swap feature implemented), INSTANCE_ID=33 (Instance index for TCC0), MCLK_ID_APB=41 (Index for TCC0 APB clock), PAC_ID=33 (Index for TCC0 registers write protection)
TCC1 at 0x45012000 (TCC)
  pins: WO{n} PB{n+10}/F (n=0..7)
  parameters: CC_NUM=8 (Number of Compare/Capture units), DITHERING=1 (Dithering feature implemented), DMAC_ID_MC_{n}={n+35} (Indexes of DMA Match/Compare triggers {n}) (n=0..7), DMAC_ID_OVF=34 (DMA overflow/underflow/retrigger trigger), DTI=1 (Dead-Time-Insertion feature implemented), GCLK_ID=32 (Index of Generic Clock), MASTER_SLAVE_MODE=0 (TCC type 0 : NA, 1 : Master, 2 : Slave), OTMX=1 (Output Matrix feature implemented), OW_NUM=8 (Number of Output Waveforms), PG=1 (Pattern Generation feature implemented), SIZE=32, SWAP=1 (DTI outputs swap feature implemented), INSTANCE_ID=34 (Instance index for TCC1), MCLK_ID_APB=42 (Index for TCC1 APB clock), PAC_ID=34 (Index for TCC1 registers write protection)
TCC2 at 0x45014000 (TCC)
  pins: WO0 PD10/F set 1; WO1 PD11/F set 1; WO2 PD12/F set 1; WO3 PA04/F set 1; WO4 PA03/F set 1; WO5 PA02/F set 1
  parameters: CC_NUM=6 (Number of Compare/Capture units), DITHERING=1 (Dithering feature implemented), DMAC_ID_MC_{n}={n+44} (Indexes of DMA Match/Compare triggers {n}) (n=0..5), DMAC_ID_OVF=43 (DMA overflow/underflow/retrigger trigger), DTI=1 (Dead-Time-Insertion feature implemented), GCLK_ID=33 (Index of Generic Clock), MASTER_SLAVE_MODE=0 (TCC type 0 : NA, 1 : Master, 2 : Slave), OTMX=1 (Output Matrix feature implemented), OW_NUM=6 (Number of Output Waveforms), PG=1 (Pattern Generation feature implemented), SIZE=32, SWAP=1 (DTI outputs swap feature implemented), INSTANCE_ID=35 (Instance index for TCC2), MCLK_ID_APB=43 (Index for TCC2 APB clock), PAC_ID=35 (Index for TCC2 registers write protection)
TCC3 at 0x45810000 (TCC)
  pins: WO0 PA05/F; WO1 PA06/F
  parameters: CC_NUM=2 (Number of Compare/Capture units), DITHERING=1 (Dithering feature implemented), DMAC_ID_MC_0=51 (Indexes of DMA Match/Compare triggers 0), DMAC_ID_MC_1=52 (Indexes of DMA Match/Compare triggers 1), DMAC_ID_OVF=50 (DMA overflow/underflow/retrigger trigger), DTI=1 (Dead-Time-Insertion feature implemented), GCLK_ID=34 (Index of Generic Clock), MASTER_SLAVE_MODE=0 (TCC type 0 : NA, 1 : Master, 2 : Slave), OTMX=1 (Output Matrix feature implemented), OW_NUM=2 (Number of Output Waveforms), PG=1 (Pattern Generation feature implemented), SIZE=32, SWAP=1 (DTI outputs swap feature implemented), INSTANCE_ID=36 (Instance index for TCC3), MCLK_ID_APB=44 (Index for TCC3 APB clock), PAC_ID=36 (Index for TCC3 registers write protection)
TCC4 at 0x45812000 (TCC)
  pins: WO0 PC12/F set 1 or PC29/F set 2; WO1 PC13/F set 1 or PD13/F set 2
  parameters: CC_NUM=2 (Number of Compare/Capture units), DITHERING=1 (Dithering feature implemented), DMAC_ID_MC_0=54 (Indexes of DMA Match/Compare triggers 0), DMAC_ID_MC_1=55 (Indexes of DMA Match/Compare triggers 1), DMAC_ID_OVF=53 (DMA overflow/underflow/retrigger trigger), DTI=1 (Dead-Time-Insertion feature implemented), GCLK_ID=35 (Index of Generic Clock), MASTER_SLAVE_MODE=0 (TCC type 0 : NA, 1 : Master, 2 : Slave), OTMX=1 (Output Matrix feature implemented), OW_NUM=2 (Number of Output Waveforms), PG=1 (Pattern Generation feature implemented), SIZE=32, SWAP=1 (DTI outputs swap feature implemented), INSTANCE_ID=37 (Instance index for TCC4), MCLK_ID_APB=45 (Index for TCC4 APB clock), PAC_ID=37 (Index for TCC4 registers write protection)
TCC5 at 0x46010000 (TCC)
  pins: WO0 PC08/F set 1 or PC23/F set 2; WO1 PC09/F set 1 or PC24/F set 2
  parameters: CC_NUM=2 (Number of Compare/Capture units), DITHERING=1 (Dithering feature implemented), DMAC_ID_MC_0=57 (Indexes of DMA Match/Compare triggers 0), DMAC_ID_MC_1=58 (Indexes of DMA Match/Compare triggers 1), DMAC_ID_OVF=56 (DMA overflow/underflow/retrigger trigger), DTI=1 (Dead-Time-Insertion feature implemented), GCLK_ID=36 (Index of Generic Clock), MASTER_SLAVE_MODE=0 (TCC type 0 : NA, 1 : Master, 2 : Slave), OTMX=1 (Output Matrix feature implemented), OW_NUM=2 (Number of Output Waveforms), PG=1 (Pattern Generation feature implemented), SIZE=32, SWAP=1 (DTI outputs swap feature implemented), INSTANCE_ID=38 (Instance index for TCC5), MCLK_ID_APB=46 (Index for TCC5 APB clock), PAC_ID=38 (Index for TCC5 registers write protection)
TCC6 at 0x46012000 (TCC)
  pins: WO0 PC10/F set 1 or PC21/F set 2; WO1 PC11/F set 1 or PC22/F set 2
  parameters: CC_NUM=2 (Number of Compare/Capture units), DITHERING=1 (Dithering feature implemented), DMAC_ID_MC_0=60 (Indexes of DMA Match/Compare triggers 0), DMAC_ID_MC_1=61 (Indexes of DMA Match/Compare triggers 1), DMAC_ID_OVF=59 (DMA overflow/underflow/retrigger trigger), DTI=1 (Dead-Time-Insertion feature implemented), GCLK_ID=37 (Index of Generic Clock), MASTER_SLAVE_MODE=0 (TCC type 0 : NA, 1 : Master, 2 : Slave), OTMX=0 (Output Matrix feature implemented), OW_NUM=2 (Number of Output Waveforms), PG=0 (Pattern Generation feature implemented), SIZE=32, SWAP=1 (DTI outputs swap feature implemented), INSTANCE_ID=39 (Instance index for TCC6), MCLK_ID_APB=47 (Index for TCC6 APB clock), PAC_ID=39 (Index for TCC6 registers write protection)
TCC7 at 0x46810000 (TCC)
  pins: WO0 PA22/F set 1 or PD08/F set 2; WO1 PA23/F set 1 or PD07/F set 2
  parameters: CC_NUM=2 (Number of Compare/Capture units), DITHERING=1 (Dithering feature implemented), DMAC_ID_MC_0=63 (Indexes of DMA Match/Compare triggers 0), DMAC_ID_MC_1=64 (Indexes of DMA Match/Compare triggers 1), DMAC_ID_OVF=62 (DMA overflow/underflow/retrigger trigger), DTI=1 (Dead-Time-Insertion feature implemented), GCLK_ID=38 (Index of Generic Clock), MASTER_SLAVE_MODE=0 (TCC type 0 : NA, 1 : Master, 2 : Slave), OTMX=0 (Output Matrix feature implemented), OW_NUM=2 (Number of Output Waveforms), PG=0 (Pattern Generation feature implemented), SIZE=32, SWAP=1 (DTI outputs swap feature implemented), INSTANCE_ID=40 (Instance index for TCC7), MCLK_ID_APB=48 (Index for TCC7 APB clock), PAC_ID=40 (Index for TCC7 registers write protection)
TCC8 at 0x46812000 (TCC)
  pins: WO0 PA21/F set 1 or PC14/F set 2; WO1 PC15/F set 1
  parameters: CC_NUM=2 (Number of Compare/Capture units), DITHERING=1 (Dithering feature implemented), DMAC_ID_MC_0=66 (Indexes of DMA Match/Compare triggers 0), DMAC_ID_MC_1=67 (Indexes of DMA Match/Compare triggers 1), DMAC_ID_OVF=65 (DMA overflow/underflow/retrigger trigger), DTI=1 (Dead-Time-Insertion feature implemented), GCLK_ID=39 (Index of Generic Clock), MASTER_SLAVE_MODE=0 (TCC type 0 : NA, 1 : Master, 2 : Slave), OTMX=0 (Output Matrix feature implemented), OW_NUM=2 (Number of Output Waveforms), PG=0 (Pattern Generation feature implemented), SIZE=32, SWAP=1 (DTI outputs swap feature implemented), INSTANCE_ID=41 (Instance index for TCC8), MCLK_ID_APB=49 (Index for TCC8 APB clock), PAC_ID=41 (Index for TCC8 registers write protection)
TCC9 at 0x46814000 (TCC)
  pins: WO0 PD04/F set 1; WO1 PD05/F set 1; WO2 PD06/F set 1; WO3 PD03/F set 1; WO4 PD02/F set 1; WO5 PC20/F set 1
  parameters: CC_NUM=6 (Number of Compare/Capture units), DITHERING=1 (Dithering feature implemented), DMAC_ID_MC_{n}={n+69} (Indexes of DMA Match/Compare triggers {n}) (n=0..5), DMAC_ID_OVF=68 (DMA overflow/underflow/retrigger trigger), DTI=1 (Dead-Time-Insertion feature implemented), GCLK_ID=40 (Index of Generic Clock), MASTER_SLAVE_MODE=0 (TCC type 0 : NA, 1 : Master, 2 : Slave), OTMX=1 (Output Matrix feature implemented), OW_NUM=6 (Number of Output Waveforms), PG=1 (Pattern Generation feature implemented), SIZE=32, SWAP=1 (DTI outputs swap feature implemented), INSTANCE_ID=42 (Instance index for TCC9), MCLK_ID_APB=50 (Index for TCC9 APB clock), PAC_ID=42 (Index for TCC9 registers write protection)
TPI at 0xE0040000
TRAM at 0x44824000
  parameters: ADDR_MSB=10 (Value of the MSB bit of physical RAM address), INSTANCE_ID=17 (Instance index for TRAM), MCLK_ID_APB=21 (Index for TRAM APB clock), PAC_ID=17 (Index for TRAM registers write protection)
TRNG at 0x44870000
  parameters: INSTANCE_ID=59 (Instance index for TRNG), MCLK_ID_APB=68 (Index for TRNG APB clock), PAC_ID=59 (Index for TRNG registers write protection)
USBHS0 at 0x4F010000 (USBHS)
  pins: USB0ID USBID0; USB0PN USBDM0; USB0PP USBDP0; USBRBIAS USBRBIAS0; VBUS VBUS0
  parameters: MCLK_ID_AHB=73 (Index for USBHS0 AHB clock)
WDT at 0x44070000
  parameters: FUSES_UPDATE_SUPPORT=0 (WDT Fuse Update Support), INSTANCE_ID=11 (Instance index for WDT), MCLK_ID_APB=14 (Index for WDT APB clock), PAC_ID=11 (Index for WDT registers write protection)

## Notices in the file
Copyright (c) 2021 Microchip Technology Inc.
SPDX-License-Identifier: Apache-2.0
Licensed under the Apache License, Version 2.0 (the "License");
you may not use this file except in compliance with the License.
You may obtain a copy of the License at
http://www.apache.org/licenses/LICENSE-2.0
Unless required by applicable law or agreed to in writing, software
distributed under the License is distributed on an "AS IS" BASIS,
WITHOUT WARRANTIES OR CONDITIONS OF ANY KIND, either express or implied.
See the License for the specific language governing permissions and
limitations under the License.
